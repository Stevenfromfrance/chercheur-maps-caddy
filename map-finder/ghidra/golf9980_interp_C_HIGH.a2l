ASAP2_VERSION 1 60
/begin PROJECT PCR21_9980_RE "Reverse-engineered stub - NOT OEM A2L"
/begin MODULE PCR21_SM2G0P_9980 "Golf 03L997558A 9980; names from map_interp_C families"
/* Generated by scan_interp_families.py --hub map_interp_C. Do not treat IdNames as Siemens. */
/* HIGH clusters only (n>=4). */
/begin AXIS_PTS AX_1B674C "RE axis (code ptr, not OEM AXIS_PTS)" 0x1B674C RL_IDENTITY 0 NO_INPUT_QUANTITY 1.0 7 FORMAT "%%5.0" /end AXIS_PTS
/begin CHARACTERISTIC C_lookup_ax_X_Y_19E4AC "RE curve family C_fam_0007 n=3" CURVE 0x19E4AC RL_IDENTITY 0 NO_INPUT_QUANTITY 1.0 FORMAT "%%5.0"
 /begin AXIS_DESCR COM_AXIS NO_INPUT_QUANTITY NO_COMPU_METHOD 7 AXIS_PTS_REF AX_1B674C /end AXIS_DESCR
/end CHARACTERISTIC
/begin CHARACTERISTIC C_lookup_ax_X_Y_1D39D8 "RE curve family C_fam_0007 n=3" CURVE 0x1D39D8 RL_IDENTITY 0 NO_INPUT_QUANTITY 1.0 FORMAT "%%5.0"
 /begin AXIS_DESCR COM_AXIS NO_INPUT_QUANTITY NO_COMPU_METHOD 7 AXIS_PTS_REF AX_1B674C /end AXIS_DESCR
/end CHARACTERISTIC
/begin AXIS_PTS AX_1AC8E0 "RE axis (code ptr, not OEM AXIS_PTS)" 0x1AC8E0 RL_IDENTITY 0 NO_INPUT_QUANTITY 1.0 4 FORMAT "%%5.0" /end AXIS_PTS
/begin AXIS_PTS AY_1A9200 "RE axis (code ptr, not OEM AXIS_PTS)" 0x1A9200 RL_IDENTITY 0 NO_INPUT_QUANTITY 1.0 7 FORMAT "%%5.0" /end AXIS_PTS
/begin CHARACTERISTIC C_lookup_ax_X_Y_19D4B4 "RE lookup family C_fam_0020 n=2" MAP 0x19D4B4 RL_IDENTITY 0 NO_INPUT_QUANTITY 1.0 FORMAT "%%5.0"
 /begin AXIS_DESCR COM_AXIS NO_INPUT_QUANTITY NO_COMPU_METHOD 4 AXIS_PTS_REF AX_1AC8E0 /end AXIS_DESCR
 /begin AXIS_DESCR COM_AXIS NO_INPUT_QUANTITY NO_COMPU_METHOD 7 AXIS_PTS_REF AY_1A9200 /end AXIS_DESCR
/end CHARACTERISTIC
/begin AXIS_PTS AX_1AF82C "RE axis (code ptr, not OEM AXIS_PTS)" 0x1AF82C RL_IDENTITY 0 NO_INPUT_QUANTITY 1.0 4 FORMAT "%%5.0" /end AXIS_PTS
/begin CHARACTERISTIC C_lookup_ax_X_Y_1C3A9C "RE curve family C_fam_0033 n=2" CURVE 0x1C3A9C RL_IDENTITY 0 NO_INPUT_QUANTITY 1.0 FORMAT "%%5.0"
 /begin AXIS_DESCR COM_AXIS NO_INPUT_QUANTITY NO_COMPU_METHOD 4 AXIS_PTS_REF AX_1AF82C /end AXIS_DESCR
/end CHARACTERISTIC
/begin CHARACTERISTIC C_lookup_ax_X_Y_1C3A70 "RE curve family C_fam_0033 n=2" CURVE 0x1C3A70 RL_IDENTITY 0 NO_INPUT_QUANTITY 1.0 FORMAT "%%5.0"
 /begin AXIS_DESCR COM_AXIS NO_INPUT_QUANTITY NO_COMPU_METHOD 4 AXIS_PTS_REF AX_1AF82C /end AXIS_DESCR
/end CHARACTERISTIC
/begin AXIS_PTS AX_1AE848 "RE axis (code ptr, not OEM AXIS_PTS)" 0x1AE848 RL_IDENTITY 0 NO_INPUT_QUANTITY 1.0 4 FORMAT "%%5.0" /end AXIS_PTS
/begin AXIS_PTS AY_1AA974 "RE axis (code ptr, not OEM AXIS_PTS)" 0x1AA974 RL_IDENTITY 0 NO_INPUT_QUANTITY 1.0 32 FORMAT "%%5.0" /end AXIS_PTS
/begin CHARACTERISTIC C_lookup_ax_X_Y_1EBDF0 "RE lookup family C_fam_0026 n=2" MAP 0x1EBDF0 RL_IDENTITY 0 NO_INPUT_QUANTITY 1.0 FORMAT "%%5.0"
 /begin AXIS_DESCR COM_AXIS NO_INPUT_QUANTITY NO_COMPU_METHOD 4 AXIS_PTS_REF AX_1AE848 /end AXIS_DESCR
 /begin AXIS_DESCR COM_AXIS NO_INPUT_QUANTITY NO_COMPU_METHOD 32 AXIS_PTS_REF AY_1AA974 /end AXIS_DESCR
/end CHARACTERISTIC
/begin CHARACTERISTIC C_lookup_ax_X_Y_1F2D9C "RE lookup family C_fam_0026 n=2" MAP 0x1F2D9C RL_IDENTITY 0 NO_INPUT_QUANTITY 1.0 FORMAT "%%5.0"
 /begin AXIS_DESCR COM_AXIS NO_INPUT_QUANTITY NO_COMPU_METHOD 4 AXIS_PTS_REF AX_1AE848 /end AXIS_DESCR
 /begin AXIS_DESCR COM_AXIS NO_INPUT_QUANTITY NO_COMPU_METHOD 32 AXIS_PTS_REF AY_1AA974 /end AXIS_DESCR
/end CHARACTERISTIC
/begin AXIS_PTS AX_1B1908 "RE axis (code ptr, not OEM AXIS_PTS)" 0x1B1908 RL_IDENTITY 0 NO_INPUT_QUANTITY 1.0 4 FORMAT "%%5.0" /end AXIS_PTS
/begin CHARACTERISTIC C_lookup_ax_X_Y_1CD9F8 "RE curve family C_fam_0010 n=3" CURVE 0x1CD9F8 RL_IDENTITY 0 NO_INPUT_QUANTITY 1.0 FORMAT "%%5.0"
 /begin AXIS_DESCR COM_AXIS NO_INPUT_QUANTITY NO_COMPU_METHOD 4 AXIS_PTS_REF AX_1B1908 /end AXIS_DESCR
/end CHARACTERISTIC
/begin CHARACTERISTIC C_lookup_ax_X_Y_1C89D8 "RE curve family C_fam_0010 n=3" CURVE 0x1C89D8 RL_IDENTITY 0 NO_INPUT_QUANTITY 1.0 FORMAT "%%5.0"
 /begin AXIS_DESCR COM_AXIS NO_INPUT_QUANTITY NO_COMPU_METHOD 4 AXIS_PTS_REF AX_1B1908 /end AXIS_DESCR
/end CHARACTERISTIC
/begin CHARACTERISTIC C_lookup_ax_X_Y_1CDE44 "RE curve family C_fam_0010 n=3" CURVE 0x1CDE44 RL_IDENTITY 0 NO_INPUT_QUANTITY 1.0 FORMAT "%%5.0"
 /begin AXIS_DESCR COM_AXIS NO_INPUT_QUANTITY NO_COMPU_METHOD 4 AXIS_PTS_REF AX_1B1908 /end AXIS_DESCR
/end CHARACTERISTIC
/begin AXIS_PTS AX_1A53D4 "RE axis (code ptr, not OEM AXIS_PTS)" 0x1A53D4 RL_IDENTITY 0 NO_INPUT_QUANTITY 1.0 9 FORMAT "%%5.0" /end AXIS_PTS
/begin CHARACTERISTIC C_lookup_ax_X_Y_1C3A4C "RE curve family C_fam_0009 n=3" CURVE 0x1C3A4C RL_IDENTITY 0 NO_INPUT_QUANTITY 1.0 FORMAT "%%5.0"
 /begin AXIS_DESCR COM_AXIS NO_INPUT_QUANTITY NO_COMPU_METHOD 9 AXIS_PTS_REF AX_1A53D4 /end AXIS_DESCR
/end CHARACTERISTIC
/begin CHARACTERISTIC C_lookup_ax_X_Y_1C3A84 "RE curve family C_fam_0009 n=3" CURVE 0x1C3A84 RL_IDENTITY 0 NO_INPUT_QUANTITY 1.0 FORMAT "%%5.0"
 /begin AXIS_DESCR COM_AXIS NO_INPUT_QUANTITY NO_COMPU_METHOD 9 AXIS_PTS_REF AX_1A53D4 /end AXIS_DESCR
/end CHARACTERISTIC
/begin AXIS_PTS AX_1BFA78 "RE axis (code ptr, not OEM AXIS_PTS)" 0x1BFA78 RL_IDENTITY 0 NO_INPUT_QUANTITY 1.0 4 FORMAT "%%5.0" /end AXIS_PTS
/begin CHARACTERISTIC C_lookup_D0001DC6_x_D0001DC4_19A51C "RE curve family C_fam_0038 n=2" CURVE 0x19A51C RL_IDENTITY 0 NO_INPUT_QUANTITY 1.0 FORMAT "%%5.0"
 /begin AXIS_DESCR COM_AXIS NO_INPUT_QUANTITY NO_COMPU_METHOD 4 AXIS_PTS_REF AX_1BFA78 /end AXIS_DESCR
/end CHARACTERISTIC
/begin AXIS_PTS AX_1BB9C0 "RE axis (code ptr, not OEM AXIS_PTS)" 0x1BB9C0 RL_IDENTITY 0 NO_INPUT_QUANTITY 1.0 4 FORMAT "%%5.0" /end AXIS_PTS
/begin CHARACTERISTIC C_lookup_ax_X_Y_1C79A8 "RE curve family C_fam_0037 n=2" CURVE 0x1C79A8 RL_IDENTITY 0 NO_INPUT_QUANTITY 1.0 FORMAT "%%5.0"
 /begin AXIS_DESCR COM_AXIS NO_INPUT_QUANTITY NO_COMPU_METHOD 4 AXIS_PTS_REF AX_1BB9C0 /end AXIS_DESCR
/end CHARACTERISTIC
/begin CHARACTERISTIC C_lookup_ax_X_Y_1C3938 "RE curve family C_fam_0037 n=2" CURVE 0x1C3938 RL_IDENTITY 0 NO_INPUT_QUANTITY 1.0 FORMAT "%%5.0"
 /begin AXIS_DESCR COM_AXIS NO_INPUT_QUANTITY NO_COMPU_METHOD 4 AXIS_PTS_REF AX_1BB9C0 /end AXIS_DESCR
/end CHARACTERISTIC
/begin AXIS_PTS AX_1AB8F8 "RE axis (code ptr, not OEM AXIS_PTS)" 0x1AB8F8 RL_IDENTITY 0 NO_INPUT_QUANTITY 1.0 4 FORMAT "%%5.0" /end AXIS_PTS
/begin CHARACTERISTIC C_lookup_ax_X_Y_1D7090 "RE curve family C_fam_0042 n=2" CURVE 0x1D7090 RL_IDENTITY 0 NO_INPUT_QUANTITY 1.0 FORMAT "%%5.0"
 /begin AXIS_DESCR COM_AXIS NO_INPUT_QUANTITY NO_COMPU_METHOD 4 AXIS_PTS_REF AX_1AB8F8 /end AXIS_DESCR
/end CHARACTERISTIC
/begin CHARACTERISTIC C_lookup_ax_X_Y_1C8090 "RE curve family C_fam_0042 n=2" CURVE 0x1C8090 RL_IDENTITY 0 NO_INPUT_QUANTITY 1.0 FORMAT "%%5.0"
 /begin AXIS_DESCR COM_AXIS NO_INPUT_QUANTITY NO_COMPU_METHOD 4 AXIS_PTS_REF AX_1AB8F8 /end AXIS_DESCR
/end CHARACTERISTIC
/begin AXIS_PTS AX_1A140C "RE axis (code ptr, not OEM AXIS_PTS)" 0x1A140C RL_IDENTITY 0 NO_INPUT_QUANTITY 1.0 4 FORMAT "%%5.0" /end AXIS_PTS
/begin AXIS_PTS AY_1A3538 "RE axis (code ptr, not OEM AXIS_PTS)" 0x1A3538 RL_IDENTITY 0 NO_INPUT_QUANTITY 1.0 4 FORMAT "%%5.0" /end AXIS_PTS
/begin CHARACTERISTIC C_lookup_ax_X_Y_1D3928 "RE lookup family C_fam_0012 n=2" MAP 0x1D3928 RL_IDENTITY 0 NO_INPUT_QUANTITY 1.0 FORMAT "%%5.0"
 /begin AXIS_DESCR COM_AXIS NO_INPUT_QUANTITY NO_COMPU_METHOD 4 AXIS_PTS_REF AX_1A140C /end AXIS_DESCR
 /begin AXIS_DESCR COM_AXIS NO_INPUT_QUANTITY NO_COMPU_METHOD 4 AXIS_PTS_REF AY_1A3538 /end AXIS_DESCR
/end CHARACTERISTIC
/begin AXIS_PTS AX_1BC8F4 "RE axis (code ptr, not OEM AXIS_PTS)" 0x1BC8F4 RL_IDENTITY 0 NO_INPUT_QUANTITY 1.0 9 FORMAT "%%5.0" /end AXIS_PTS
/begin CHARACTERISTIC C_lookup_ax_X_Y_19C3E8 "RE curve family C_fam_0008 n=3" CURVE 0x19C3E8 RL_IDENTITY 0 NO_INPUT_QUANTITY 1.0 FORMAT "%%5.0"
 /begin AXIS_DESCR COM_AXIS NO_INPUT_QUANTITY NO_COMPU_METHOD 9 AXIS_PTS_REF AX_1BC8F4 /end AXIS_DESCR
/end CHARACTERISTIC
/begin AXIS_PTS AX_1AC8F0 "RE axis (code ptr, not OEM AXIS_PTS)" 0x1AC8F0 RL_IDENTITY 0 NO_INPUT_QUANTITY 1.0 4 FORMAT "%%5.0" /end AXIS_PTS
/begin CHARACTERISTIC C_lookup_D001481A_x_D001481A_1D787C "RE curve family C_fam_0040 n=2" CURVE 0x1D787C RL_IDENTITY 0 NO_INPUT_QUANTITY 1.0 FORMAT "%%5.0"
 /begin AXIS_DESCR COM_AXIS NO_INPUT_QUANTITY NO_COMPU_METHOD 4 AXIS_PTS_REF AX_1AC8F0 /end AXIS_DESCR
/end CHARACTERISTIC
/begin AXIS_PTS AX_1B6938 "RE axis (code ptr, not OEM AXIS_PTS)" 0x1B6938 RL_IDENTITY 0 NO_INPUT_QUANTITY 1.0 4 FORMAT "%%5.0" /end AXIS_PTS
/begin AXIS_PTS AY_1AA840 "RE axis (code ptr, not OEM AXIS_PTS)" 0x1AA840 RL_IDENTITY 0 NO_INPUT_QUANTITY 1.0 32 FORMAT "%%5.0" /end AXIS_PTS
/begin CHARACTERISTIC C_lookup_ax_X_Y_1CDE8C "RE lookup family C_fam_0030 n=2" MAP 0x1CDE8C RL_IDENTITY 0 NO_INPUT_QUANTITY 1.0 FORMAT "%%5.0"
 /begin AXIS_DESCR COM_AXIS NO_INPUT_QUANTITY NO_COMPU_METHOD 4 AXIS_PTS_REF AX_1B6938 /end AXIS_DESCR
 /begin AXIS_DESCR COM_AXIS NO_INPUT_QUANTITY NO_COMPU_METHOD 32 AXIS_PTS_REF AY_1AA840 /end AXIS_DESCR
/end CHARACTERISTIC
/begin AXIS_PTS AX_1B58F4 "RE axis (code ptr, not OEM AXIS_PTS)" 0x1B58F4 RL_IDENTITY 0 NO_INPUT_QUANTITY 1.0 4 FORMAT "%%5.0" /end AXIS_PTS
/begin CHARACTERISTIC C_lookup_ax_X_Y_1D5020 "RE curve family C_fam_0006 n=3" CURVE 0x1D5020 RL_IDENTITY 0 NO_INPUT_QUANTITY 1.0 FORMAT "%%5.0"
 /begin AXIS_DESCR COM_AXIS NO_INPUT_QUANTITY NO_COMPU_METHOD 4 AXIS_PTS_REF AX_1B58F4 /end AXIS_DESCR
/end CHARACTERISTIC
/begin CHARACTERISTIC C_lookup_ax_X_Y_1D4020 "RE curve family C_fam_0006 n=3" CURVE 0x1D4020 RL_IDENTITY 0 NO_INPUT_QUANTITY 1.0 FORMAT "%%5.0"
 /begin AXIS_DESCR COM_AXIS NO_INPUT_QUANTITY NO_COMPU_METHOD 4 AXIS_PTS_REF AX_1B58F4 /end AXIS_DESCR
/end CHARACTERISTIC
/begin CHARACTERISTIC C_lookup_ax_X_Y_1D6000 "RE curve family C_fam_0006 n=3" CURVE 0x1D6000 RL_IDENTITY 0 NO_INPUT_QUANTITY 1.0 FORMAT "%%5.0"
 /begin AXIS_DESCR COM_AXIS NO_INPUT_QUANTITY NO_COMPU_METHOD 4 AXIS_PTS_REF AX_1B58F4 /end AXIS_DESCR
/end CHARACTERISTIC
/begin AXIS_PTS AX_1AB81C "RE axis (code ptr, not OEM AXIS_PTS)" 0x1AB81C RL_IDENTITY 0 NO_INPUT_QUANTITY 1.0 4 FORMAT "%%5.0" /end AXIS_PTS
/begin AXIS_PTS AY_1AA908 "RE axis (code ptr, not OEM AXIS_PTS)" 0x1AA908 RL_IDENTITY 0 NO_INPUT_QUANTITY 1.0 32 FORMAT "%%5.0" /end AXIS_PTS
/begin CHARACTERISTIC C_lookup_ax_X_Y_1C7978 "RE lookup family C_fam_0017 n=2" MAP 0x1C7978 RL_IDENTITY 0 NO_INPUT_QUANTITY 1.0 FORMAT "%%5.0"
 /begin AXIS_DESCR COM_AXIS NO_INPUT_QUANTITY NO_COMPU_METHOD 4 AXIS_PTS_REF AX_1AB81C /end AXIS_DESCR
 /begin AXIS_DESCR COM_AXIS NO_INPUT_QUANTITY NO_COMPU_METHOD 32 AXIS_PTS_REF AY_1AA908 /end AXIS_DESCR
/end CHARACTERISTIC
/begin AXIS_PTS AX_1AB808 "RE axis (code ptr, not OEM AXIS_PTS)" 0x1AB808 RL_IDENTITY 0 NO_INPUT_QUANTITY 1.0 4 FORMAT "%%5.0" /end AXIS_PTS
/begin AXIS_PTS AY_1A993C "RE axis (code ptr, not OEM AXIS_PTS)" 0x1A993C RL_IDENTITY 0 NO_INPUT_QUANTITY 1.0 4 FORMAT "%%5.0" /end AXIS_PTS
/begin CHARACTERISTIC C_lookup_ax_X_Y_1C7968 "RE lookup family C_fam_0015 n=2" MAP 0x1C7968 RL_IDENTITY 0 NO_INPUT_QUANTITY 1.0 FORMAT "%%5.0"
 /begin AXIS_DESCR COM_AXIS NO_INPUT_QUANTITY NO_COMPU_METHOD 4 AXIS_PTS_REF AX_1AB808 /end AXIS_DESCR
 /begin AXIS_DESCR COM_AXIS NO_INPUT_QUANTITY NO_COMPU_METHOD 4 AXIS_PTS_REF AY_1A993C /end AXIS_DESCR
/end CHARACTERISTIC
/begin AXIS_PTS AX_1AA838 "RE axis (code ptr, not OEM AXIS_PTS)" 0x1AA838 RL_IDENTITY 0 NO_INPUT_QUANTITY 1.0 32 FORMAT "%%5.0" /end AXIS_PTS
/begin AXIS_PTS AY_1AC3F0 "RE axis (code ptr, not OEM AXIS_PTS)" 0x1AC3F0 RL_IDENTITY 0 NO_INPUT_QUANTITY 1.0 4 FORMAT "%%5.0" /end AXIS_PTS
/begin CHARACTERISTIC C_lookup_ax_X_Y_1D442C "RE lookup family C_fam_0014 n=2" MAP 0x1D442C RL_IDENTITY 0 NO_INPUT_QUANTITY 1.0 FORMAT "%%5.0"
 /begin AXIS_DESCR COM_AXIS NO_INPUT_QUANTITY NO_COMPU_METHOD 32 AXIS_PTS_REF AX_1AA838 /end AXIS_DESCR
 /begin AXIS_DESCR COM_AXIS NO_INPUT_QUANTITY NO_COMPU_METHOD 4 AXIS_PTS_REF AY_1AC3F0 /end AXIS_DESCR
/end CHARACTERISTIC
/begin AXIS_PTS AX_1B3860 "RE axis (code ptr, not OEM AXIS_PTS)" 0x1B3860 RL_IDENTITY 0 NO_INPUT_QUANTITY 1.0 4 FORMAT "%%5.0" /end AXIS_PTS
/begin AXIS_PTS AY_1B5978 "RE axis (code ptr, not OEM AXIS_PTS)" 0x1B5978 RL_IDENTITY 0 NO_INPUT_QUANTITY 1.0 4 FORMAT "%%5.0" /end AXIS_PTS
/begin CHARACTERISTIC C_lookup_ax_X_Y_1C3ABC "RE lookup family C_fam_0029 n=2" MAP 0x1C3ABC RL_IDENTITY 0 NO_INPUT_QUANTITY 1.0 FORMAT "%%5.0"
 /begin AXIS_DESCR COM_AXIS NO_INPUT_QUANTITY NO_COMPU_METHOD 4 AXIS_PTS_REF AX_1B3860 /end AXIS_DESCR
 /begin AXIS_DESCR COM_AXIS NO_INPUT_QUANTITY NO_COMPU_METHOD 4 AXIS_PTS_REF AY_1B5978 /end AXIS_DESCR
/end CHARACTERISTIC
/begin CHARACTERISTIC C_lookup_ax_X_Y_1C4A50 "RE lookup family C_fam_0029 n=2" MAP 0x1C4A50 RL_IDENTITY 0 NO_INPUT_QUANTITY 1.0 FORMAT "%%5.0"
 /begin AXIS_DESCR COM_AXIS NO_INPUT_QUANTITY NO_COMPU_METHOD 4 AXIS_PTS_REF AX_1B3860 /end AXIS_DESCR
 /begin AXIS_DESCR COM_AXIS NO_INPUT_QUANTITY NO_COMPU_METHOD 4 AXIS_PTS_REF AY_1B5978 /end AXIS_DESCR
/end CHARACTERISTIC
/begin AXIS_PTS AX_1A9928 "RE axis (code ptr, not OEM AXIS_PTS)" 0x1A9928 RL_IDENTITY 0 NO_INPUT_QUANTITY 1.0 4 FORMAT "%%5.0" /end AXIS_PTS
/begin CHARACTERISTIC C_lookup_ax_X_Y_1C8390 "RE curve family C_fam_0032 n=2" CURVE 0x1C8390 RL_IDENTITY 0 NO_INPUT_QUANTITY 1.0 FORMAT "%%5.0"
 /begin AXIS_DESCR COM_AXIS NO_INPUT_QUANTITY NO_COMPU_METHOD 4 AXIS_PTS_REF AX_1A9928 /end AXIS_DESCR
/end CHARACTERISTIC
/begin AXIS_PTS AX_1AFBD0 "RE axis (code ptr, not OEM AXIS_PTS)" 0x1AFBD0 RL_IDENTITY 0 NO_INPUT_QUANTITY 1.0 4 FORMAT "%%5.0" /end AXIS_PTS
/begin CHARACTERISTIC C_lookup_ax_X_Y_19F7F4 "RE curve family C_fam_0034 n=2" CURVE 0x19F7F4 RL_IDENTITY 0 NO_INPUT_QUANTITY 1.0 FORMAT "%%5.0"
 /begin AXIS_DESCR COM_AXIS NO_INPUT_QUANTITY NO_COMPU_METHOD 4 AXIS_PTS_REF AX_1AFBD0 /end AXIS_DESCR
/end CHARACTERISTIC
/begin AXIS_PTS AX_1A371C "RE axis (code ptr, not OEM AXIS_PTS)" 0x1A371C RL_IDENTITY 0 NO_INPUT_QUANTITY 1.0 4 FORMAT "%%5.0" /end AXIS_PTS
/begin CHARACTERISTIC C_lookup_ax_X_Y_1D391C "RE curve family C_fam_0043 n=2" CURVE 0x1D391C RL_IDENTITY 0 NO_INPUT_QUANTITY 1.0 FORMAT "%%5.0"
 /begin AXIS_DESCR COM_AXIS NO_INPUT_QUANTITY NO_COMPU_METHOD 4 AXIS_PTS_REF AX_1A371C /end AXIS_DESCR
/end CHARACTERISTIC
/begin AXIS_PTS AX_1A882C "RE axis (code ptr, not OEM AXIS_PTS)" 0x1A882C RL_IDENTITY 0 NO_INPUT_QUANTITY 1.0 12 FORMAT "%%5.0" /end AXIS_PTS
/begin CHARACTERISTIC C_lookup_ax_X_Y_1C8EF4 "RE curve family C_fam_0005 n=3" CURVE 0x1C8EF4 RL_IDENTITY 0 NO_INPUT_QUANTITY 1.0 FORMAT "%%5.0"
 /begin AXIS_DESCR COM_AXIS NO_INPUT_QUANTITY NO_COMPU_METHOD 12 AXIS_PTS_REF AX_1A882C /end AXIS_DESCR
/end CHARACTERISTIC
/begin CHARACTERISTIC C_lookup_ax_X_Y_1C8EE0 "RE curve family C_fam_0005 n=3" CURVE 0x1C8EE0 RL_IDENTITY 0 NO_INPUT_QUANTITY 1.0 FORMAT "%%5.0"
 /begin AXIS_DESCR COM_AXIS NO_INPUT_QUANTITY NO_COMPU_METHOD 12 AXIS_PTS_REF AX_1A882C /end AXIS_DESCR
/end CHARACTERISTIC
/begin CHARACTERISTIC C_lookup_ax_X_Y_1D4ED0 "RE curve family C_fam_0005 n=3" CURVE 0x1D4ED0 RL_IDENTITY 0 NO_INPUT_QUANTITY 1.0 FORMAT "%%5.0"
 /begin AXIS_DESCR COM_AXIS NO_INPUT_QUANTITY NO_COMPU_METHOD 12 AXIS_PTS_REF AX_1A882C /end AXIS_DESCR
/end CHARACTERISTIC
/begin AXIS_PTS AX_1A73DC "RE axis (code ptr, not OEM AXIS_PTS)" 0x1A73DC RL_IDENTITY 0 NO_INPUT_QUANTITY 1.0 4 FORMAT "%%5.0" /end AXIS_PTS
/begin AXIS_PTS AY_1AB87C "RE axis (code ptr, not OEM AXIS_PTS)" 0x1AB87C RL_IDENTITY 0 NO_INPUT_QUANTITY 1.0 4 FORMAT "%%5.0" /end AXIS_PTS
/begin CHARACTERISTIC C_lookup_ax_X_Y_1C7A24 "RE lookup family C_fam_0013 n=2" MAP 0x1C7A24 RL_IDENTITY 0 NO_INPUT_QUANTITY 1.0 FORMAT "%%5.0"
 /begin AXIS_DESCR COM_AXIS NO_INPUT_QUANTITY NO_COMPU_METHOD 4 AXIS_PTS_REF AX_1A73DC /end AXIS_DESCR
 /begin AXIS_DESCR COM_AXIS NO_INPUT_QUANTITY NO_COMPU_METHOD 4 AXIS_PTS_REF AY_1AB87C /end AXIS_DESCR
/end CHARACTERISTIC
/begin AXIS_PTS AX_1AD908 "RE axis (code ptr, not OEM AXIS_PTS)" 0x1AD908 RL_IDENTITY 0 NO_INPUT_QUANTITY 1.0 4 FORMAT "%%5.0" /end AXIS_PTS
/begin CHARACTERISTIC C_lookup_ax_X_Y_1C7A30 "RE lookup family C_fam_0022 n=2" MAP 0x1C7A30 RL_IDENTITY 0 NO_INPUT_QUANTITY 1.0 FORMAT "%%5.0"
 /begin AXIS_DESCR COM_AXIS NO_INPUT_QUANTITY NO_COMPU_METHOD 4 AXIS_PTS_REF AX_1AD908 /end AXIS_DESCR
 /begin AXIS_DESCR COM_AXIS NO_INPUT_QUANTITY NO_COMPU_METHOD 4 AXIS_PTS_REF AY_1AB87C /end AXIS_DESCR
/end CHARACTERISTIC
/begin CHARACTERISTIC C_lookup_ax_X_Y_1D0878 "RE lookup family C_fam_0022 n=2" MAP 0x1D0878 RL_IDENTITY 0 NO_INPUT_QUANTITY 1.0 FORMAT "%%5.0"
 /begin AXIS_DESCR COM_AXIS NO_INPUT_QUANTITY NO_COMPU_METHOD 4 AXIS_PTS_REF AX_1AD908 /end AXIS_DESCR
 /begin AXIS_DESCR COM_AXIS NO_INPUT_QUANTITY NO_COMPU_METHOD 4 AXIS_PTS_REF AY_1AB87C /end AXIS_DESCR
/end CHARACTERISTIC
/begin AXIS_PTS AX_1A669C "RE axis (code ptr, not OEM AXIS_PTS)" 0x1A669C RL_IDENTITY 0 NO_INPUT_QUANTITY 1.0 5 FORMAT "%%5.0" /end AXIS_PTS
/begin CHARACTERISTIC C_lookup_ax_X_Y_1D0858 "RE curve family C_fam_0031 n=2" CURVE 0x1D0858 RL_IDENTITY 0 NO_INPUT_QUANTITY 1.0 FORMAT "%%5.0"
 /begin AXIS_DESCR COM_AXIS NO_INPUT_QUANTITY NO_COMPU_METHOD 5 AXIS_PTS_REF AX_1A669C /end AXIS_DESCR
/end CHARACTERISTIC
/begin AXIS_PTS AX_1B66FC "RE axis (code ptr, not OEM AXIS_PTS)" 0x1B66FC RL_IDENTITY 0 NO_INPUT_QUANTITY 1.0 4 FORMAT "%%5.0" /end AXIS_PTS
/begin CHARACTERISTIC C_lookup_ax_X_Y_19C4B0 "RE curve family C_fam_0036 n=2" CURVE 0x19C4B0 RL_IDENTITY 0 NO_INPUT_QUANTITY 1.0 FORMAT "%%5.0"
 /begin AXIS_DESCR COM_AXIS NO_INPUT_QUANTITY NO_COMPU_METHOD 4 AXIS_PTS_REF AX_1B66FC /end AXIS_DESCR
/end CHARACTERISTIC
/begin AXIS_PTS AX_1AD940 "RE axis (code ptr, not OEM AXIS_PTS)" 0x1AD940 RL_IDENTITY 0 NO_INPUT_QUANTITY 1.0 4 FORMAT "%%5.0" /end AXIS_PTS
/begin AXIS_PTS AY_1AC970 "RE axis (code ptr, not OEM AXIS_PTS)" 0x1AC970 RL_IDENTITY 0 NO_INPUT_QUANTITY 1.0 4 FORMAT "%%5.0" /end AXIS_PTS
/begin CHARACTERISTIC C_lookup_ax_X_Y_1CFAA8 "RE lookup family C_fam_0023 n=2" MAP 0x1CFAA8 RL_IDENTITY 0 NO_INPUT_QUANTITY 1.0 FORMAT "%%5.0"
 /begin AXIS_DESCR COM_AXIS NO_INPUT_QUANTITY NO_COMPU_METHOD 4 AXIS_PTS_REF AX_1AD940 /end AXIS_DESCR
 /begin AXIS_DESCR COM_AXIS NO_INPUT_QUANTITY NO_COMPU_METHOD 4 AXIS_PTS_REF AY_1AC970 /end AXIS_DESCR
/end CHARACTERISTIC
/begin CHARACTERISTIC C_lookup_ax_X_Y_1CFA84 "RE lookup family C_fam_0023 n=2" MAP 0x1CFA84 RL_IDENTITY 0 NO_INPUT_QUANTITY 1.0 FORMAT "%%5.0"
 /begin AXIS_DESCR COM_AXIS NO_INPUT_QUANTITY NO_COMPU_METHOD 4 AXIS_PTS_REF AX_1AD940 /end AXIS_DESCR
 /begin AXIS_DESCR COM_AXIS NO_INPUT_QUANTITY NO_COMPU_METHOD 4 AXIS_PTS_REF AY_1AC970 /end AXIS_DESCR
/end CHARACTERISTIC
/begin AXIS_PTS AX_1AFC18 "RE axis (code ptr, not OEM AXIS_PTS)" 0x1AFC18 RL_IDENTITY 0 NO_INPUT_QUANTITY 1.0 4 FORMAT "%%5.0" /end AXIS_PTS
/begin CHARACTERISTIC C_lookup_ax_X_Y_19E49C "RE curve family C_fam_0035 n=2" CURVE 0x19E49C RL_IDENTITY 0 NO_INPUT_QUANTITY 1.0 FORMAT "%%5.0"
 /begin AXIS_DESCR COM_AXIS NO_INPUT_QUANTITY NO_COMPU_METHOD 4 AXIS_PTS_REF AX_1AFC18 /end AXIS_DESCR
/end CHARACTERISTIC
/end MODULE
/end PROJECT
