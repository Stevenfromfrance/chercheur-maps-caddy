ASAP2_VERSION 1 60
/begin PROJECT PCR21_9980_RE "Reverse-engineered stub - NOT OEM A2L"
/begin MODULE PCR21_SM2G0P_9980 "Golf 03L997558A 9980; names from map_interp_M families"
/* Generated by scan_interp_families.py --hub map_interp_M. Do not treat IdNames as Siemens. */
/* HIGH clusters only (n>=4). */
/begin AXIS_PTS AX_1AE94C "RE axis (code ptr, not OEM AXIS_PTS)" 0x1AE94C RL_IDENTITY 0 NO_INPUT_QUANTITY 1.0 4 FORMAT "%%5.0" /end AXIS_PTS
/begin AXIS_PTS AY_1B292C "RE axis (code ptr, not OEM AXIS_PTS)" 0x1B292C RL_IDENTITY 0 NO_INPUT_QUANTITY 1.0 4 FORMAT "%%5.0" /end AXIS_PTS
/begin CHARACTERISTIC M_lookup_ax_X_Y_1D13A8 "RE lookup family M_fam_0004 n=2" MAP 0x1D13A8 RL_IDENTITY 0 NO_INPUT_QUANTITY 1.0 FORMAT "%%5.0"
 /begin AXIS_DESCR COM_AXIS NO_INPUT_QUANTITY NO_COMPU_METHOD 4 AXIS_PTS_REF AX_1AE94C /end AXIS_DESCR
 /begin AXIS_DESCR COM_AXIS NO_INPUT_QUANTITY NO_COMPU_METHOD 4 AXIS_PTS_REF AY_1B292C /end AXIS_DESCR
/end CHARACTERISTIC
/begin CHARACTERISTIC M_lookup_ax_X_Y_1CE368 "RE lookup family M_fam_0004 n=2" MAP 0x1CE368 RL_IDENTITY 0 NO_INPUT_QUANTITY 1.0 FORMAT "%%5.0"
 /begin AXIS_DESCR COM_AXIS NO_INPUT_QUANTITY NO_COMPU_METHOD 4 AXIS_PTS_REF AX_1AE94C /end AXIS_DESCR
 /begin AXIS_DESCR COM_AXIS NO_INPUT_QUANTITY NO_COMPU_METHOD 4 AXIS_PTS_REF AY_1B292C /end AXIS_DESCR
/end CHARACTERISTIC
/begin AXIS_PTS AX_1B2874 "RE axis (code ptr, not OEM AXIS_PTS)" 0x1B2874 RL_IDENTITY 0 NO_INPUT_QUANTITY 1.0 4 FORMAT "%%5.0" /end AXIS_PTS
/begin AXIS_PTS AY_1AC814 "RE axis (code ptr, not OEM AXIS_PTS)" 0x1AC814 RL_IDENTITY 0 NO_INPUT_QUANTITY 1.0 4 FORMAT "%%5.0" /end AXIS_PTS
/begin CHARACTERISTIC M_lookup_ax_X_Y_1C77F4 "RE lookup family M_fam_0006 n=2" MAP 0x1C77F4 RL_IDENTITY 0 NO_INPUT_QUANTITY 1.0 FORMAT "%%5.0"
 /begin AXIS_DESCR COM_AXIS NO_INPUT_QUANTITY NO_COMPU_METHOD 4 AXIS_PTS_REF AX_1B2874 /end AXIS_DESCR
 /begin AXIS_DESCR COM_AXIS NO_INPUT_QUANTITY NO_COMPU_METHOD 4 AXIS_PTS_REF AY_1AC814 /end AXIS_DESCR
/end CHARACTERISTIC
/begin AXIS_PTS AX_1B7914 "RE axis (code ptr, not OEM AXIS_PTS)" 0x1B7914 RL_IDENTITY 0 NO_INPUT_QUANTITY 1.0 4 FORMAT "%%5.0" /end AXIS_PTS
/begin CHARACTERISTIC M_lookup_ax_X_Y_1C77F4 "RE lookup family M_fam_0001 n=3" MAP 0x1C77F4 RL_IDENTITY 0 NO_INPUT_QUANTITY 1.0 FORMAT "%%5.0"
 /begin AXIS_DESCR COM_AXIS NO_INPUT_QUANTITY NO_COMPU_METHOD 4 AXIS_PTS_REF AX_1B7914 /end AXIS_DESCR
 /begin AXIS_DESCR COM_AXIS NO_INPUT_QUANTITY NO_COMPU_METHOD 4 AXIS_PTS_REF AY_1AC814 /end AXIS_DESCR
/end CHARACTERISTIC
/end MODULE
/end PROJECT
