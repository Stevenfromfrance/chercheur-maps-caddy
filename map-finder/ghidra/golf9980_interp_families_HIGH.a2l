ASAP2_VERSION 1 60
/begin PROJECT PCR21_9980_RE "Reverse-engineered stub — NOT OEM A2L"
/begin MODULE PCR21_SM2G0P_9980 "Golf 03L997558A 9980; names from interp_2d families"
/* Generated by scan_interp_families.py. Do not treat IdNames as Siemens. */
/* Partial WinOLS JSON has ~299 maps; this file only HIGH clusters (n>=4). */
/begin AXIS_PTS AX_1AE848 "RE axis (code ptr, not OEM AXIS_PTS)" 0x1AE848 RL_IDENTITY 0 NO_INPUT_QUANTITY 1.0 4 FORMAT "%%5.0" /end AXIS_PTS
/begin AXIS_PTS AY_1AA974 "RE axis (code ptr, not OEM AXIS_PTS)" 0x1AA974 RL_IDENTITY 0 NO_INPUT_QUANTITY 1.0 32 FORMAT "%%5.0" /end AXIS_PTS
/begin CHARACTERISTIC lookup_ax_X_Y_1E8DB0 "RE lookup family fam_0003 n=4" MAP 0x1E8DB0 RL_IDENTITY 0 NO_INPUT_QUANTITY 1.0 FORMAT "%%5.0"
 /begin AXIS_DESCR COM_AXIS NO_INPUT_QUANTITY NO_COMPU_METHOD 4 AXIS_PTS_REF AX_1AE848 /end AXIS_DESCR
 /begin AXIS_DESCR COM_AXIS NO_INPUT_QUANTITY NO_COMPU_METHOD 32 AXIS_PTS_REF AY_1AA974 /end AXIS_DESCR
/end CHARACTERISTIC
/begin AXIS_PTS AX_1AA8E4 "RE axis (code ptr, not OEM AXIS_PTS)" 0x1AA8E4 RL_IDENTITY 0 NO_INPUT_QUANTITY 1.0 32 FORMAT "%%5.0" /end AXIS_PTS
/begin AXIS_PTS AY_1B3900 "RE axis (code ptr, not OEM AXIS_PTS)" 0x1B3900 RL_IDENTITY 0 NO_INPUT_QUANTITY 1.0 4 FORMAT "%%5.0" /end AXIS_PTS
/begin CHARACTERISTIC lookup_ax_X_Y_1CFFC0 "RE lookup family fam_0001 n=13" MAP 0x1CFFC0 RL_IDENTITY 0 NO_INPUT_QUANTITY 1.0 FORMAT "%%5.0"
 /begin AXIS_DESCR COM_AXIS NO_INPUT_QUANTITY NO_COMPU_METHOD 32 AXIS_PTS_REF AX_1AA8E4 /end AXIS_DESCR
 /begin AXIS_DESCR COM_AXIS NO_INPUT_QUANTITY NO_COMPU_METHOD 4 AXIS_PTS_REF AY_1B3900 /end AXIS_DESCR
/end CHARACTERISTIC
/begin CHARACTERISTIC lookup_D0002198_x_D000219A_1D7F80 "RE lookup family fam_0001 n=13" MAP 0x1D7F80 RL_IDENTITY 0 NO_INPUT_QUANTITY 1.0 FORMAT "%%5.0"
 /begin AXIS_DESCR COM_AXIS NO_INPUT_QUANTITY NO_COMPU_METHOD 32 AXIS_PTS_REF AX_1AA8E4 /end AXIS_DESCR
 /begin AXIS_DESCR COM_AXIS NO_INPUT_QUANTITY NO_COMPU_METHOD 4 AXIS_PTS_REF AY_1B3900 /end AXIS_DESCR
/end CHARACTERISTIC
/begin CHARACTERISTIC lookup_D0002198_x_D000219A_1CBF80 "RE lookup family fam_0001 n=13" MAP 0x1CBF80 RL_IDENTITY 0 NO_INPUT_QUANTITY 1.0 FORMAT "%%5.0"
 /begin AXIS_DESCR COM_AXIS NO_INPUT_QUANTITY NO_COMPU_METHOD 32 AXIS_PTS_REF AX_1AA8E4 /end AXIS_DESCR
 /begin AXIS_DESCR COM_AXIS NO_INPUT_QUANTITY NO_COMPU_METHOD 4 AXIS_PTS_REF AY_1B3900 /end AXIS_DESCR
/end CHARACTERISTIC
/begin CHARACTERISTIC lookup_D0002198_x_D000219A_1CFF80 "RE lookup family fam_0001 n=13" MAP 0x1CFF80 RL_IDENTITY 0 NO_INPUT_QUANTITY 1.0 FORMAT "%%5.0"
 /begin AXIS_DESCR COM_AXIS NO_INPUT_QUANTITY NO_COMPU_METHOD 32 AXIS_PTS_REF AX_1AA8E4 /end AXIS_DESCR
 /begin AXIS_DESCR COM_AXIS NO_INPUT_QUANTITY NO_COMPU_METHOD 4 AXIS_PTS_REF AY_1B3900 /end AXIS_DESCR
/end CHARACTERISTIC
/begin CHARACTERISTIC lookup_D0002198_x_D000219A_1D3FC0 "RE lookup family fam_0001 n=13" MAP 0x1D3FC0 RL_IDENTITY 0 NO_INPUT_QUANTITY 1.0 FORMAT "%%5.0"
 /begin AXIS_DESCR COM_AXIS NO_INPUT_QUANTITY NO_COMPU_METHOD 32 AXIS_PTS_REF AX_1AA8E4 /end AXIS_DESCR
 /begin AXIS_DESCR COM_AXIS NO_INPUT_QUANTITY NO_COMPU_METHOD 4 AXIS_PTS_REF AY_1B3900 /end AXIS_DESCR
/end CHARACTERISTIC
/begin CHARACTERISTIC lookup_D0002198_x_D000219A_1D7FC0 "RE lookup family fam_0001 n=13" MAP 0x1D7FC0 RL_IDENTITY 0 NO_INPUT_QUANTITY 1.0 FORMAT "%%5.0"
 /begin AXIS_DESCR COM_AXIS NO_INPUT_QUANTITY NO_COMPU_METHOD 32 AXIS_PTS_REF AX_1AA8E4 /end AXIS_DESCR
 /begin AXIS_DESCR COM_AXIS NO_INPUT_QUANTITY NO_COMPU_METHOD 4 AXIS_PTS_REF AY_1B3900 /end AXIS_DESCR
/end CHARACTERISTIC
/begin CHARACTERISTIC lookup_D0002198_x_D000219A_1CBFC0 "RE lookup family fam_0001 n=13" MAP 0x1CBFC0 RL_IDENTITY 0 NO_INPUT_QUANTITY 1.0 FORMAT "%%5.0"
 /begin AXIS_DESCR COM_AXIS NO_INPUT_QUANTITY NO_COMPU_METHOD 32 AXIS_PTS_REF AX_1AA8E4 /end AXIS_DESCR
 /begin AXIS_DESCR COM_AXIS NO_INPUT_QUANTITY NO_COMPU_METHOD 4 AXIS_PTS_REF AY_1B3900 /end AXIS_DESCR
/end CHARACTERISTIC
/begin AXIS_PTS AX_1AE8AC "RE axis (code ptr, not OEM AXIS_PTS)" 0x1AE8AC RL_IDENTITY 0 NO_INPUT_QUANTITY 1.0 4 FORMAT "%%5.0" /end AXIS_PTS
/begin AXIS_PTS AY_1B5978 "RE axis (code ptr, not OEM AXIS_PTS)" 0x1B5978 RL_IDENTITY 0 NO_INPUT_QUANTITY 1.0 4 FORMAT "%%5.0" /end AXIS_PTS
/begin CHARACTERISTIC lookup_ax_X_Y_1C3ABC "RE lookup family fam_0004 n=4" MAP 0x1C3ABC RL_IDENTITY 0 NO_INPUT_QUANTITY 1.0 FORMAT "%%5.0"
 /begin AXIS_DESCR COM_AXIS NO_INPUT_QUANTITY NO_COMPU_METHOD 4 AXIS_PTS_REF AX_1AE8AC /end AXIS_DESCR
 /begin AXIS_DESCR COM_AXIS NO_INPUT_QUANTITY NO_COMPU_METHOD 4 AXIS_PTS_REF AY_1B5978 /end AXIS_DESCR
/end CHARACTERISTIC
/begin CHARACTERISTIC lookup_ax_X_Y_1C4A50 "RE lookup family fam_0004 n=4" MAP 0x1C4A50 RL_IDENTITY 0 NO_INPUT_QUANTITY 1.0 FORMAT "%%5.0"
 /begin AXIS_DESCR COM_AXIS NO_INPUT_QUANTITY NO_COMPU_METHOD 4 AXIS_PTS_REF AX_1AE8AC /end AXIS_DESCR
 /begin AXIS_DESCR COM_AXIS NO_INPUT_QUANTITY NO_COMPU_METHOD 4 AXIS_PTS_REF AY_1B5978 /end AXIS_DESCR
/end CHARACTERISTIC
/begin AXIS_PTS AX_1A8864 "RE axis (code ptr, not OEM AXIS_PTS)" 0x1A8864 RL_IDENTITY 0 NO_INPUT_QUANTITY 1.0 4 FORMAT "%%5.0" /end AXIS_PTS
/begin AXIS_PTS AY_1AC87C "RE axis (code ptr, not OEM AXIS_PTS)" 0x1AC87C RL_IDENTITY 0 NO_INPUT_QUANTITY 1.0 4 FORMAT "%%5.0" /end AXIS_PTS
/begin CHARACTERISTIC lookup_ax_X_Y_1CBAE4 "RE lookup family fam_0002 n=4" MAP 0x1CBAE4 RL_IDENTITY 0 NO_INPUT_QUANTITY 1.0 FORMAT "%%5.0"
 /begin AXIS_DESCR COM_AXIS NO_INPUT_QUANTITY NO_COMPU_METHOD 4 AXIS_PTS_REF AX_1A8864 /end AXIS_DESCR
 /begin AXIS_DESCR COM_AXIS NO_INPUT_QUANTITY NO_COMPU_METHOD 4 AXIS_PTS_REF AY_1AC87C /end AXIS_DESCR
/end CHARACTERISTIC
/begin CHARACTERISTIC lookup_ax_X_Y_1C9AE4 "RE lookup family fam_0002 n=4" MAP 0x1C9AE4 RL_IDENTITY 0 NO_INPUT_QUANTITY 1.0 FORMAT "%%5.0"
 /begin AXIS_DESCR COM_AXIS NO_INPUT_QUANTITY NO_COMPU_METHOD 4 AXIS_PTS_REF AX_1A8864 /end AXIS_DESCR
 /begin AXIS_DESCR COM_AXIS NO_INPUT_QUANTITY NO_COMPU_METHOD 4 AXIS_PTS_REF AY_1AC87C /end AXIS_DESCR
/end CHARACTERISTIC
/begin CHARACTERISTIC lookup_ax_X_Y_1D7AE4 "RE lookup family fam_0002 n=4" MAP 0x1D7AE4 RL_IDENTITY 0 NO_INPUT_QUANTITY 1.0 FORMAT "%%5.0"
 /begin AXIS_DESCR COM_AXIS NO_INPUT_QUANTITY NO_COMPU_METHOD 4 AXIS_PTS_REF AX_1A8864 /end AXIS_DESCR
 /begin AXIS_DESCR COM_AXIS NO_INPUT_QUANTITY NO_COMPU_METHOD 4 AXIS_PTS_REF AY_1AC87C /end AXIS_DESCR
/end CHARACTERISTIC
/begin CHARACTERISTIC lookup_ax_X_Y_1D5AE4 "RE lookup family fam_0002 n=4" MAP 0x1D5AE4 RL_IDENTITY 0 NO_INPUT_QUANTITY 1.0 FORMAT "%%5.0"
 /begin AXIS_DESCR COM_AXIS NO_INPUT_QUANTITY NO_COMPU_METHOD 4 AXIS_PTS_REF AX_1A8864 /end AXIS_DESCR
 /begin AXIS_DESCR COM_AXIS NO_INPUT_QUANTITY NO_COMPU_METHOD 4 AXIS_PTS_REF AY_1AC87C /end AXIS_DESCR
/end CHARACTERISTIC
/end MODULE
/end PROJECT
