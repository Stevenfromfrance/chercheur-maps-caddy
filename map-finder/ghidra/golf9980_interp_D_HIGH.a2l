ASAP2_VERSION 1 60
/begin PROJECT PCR21_9980_RE "Reverse-engineered stub - NOT OEM A2L"
/begin MODULE PCR21_SM2G0P_9980 "Golf 03L997558A 9980; names from map_interp_D families"
/* Generated by scan_interp_families.py --hub map_interp_D. Do not treat IdNames as Siemens. */
/* HIGH clusters only (n>=4). */
/begin AXIS_PTS AX_1A2B64 "RE axis (code ptr, not OEM AXIS_PTS)" 0x1A2B64 RL_IDENTITY 0 NO_INPUT_QUANTITY 1.0 4 FORMAT "%%5.0" /end AXIS_PTS
/begin CHARACTERISTIC D_lookup_ax_X_Y_18D998 "RE curve family D_fam_0008 n=2" CURVE 0x18D998 RL_IDENTITY 0 NO_INPUT_QUANTITY 1.0 FORMAT "%%5.0"
 /begin AXIS_DESCR COM_AXIS NO_INPUT_QUANTITY NO_COMPU_METHOD 4 AXIS_PTS_REF AX_1A2B64 /end AXIS_DESCR
/end CHARACTERISTIC
/begin AXIS_PTS AX_1AB88C "RE axis (code ptr, not OEM AXIS_PTS)" 0x1AB88C RL_IDENTITY 0 NO_INPUT_QUANTITY 1.0 4 FORMAT "%%5.0" /end AXIS_PTS
/begin CHARACTERISTIC D_lookup_ax_X_Y_1D5ED8 "RE curve family D_fam_0009 n=2" CURVE 0x1D5ED8 RL_IDENTITY 0 NO_INPUT_QUANTITY 1.0 FORMAT "%%5.0"
 /begin AXIS_DESCR COM_AXIS NO_INPUT_QUANTITY NO_COMPU_METHOD 4 AXIS_PTS_REF AX_1AB88C /end AXIS_DESCR
/end CHARACTERISTIC
/begin AXIS_PTS AX_1B68FC "RE axis (code ptr, not OEM AXIS_PTS)" 0x1B68FC RL_IDENTITY 0 NO_INPUT_QUANTITY 1.0 4 FORMAT "%%5.0" /end AXIS_PTS
/begin CHARACTERISTIC D_lookup_ax_X_Y_1D6EE8 "RE curve family D_fam_0010 n=2" CURVE 0x1D6EE8 RL_IDENTITY 0 NO_INPUT_QUANTITY 1.0 FORMAT "%%5.0"
 /begin AXIS_DESCR COM_AXIS NO_INPUT_QUANTITY NO_COMPU_METHOD 4 AXIS_PTS_REF AX_1B68FC /end AXIS_DESCR
/end CHARACTERISTIC
/begin CHARACTERISTIC D_lookup_ax_X_Y_1D7ED0 "RE curve family D_fam_0010 n=2" CURVE 0x1D7ED0 RL_IDENTITY 0 NO_INPUT_QUANTITY 1.0 FORMAT "%%5.0"
 /begin AXIS_DESCR COM_AXIS NO_INPUT_QUANTITY NO_COMPU_METHOD 4 AXIS_PTS_REF AX_1B68FC /end AXIS_DESCR
/end CHARACTERISTIC
/begin AXIS_PTS AX_1A9904 "RE axis (code ptr, not OEM AXIS_PTS)" 0x1A9904 RL_IDENTITY 0 NO_INPUT_QUANTITY 1.0 4 FORMAT "%%5.0" /end AXIS_PTS
/begin AXIS_PTS AY_1B3938 "RE axis (code ptr, not OEM AXIS_PTS)" 0x1B3938 RL_IDENTITY 0 NO_INPUT_QUANTITY 1.0 4 FORMAT "%%5.0" /end AXIS_PTS
/begin CHARACTERISTIC D_lookup_ax_X_Y_1D19EC "RE lookup family D_fam_0005 n=2" MAP 0x1D19EC RL_IDENTITY 0 NO_INPUT_QUANTITY 1.0 FORMAT "%%5.0"
 /begin AXIS_DESCR COM_AXIS NO_INPUT_QUANTITY NO_COMPU_METHOD 4 AXIS_PTS_REF AX_1A9904 /end AXIS_DESCR
 /begin AXIS_DESCR COM_AXIS NO_INPUT_QUANTITY NO_COMPU_METHOD 4 AXIS_PTS_REF AY_1B3938 /end AXIS_DESCR
/end CHARACTERISTIC
/end MODULE
/end PROJECT
