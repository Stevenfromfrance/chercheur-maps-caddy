ASAP2_VERSION 1 60
/begin PROJECT PCR21_9980_RE "Reverse-engineered stub - NOT OEM A2L"
/begin MODULE PCR21_SM2G0P_9980 "Golf 03L997558A 9980; names from map_interp_E families"
/* Generated by scan_interp_families.py --hub map_interp_E. Do not treat IdNames as Siemens. */
/* HIGH clusters only (n>=4). */
/begin AXIS_PTS AX_1BC8F4 "RE axis (code ptr, not OEM AXIS_PTS)" 0x1BC8F4 RL_IDENTITY 0 NO_INPUT_QUANTITY 1.0 9 FORMAT "%%5.0" /end AXIS_PTS
/begin AXIS_PTS AY_1BD8C0 "RE axis (code ptr, not OEM AXIS_PTS)" 0x1BD8C0 RL_IDENTITY 0 NO_INPUT_QUANTITY 1.0 4 FORMAT "%%5.0" /end AXIS_PTS
/begin CHARACTERISTIC E_lookup_ax_X_Y_19C3E8 "RE lookup family E_fam_0001 n=4" MAP 0x19C3E8 RL_IDENTITY 0 NO_INPUT_QUANTITY 1.0 FORMAT "%%5.0"
 /begin AXIS_DESCR COM_AXIS NO_INPUT_QUANTITY NO_COMPU_METHOD 9 AXIS_PTS_REF AX_1BC8F4 /end AXIS_DESCR
 /begin AXIS_DESCR COM_AXIS NO_INPUT_QUANTITY NO_COMPU_METHOD 4 AXIS_PTS_REF AY_1BD8C0 /end AXIS_DESCR
/end CHARACTERISTIC
/begin AXIS_PTS AX_1B792C "RE axis (code ptr, not OEM AXIS_PTS)" 0x1B792C RL_IDENTITY 0 NO_INPUT_QUANTITY 1.0 4 FORMAT "%%5.0" /end AXIS_PTS
/begin CHARACTERISTIC E_lookup_ax_X_Y_1D332C "RE curve family E_fam_0010 n=2" CURVE 0x1D332C RL_IDENTITY 0 NO_INPUT_QUANTITY 1.0 FORMAT "%%5.0"
 /begin AXIS_DESCR COM_AXIS NO_INPUT_QUANTITY NO_COMPU_METHOD 4 AXIS_PTS_REF AX_1B792C /end AXIS_DESCR
/end CHARACTERISTIC
/begin CHARACTERISTIC E_lookup_ax_X_Y_1D333C "RE curve family E_fam_0010 n=2" CURVE 0x1D333C RL_IDENTITY 0 NO_INPUT_QUANTITY 1.0 FORMAT "%%5.0"
 /begin AXIS_DESCR COM_AXIS NO_INPUT_QUANTITY NO_COMPU_METHOD 4 AXIS_PTS_REF AX_1B792C /end AXIS_DESCR
/end CHARACTERISTIC
/begin AXIS_PTS AX_1AA908 "RE axis (code ptr, not OEM AXIS_PTS)" 0x1AA908 RL_IDENTITY 0 NO_INPUT_QUANTITY 1.0 32 FORMAT "%%5.0" /end AXIS_PTS
/begin AXIS_PTS AY_1B98B8 "RE axis (code ptr, not OEM AXIS_PTS)" 0x1B98B8 RL_IDENTITY 0 NO_INPUT_QUANTITY 1.0 4 FORMAT "%%5.0" /end AXIS_PTS
/begin CHARACTERISTIC E_lookup_ax_X_Y_1C7978 "RE lookup family E_fam_0005 n=2" MAP 0x1C7978 RL_IDENTITY 0 NO_INPUT_QUANTITY 1.0 FORMAT "%%5.0"
 /begin AXIS_DESCR COM_AXIS NO_INPUT_QUANTITY NO_COMPU_METHOD 32 AXIS_PTS_REF AX_1AA908 /end AXIS_DESCR
 /begin AXIS_DESCR COM_AXIS NO_INPUT_QUANTITY NO_COMPU_METHOD 4 AXIS_PTS_REF AY_1B98B8 /end AXIS_DESCR
/end CHARACTERISTIC
/begin AXIS_PTS AX_1A993C "RE axis (code ptr, not OEM AXIS_PTS)" 0x1A993C RL_IDENTITY 0 NO_INPUT_QUANTITY 1.0 4 FORMAT "%%5.0" /end AXIS_PTS
/begin CHARACTERISTIC E_lookup_ax_X_Y_1C7968 "RE curve family E_fam_0008 n=2" CURVE 0x1C7968 RL_IDENTITY 0 NO_INPUT_QUANTITY 1.0 FORMAT "%%5.0"
 /begin AXIS_DESCR COM_AXIS NO_INPUT_QUANTITY NO_COMPU_METHOD 4 AXIS_PTS_REF AX_1A993C /end AXIS_DESCR
/end CHARACTERISTIC
/begin AXIS_PTS AY_1B8958 "RE axis (code ptr, not OEM AXIS_PTS)" 0x1B8958 RL_IDENTITY 0 NO_INPUT_QUANTITY 1.0 4 FORMAT "%%5.0" /end AXIS_PTS
/begin CHARACTERISTIC E_lookup_ax_X_Y_1C08D8 "RE lookup family E_fam_0004 n=2" MAP 0x1C08D8 RL_IDENTITY 0 NO_INPUT_QUANTITY 1.0 FORMAT "%%5.0"
 /begin AXIS_DESCR COM_AXIS NO_INPUT_QUANTITY NO_COMPU_METHOD 32 AXIS_PTS_REF AX_1AA908 /end AXIS_DESCR
 /begin AXIS_DESCR COM_AXIS NO_INPUT_QUANTITY NO_COMPU_METHOD 4 AXIS_PTS_REF AY_1B8958 /end AXIS_DESCR
/end CHARACTERISTIC
/begin AXIS_PTS AX_1B4284 "RE axis (code ptr, not OEM AXIS_PTS)" 0x1B4284 RL_IDENTITY 0 NO_INPUT_QUANTITY 1.0 4 FORMAT "%%5.0" /end AXIS_PTS
/begin CHARACTERISTIC E_lookup_ax_X_Y_1C4988 "RE curve family E_fam_0009 n=2" CURVE 0x1C4988 RL_IDENTITY 0 NO_INPUT_QUANTITY 1.0 FORMAT "%%5.0"
 /begin AXIS_DESCR COM_AXIS NO_INPUT_QUANTITY NO_COMPU_METHOD 4 AXIS_PTS_REF AX_1B4284 /end AXIS_DESCR
/end CHARACTERISTIC
/end MODULE
/end PROJECT
