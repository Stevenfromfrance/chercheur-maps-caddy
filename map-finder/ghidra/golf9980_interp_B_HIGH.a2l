ASAP2_VERSION 1 60
/begin PROJECT PCR21_9980_RE "Reverse-engineered stub - NOT OEM A2L"
/begin MODULE PCR21_SM2G0P_9980 "Golf 03L997558A 9980; names from interp_2d_B families"
/* Generated by scan_interp_families.py --hub interp_2d_B. Do not treat IdNames as Siemens. */
/* HIGH clusters only (n>=4). */
/begin AXIS_PTS AX_1B4894 "RE axis (code ptr, not OEM AXIS_PTS)" 0x1B4894 RL_IDENTITY 0 NO_INPUT_QUANTITY 1.0 4 FORMAT "%%5.0" /end AXIS_PTS
/begin AXIS_PTS AY_1B2868 "RE axis (code ptr, not OEM AXIS_PTS)" 0x1B2868 RL_IDENTITY 0 NO_INPUT_QUANTITY 1.0 4 FORMAT "%%5.0" /end AXIS_PTS
/begin CHARACTERISTIC B_lookup_ax_X_Y_1D32CC "RE lookup family B_fam_0003 n=3" MAP 0x1D32CC RL_IDENTITY 0 NO_INPUT_QUANTITY 1.0 FORMAT "%%5.0"
 /begin AXIS_DESCR COM_AXIS NO_INPUT_QUANTITY NO_COMPU_METHOD 4 AXIS_PTS_REF AX_1B4894 /end AXIS_DESCR
 /begin AXIS_DESCR COM_AXIS NO_INPUT_QUANTITY NO_COMPU_METHOD 4 AXIS_PTS_REF AY_1B2868 /end AXIS_DESCR
/end CHARACTERISTIC
/begin CHARACTERISTIC B_lookup_ax_X_Y_1D12CC "RE lookup family B_fam_0003 n=3" MAP 0x1D12CC RL_IDENTITY 0 NO_INPUT_QUANTITY 1.0 FORMAT "%%5.0"
 /begin AXIS_DESCR COM_AXIS NO_INPUT_QUANTITY NO_COMPU_METHOD 4 AXIS_PTS_REF AX_1B4894 /end AXIS_DESCR
 /begin AXIS_DESCR COM_AXIS NO_INPUT_QUANTITY NO_COMPU_METHOD 4 AXIS_PTS_REF AY_1B2868 /end AXIS_DESCR
/end CHARACTERISTIC
/begin CHARACTERISTIC B_lookup_ax_X_Y_1D52EC "RE lookup family B_fam_0003 n=3" MAP 0x1D52EC RL_IDENTITY 0 NO_INPUT_QUANTITY 1.0 FORMAT "%%5.0"
 /begin AXIS_DESCR COM_AXIS NO_INPUT_QUANTITY NO_COMPU_METHOD 4 AXIS_PTS_REF AX_1B4894 /end AXIS_DESCR
 /begin AXIS_DESCR COM_AXIS NO_INPUT_QUANTITY NO_COMPU_METHOD 4 AXIS_PTS_REF AY_1B2868 /end AXIS_DESCR
/end CHARACTERISTIC
/begin AXIS_PTS AX_1A6614 "RE axis (code ptr, not OEM AXIS_PTS)" 0x1A6614 RL_IDENTITY 0 NO_INPUT_QUANTITY 1.0 4 FORMAT "%%5.0" /end AXIS_PTS
/begin CHARACTERISTIC B_lookup_D0002496_x_D0002494_1CE29C "RE curve family B_fam_0008 n=2" CURVE 0x1CE29C RL_IDENTITY 0 NO_INPUT_QUANTITY 1.0 FORMAT "%%5.0"
 /begin AXIS_DESCR COM_AXIS NO_INPUT_QUANTITY NO_COMPU_METHOD 4 AXIS_PTS_REF AX_1A6614 /end AXIS_DESCR
/end CHARACTERISTIC
/begin AXIS_PTS AX_1A3B74 "RE axis (code ptr, not OEM AXIS_PTS)" 0x1A3B74 RL_IDENTITY 0 NO_INPUT_QUANTITY 1.0 4 FORMAT "%%5.0" /end AXIS_PTS
/begin CHARACTERISTIC B_lookup_ax_X_Y_191B68 "RE curve family B_fam_0010 n=2" CURVE 0x191B68 RL_IDENTITY 0 NO_INPUT_QUANTITY 1.0 FORMAT "%%5.0"
 /begin AXIS_DESCR COM_AXIS NO_INPUT_QUANTITY NO_COMPU_METHOD 4 AXIS_PTS_REF AX_1A3B74 /end AXIS_DESCR
/end CHARACTERISTIC
/begin AXIS_PTS AX_1A88FC "RE axis (code ptr, not OEM AXIS_PTS)" 0x1A88FC RL_IDENTITY 0 NO_INPUT_QUANTITY 1.0 5 FORMAT "%%5.0" /end AXIS_PTS
/begin AXIS_PTS AY_1A8934 "RE axis (code ptr, not OEM AXIS_PTS)" 0x1A8934 RL_IDENTITY 0 NO_INPUT_QUANTITY 1.0 7 FORMAT "%%5.0" /end AXIS_PTS
/begin CHARACTERISTIC B_lookup_ax_X_Y_1CE2CC "RE lookup family B_fam_0002 n=3" MAP 0x1CE2CC RL_IDENTITY 0 NO_INPUT_QUANTITY 1.0 FORMAT "%%5.0"
 /begin AXIS_DESCR COM_AXIS NO_INPUT_QUANTITY NO_COMPU_METHOD 5 AXIS_PTS_REF AX_1A88FC /end AXIS_DESCR
 /begin AXIS_DESCR COM_AXIS NO_INPUT_QUANTITY NO_COMPU_METHOD 7 AXIS_PTS_REF AY_1A8934 /end AXIS_DESCR
/end CHARACTERISTIC
/begin CHARACTERISTIC B_lookup_ax_X_Y_1C92EC "RE lookup family B_fam_0002 n=3" MAP 0x1C92EC RL_IDENTITY 0 NO_INPUT_QUANTITY 1.0 FORMAT "%%5.0"
 /begin AXIS_DESCR COM_AXIS NO_INPUT_QUANTITY NO_COMPU_METHOD 5 AXIS_PTS_REF AX_1A88FC /end AXIS_DESCR
 /begin AXIS_DESCR COM_AXIS NO_INPUT_QUANTITY NO_COMPU_METHOD 7 AXIS_PTS_REF AY_1A8934 /end AXIS_DESCR
/end CHARACTERISTIC
/begin AXIS_PTS AX_1BB9C0 "RE axis (code ptr, not OEM AXIS_PTS)" 0x1BB9C0 RL_IDENTITY 0 NO_INPUT_QUANTITY 1.0 4 FORMAT "%%5.0" /end AXIS_PTS
/begin CHARACTERISTIC B_lookup_ax_X_Y_1D43B4 "RE curve family B_fam_0009 n=2" CURVE 0x1D43B4 RL_IDENTITY 0 NO_INPUT_QUANTITY 1.0 FORMAT "%%5.0"
 /begin AXIS_DESCR COM_AXIS NO_INPUT_QUANTITY NO_COMPU_METHOD 4 AXIS_PTS_REF AX_1BB9C0 /end AXIS_DESCR
/end CHARACTERISTIC
/begin AXIS_PTS AX_1A6710 "RE axis (code ptr, not OEM AXIS_PTS)" 0x1A6710 RL_IDENTITY 0 NO_INPUT_QUANTITY 1.0 9 FORMAT "%%5.0" /end AXIS_PTS
/begin AXIS_PTS AY_1AE940 "RE axis (code ptr, not OEM AXIS_PTS)" 0x1AE940 RL_IDENTITY 0 NO_INPUT_QUANTITY 1.0 4 FORMAT "%%5.0" /end AXIS_PTS
/begin CHARACTERISTIC B_lookup_ax_X_Y_1C37F4 "RE lookup family B_fam_0004 n=2" MAP 0x1C37F4 RL_IDENTITY 0 NO_INPUT_QUANTITY 1.0 FORMAT "%%5.0"
 /begin AXIS_DESCR COM_AXIS NO_INPUT_QUANTITY NO_COMPU_METHOD 9 AXIS_PTS_REF AX_1A6710 /end AXIS_DESCR
 /begin AXIS_DESCR COM_AXIS NO_INPUT_QUANTITY NO_COMPU_METHOD 4 AXIS_PTS_REF AY_1AE940 /end AXIS_DESCR
/end CHARACTERISTIC
/begin AXIS_PTS AX_1A6724 "RE axis (code ptr, not OEM AXIS_PTS)" 0x1A6724 RL_IDENTITY 0 NO_INPUT_QUANTITY 1.0 4 FORMAT "%%5.0" /end AXIS_PTS
/begin CHARACTERISTIC B_lookup_D00024C4_x_D0000000_1C57F4 "RE lookup family B_fam_0005 n=2" MAP 0x1C57F4 RL_IDENTITY 0 NO_INPUT_QUANTITY 1.0 FORMAT "%%5.0"
 /begin AXIS_DESCR COM_AXIS NO_INPUT_QUANTITY NO_COMPU_METHOD 4 AXIS_PTS_REF AX_1A6724 /end AXIS_DESCR
 /begin AXIS_DESCR COM_AXIS NO_INPUT_QUANTITY NO_COMPU_METHOD 4 AXIS_PTS_REF AY_1AE940 /end AXIS_DESCR
/end CHARACTERISTIC
/begin AXIS_PTS AX_1AA840 "RE axis (code ptr, not OEM AXIS_PTS)" 0x1AA840 RL_IDENTITY 0 NO_INPUT_QUANTITY 1.0 32 FORMAT "%%5.0" /end AXIS_PTS
/begin AXIS_PTS AY_1AD8DC "RE axis (code ptr, not OEM AXIS_PTS)" 0x1AD8DC RL_IDENTITY 0 NO_INPUT_QUANTITY 1.0 4 FORMAT "%%5.0" /end AXIS_PTS
/begin CHARACTERISTIC B_lookup_ax_X_Y_1CDE8C "RE lookup family B_fam_0006 n=2" MAP 0x1CDE8C RL_IDENTITY 0 NO_INPUT_QUANTITY 1.0 FORMAT "%%5.0"
 /begin AXIS_DESCR COM_AXIS NO_INPUT_QUANTITY NO_COMPU_METHOD 32 AXIS_PTS_REF AX_1AA840 /end AXIS_DESCR
 /begin AXIS_DESCR COM_AXIS NO_INPUT_QUANTITY NO_COMPU_METHOD 4 AXIS_PTS_REF AY_1AD8DC /end AXIS_DESCR
/end CHARACTERISTIC
/begin AXIS_PTS AX_1A91D0 "RE axis (code ptr, not OEM AXIS_PTS)" 0x1A91D0 RL_IDENTITY 0 NO_INPUT_QUANTITY 1.0 4 FORMAT "%%5.0" /end AXIS_PTS
/begin CHARACTERISTIC B_lookup_ax_X_Y_19B7C0 "RE curve family B_fam_0001 n=4" CURVE 0x19B7C0 RL_IDENTITY 0 NO_INPUT_QUANTITY 1.0 FORMAT "%%5.0"
 /begin AXIS_DESCR COM_AXIS NO_INPUT_QUANTITY NO_COMPU_METHOD 4 AXIS_PTS_REF AX_1A91D0 /end AXIS_DESCR
/end CHARACTERISTIC
/end MODULE
/end PROJECT
