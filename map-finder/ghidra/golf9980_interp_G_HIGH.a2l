ASAP2_VERSION 1 60
/begin PROJECT PCR21_9980_RE "Reverse-engineered stub - NOT OEM A2L"
/begin MODULE PCR21_SM2G0P_9980 "Golf 03L997558A 9980; names from map_interp_G families"
/* Generated by scan_interp_families.py --hub map_interp_G. Do not treat IdNames as Siemens. */
/* HIGH clusters only (n>=4). */
/begin AXIS_PTS AX_1A378C "RE axis (code ptr, not OEM AXIS_PTS)" 0x1A378C RL_IDENTITY 0 NO_INPUT_QUANTITY 1.0 4 FORMAT "%%5.0" /end AXIS_PTS
/begin CHARACTERISTIC G_lookup_ax_X_Y_19B568 "RE curve family G_fam_0009 n=2" CURVE 0x19B568 RL_IDENTITY 0 NO_INPUT_QUANTITY 1.0 FORMAT "%%5.0"
 /begin AXIS_DESCR COM_AXIS NO_INPUT_QUANTITY NO_COMPU_METHOD 4 AXIS_PTS_REF AX_1A378C /end AXIS_DESCR
/end CHARACTERISTIC
/begin AXIS_PTS AX_1A2720 "RE axis (code ptr, not OEM AXIS_PTS)" 0x1A2720 RL_IDENTITY 0 NO_INPUT_QUANTITY 1.0 4 FORMAT "%%5.0" /end AXIS_PTS
/begin CHARACTERISTIC G_lookup_ax_X_Y_1CB388 "RE curve family G_fam_0008 n=2" CURVE 0x1CB388 RL_IDENTITY 0 NO_INPUT_QUANTITY 1.0 FORMAT "%%5.0"
 /begin AXIS_DESCR COM_AXIS NO_INPUT_QUANTITY NO_COMPU_METHOD 4 AXIS_PTS_REF AX_1A2720 /end AXIS_DESCR
/end CHARACTERISTIC
/begin AXIS_PTS AX_1A77EC "RE axis (code ptr, not OEM AXIS_PTS)" 0x1A77EC RL_IDENTITY 0 NO_INPUT_QUANTITY 1.0 8 FORMAT "%%5.0" /end AXIS_PTS
/begin CHARACTERISTIC G_lookup_ax_X_Y_19E4C8 "RE curve family G_fam_0016 n=2" CURVE 0x19E4C8 RL_IDENTITY 0 NO_INPUT_QUANTITY 1.0 FORMAT "%%5.0"
 /begin AXIS_DESCR COM_AXIS NO_INPUT_QUANTITY NO_COMPU_METHOD 8 AXIS_PTS_REF AX_1A77EC /end AXIS_DESCR
/end CHARACTERISTIC
/begin AXIS_PTS AX_1BD8D8 "RE axis (code ptr, not OEM AXIS_PTS)" 0x1BD8D8 RL_IDENTITY 0 NO_INPUT_QUANTITY 1.0 4 FORMAT "%%5.0" /end AXIS_PTS
/begin CHARACTERISTIC G_lookup_ax_X_Y_1987C4 "RE curve family G_fam_0016 n=2" CURVE 0x1987C4 RL_IDENTITY 0 NO_INPUT_QUANTITY 1.0 FORMAT "%%5.0"
 /begin AXIS_DESCR COM_AXIS NO_INPUT_QUANTITY NO_COMPU_METHOD 4 AXIS_PTS_REF AX_1BD8D8 /end AXIS_DESCR
/end CHARACTERISTIC
/end MODULE
/end PROJECT
