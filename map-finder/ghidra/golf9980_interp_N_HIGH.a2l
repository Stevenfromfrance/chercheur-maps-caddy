ASAP2_VERSION 1 60
/begin PROJECT PCR21_9980_RE "Reverse-engineered stub - NOT OEM A2L"
/begin MODULE PCR21_SM2G0P_9980 "Golf 03L997558A 9980; names from map_interp_N families"
/* Generated by scan_interp_families.py --hub map_interp_N. Do not treat IdNames as Siemens. */
/* HIGH clusters only (n>=4). */
/begin AXIS_PTS AX_1AC868 "RE axis (code ptr, not OEM AXIS_PTS)" 0x1AC868 RL_IDENTITY 0 NO_INPUT_QUANTITY 1.0 4 FORMAT "%%5.0" /end AXIS_PTS
/begin AXIS_PTS AY_1BD8C0 "RE axis (code ptr, not OEM AXIS_PTS)" 0x1BD8C0 RL_IDENTITY 0 NO_INPUT_QUANTITY 1.0 4 FORMAT "%%5.0" /end AXIS_PTS
/begin CHARACTERISTIC N_lookup_ax_X_Y_19C3E8 "RE lookup family N_fam_0004 n=2" MAP 0x19C3E8 RL_IDENTITY 0 NO_INPUT_QUANTITY 1.0 FORMAT "%%5.0"
 /begin AXIS_DESCR COM_AXIS NO_INPUT_QUANTITY NO_COMPU_METHOD 4 AXIS_PTS_REF AX_1AC868 /end AXIS_DESCR
 /begin AXIS_DESCR COM_AXIS NO_INPUT_QUANTITY NO_COMPU_METHOD 4 AXIS_PTS_REF AY_1BD8C0 /end AXIS_DESCR
/end CHARACTERISTIC
/begin AXIS_PTS AX_1A3470 "RE axis (code ptr, not OEM AXIS_PTS)" 0x1A3470 RL_IDENTITY 0 NO_INPUT_QUANTITY 1.0 4 FORMAT "%%5.0" /end AXIS_PTS
/begin AXIS_PTS AY_1A7648 "RE axis (code ptr, not OEM AXIS_PTS)" 0x1A7648 RL_IDENTITY 0 NO_INPUT_QUANTITY 1.0 4 FORMAT "%%5.0" /end AXIS_PTS
/begin CHARACTERISTIC N_lookup_ax_X_Y_1C4918 "RE lookup family N_fam_0003 n=2" MAP 0x1C4918 RL_IDENTITY 0 NO_INPUT_QUANTITY 1.0 FORMAT "%%5.0"
 /begin AXIS_DESCR COM_AXIS NO_INPUT_QUANTITY NO_COMPU_METHOD 4 AXIS_PTS_REF AX_1A3470 /end AXIS_DESCR
 /begin AXIS_DESCR COM_AXIS NO_INPUT_QUANTITY NO_COMPU_METHOD 4 AXIS_PTS_REF AY_1A7648 /end AXIS_DESCR
/end CHARACTERISTIC
/end MODULE
/end PROJECT
