ASAP2_VERSION 1 60
/begin PROJECT PCR21_9980_RE "Reverse-engineered stub - NOT OEM A2L"
/begin MODULE PCR21_SM2G0P_9980 "Golf 03L997558A 9980; names from map_interp_O families"
/* Generated by scan_interp_families.py --hub map_interp_O. Do not treat IdNames as Siemens. */
/* HIGH clusters only (n>=4). */
/begin AXIS_PTS AX_1A8928 "RE axis (code ptr, not OEM AXIS_PTS)" 0x1A8928 RL_IDENTITY 0 NO_INPUT_QUANTITY 1.0 13 FORMAT "%%5.0" /end AXIS_PTS
/begin CHARACTERISTIC O_lookup_ax_X_Y_1CD000 "RE curve family O_fam_0004 n=2" CURVE 0x1CD000 RL_IDENTITY 0 NO_INPUT_QUANTITY 1.0 FORMAT "%%5.0"
 /begin AXIS_DESCR COM_AXIS NO_INPUT_QUANTITY NO_COMPU_METHOD 13 AXIS_PTS_REF AX_1A8928 /end AXIS_DESCR
/end CHARACTERISTIC
/begin CHARACTERISTIC O_lookup_ax_X_Y_1D5040 "RE curve family O_fam_0004 n=2" CURVE 0x1D5040 RL_IDENTITY 0 NO_INPUT_QUANTITY 1.0 FORMAT "%%5.0"
 /begin AXIS_DESCR COM_AXIS NO_INPUT_QUANTITY NO_COMPU_METHOD 13 AXIS_PTS_REF AX_1A8928 /end AXIS_DESCR
/end CHARACTERISTIC
/begin AXIS_PTS AX_1B1874 "RE axis (code ptr, not OEM AXIS_PTS)" 0x1B1874 RL_IDENTITY 0 NO_INPUT_QUANTITY 1.0 4 FORMAT "%%5.0" /end AXIS_PTS
/begin CHARACTERISTIC O_lookup_ax_X_Y_1C0AA4 "RE lookup family O_fam_0003 n=2" MAP 0x1C0AA4 RL_IDENTITY 0 NO_INPUT_QUANTITY 1.0 FORMAT "%%5.0"
 /begin AXIS_DESCR COM_AXIS NO_INPUT_QUANTITY NO_COMPU_METHOD 4 AXIS_PTS_REF AX_1B1874 /end AXIS_DESCR
 /begin AXIS_DESCR COM_AXIS NO_INPUT_QUANTITY NO_COMPU_METHOD 4 AXIS_PTS_REF AY_1B1874 /end AXIS_DESCR
/end CHARACTERISTIC
/begin CHARACTERISTIC O_lookup_ax_X_Y_1C0AE4 "RE lookup family O_fam_0003 n=2" MAP 0x1C0AE4 RL_IDENTITY 0 NO_INPUT_QUANTITY 1.0 FORMAT "%%5.0"
 /begin AXIS_DESCR COM_AXIS NO_INPUT_QUANTITY NO_COMPU_METHOD 4 AXIS_PTS_REF AX_1B1874 /end AXIS_DESCR
 /begin AXIS_DESCR COM_AXIS NO_INPUT_QUANTITY NO_COMPU_METHOD 4 AXIS_PTS_REF AY_1B1874 /end AXIS_DESCR
/end CHARACTERISTIC
/begin AXIS_PTS AX_1AAAC8 "RE axis (code ptr, not OEM AXIS_PTS)" 0x1AAAC8 RL_IDENTITY 0 NO_INPUT_QUANTITY 1.0 32 FORMAT "%%5.0" /end AXIS_PTS
/begin AXIS_PTS AY_1A9AC8 "RE axis (code ptr, not OEM AXIS_PTS)" 0x1A9AC8 RL_IDENTITY 0 NO_INPUT_QUANTITY 1.0 4 FORMAT "%%5.0" /end AXIS_PTS
/begin CHARACTERISTIC O_lookup_ax_X_Y_1C2A24 "RE lookup family O_fam_0001 n=2" MAP 0x1C2A24 RL_IDENTITY 0 NO_INPUT_QUANTITY 1.0 FORMAT "%%5.0"
 /begin AXIS_DESCR COM_AXIS NO_INPUT_QUANTITY NO_COMPU_METHOD 32 AXIS_PTS_REF AX_1AAAC8 /end AXIS_DESCR
 /begin AXIS_DESCR COM_AXIS NO_INPUT_QUANTITY NO_COMPU_METHOD 4 AXIS_PTS_REF AY_1A9AC8 /end AXIS_DESCR
/end CHARACTERISTIC
/begin AXIS_PTS AX_1AAAE8 "RE axis (code ptr, not OEM AXIS_PTS)" 0x1AAAE8 RL_IDENTITY 0 NO_INPUT_QUANTITY 1.0 32 FORMAT "%%5.0" /end AXIS_PTS
/begin AXIS_PTS AY_1A9AE8 "RE axis (code ptr, not OEM AXIS_PTS)" 0x1A9AE8 RL_IDENTITY 0 NO_INPUT_QUANTITY 1.0 4 FORMAT "%%5.0" /end AXIS_PTS
/begin CHARACTERISTIC O_lookup_ax_X_Y_1C5A04 "RE lookup family O_fam_0002 n=2" MAP 0x1C5A04 RL_IDENTITY 0 NO_INPUT_QUANTITY 1.0 FORMAT "%%5.0"
 /begin AXIS_DESCR COM_AXIS NO_INPUT_QUANTITY NO_COMPU_METHOD 32 AXIS_PTS_REF AX_1AAAE8 /end AXIS_DESCR
 /begin AXIS_DESCR COM_AXIS NO_INPUT_QUANTITY NO_COMPU_METHOD 4 AXIS_PTS_REF AY_1A9AE8 /end AXIS_DESCR
/end CHARACTERISTIC
/begin CHARACTERISTIC O_lookup_ax_X_Y_1C0A04 "RE lookup family O_fam_0002 n=2" MAP 0x1C0A04 RL_IDENTITY 0 NO_INPUT_QUANTITY 1.0 FORMAT "%%5.0"
 /begin AXIS_DESCR COM_AXIS NO_INPUT_QUANTITY NO_COMPU_METHOD 32 AXIS_PTS_REF AX_1AAAE8 /end AXIS_DESCR
 /begin AXIS_DESCR COM_AXIS NO_INPUT_QUANTITY NO_COMPU_METHOD 4 AXIS_PTS_REF AY_1A9AE8 /end AXIS_DESCR
/end CHARACTERISTIC
/end MODULE
/end PROJECT
