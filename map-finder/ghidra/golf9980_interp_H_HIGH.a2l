ASAP2_VERSION 1 60
/begin PROJECT PCR21_9980_RE "Reverse-engineered stub - NOT OEM A2L"
/begin MODULE PCR21_SM2G0P_9980 "Golf 03L997558A 9980; names from map_interp_H families"
/* Generated by scan_interp_families.py --hub map_interp_H. Do not treat IdNames as Siemens. */
/* HIGH clusters only (n>=4). */
/begin AXIS_PTS AX_1A7BE0 "RE axis (code ptr, not OEM AXIS_PTS)" 0x1A7BE0 RL_IDENTITY 0 NO_INPUT_QUANTITY 1.0 5 FORMAT "%%5.0" /end AXIS_PTS
/begin CHARACTERISTIC H_lookup_ax_X_Y_198BF8 "RE curve family H_fam_0011 n=2" CURVE 0x198BF8 RL_IDENTITY 0 NO_INPUT_QUANTITY 1.0 FORMAT "%%5.0"
 /begin AXIS_DESCR COM_AXIS NO_INPUT_QUANTITY NO_COMPU_METHOD 5 AXIS_PTS_REF AX_1A7BE0 /end AXIS_DESCR
/end CHARACTERISTIC
/begin CHARACTERISTIC H_lookup_ax_X_Y_199BC4 "RE curve family H_fam_0011 n=2" CURVE 0x199BC4 RL_IDENTITY 0 NO_INPUT_QUANTITY 1.0 FORMAT "%%5.0"
 /begin AXIS_DESCR COM_AXIS NO_INPUT_QUANTITY NO_COMPU_METHOD 5 AXIS_PTS_REF AX_1A7BE0 /end AXIS_DESCR
/end CHARACTERISTIC
/end MODULE
/end PROJECT
