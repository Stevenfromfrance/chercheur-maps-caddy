ASAP2_VERSION 1 60
/begin PROJECT PCR21_9980_RE "Reverse-engineered stub - NOT OEM A2L"
/begin MODULE PCR21_SM2G0P_9980 "Golf 03L997558A 9980; names from map_interp_I families"
/* Generated by scan_interp_families.py --hub map_interp_I. Do not treat IdNames as Siemens. */
/* HIGH clusters only (n>=4). */
/begin AXIS_PTS AX_1A2734 "RE axis (code ptr, not OEM AXIS_PTS)" 0x1A2734 RL_IDENTITY 0 NO_INPUT_QUANTITY 1.0 4 FORMAT "%%5.0" /end AXIS_PTS
/begin AXIS_PTS AY_1AD8D0 "RE axis (code ptr, not OEM AXIS_PTS)" 0x1AD8D0 RL_IDENTITY 0 NO_INPUT_QUANTITY 1.0 4 FORMAT "%%5.0" /end AXIS_PTS
/begin CHARACTERISTIC I_lookup_ax_X_Y_1CD9EC "RE lookup family I_fam_0002 n=2" MAP 0x1CD9EC RL_IDENTITY 0 NO_INPUT_QUANTITY 1.0 FORMAT "%%5.0"
 /begin AXIS_DESCR COM_AXIS NO_INPUT_QUANTITY NO_COMPU_METHOD 4 AXIS_PTS_REF AX_1A2734 /end AXIS_DESCR
 /begin AXIS_DESCR COM_AXIS NO_INPUT_QUANTITY NO_COMPU_METHOD 4 AXIS_PTS_REF AY_1AD8D0 /end AXIS_DESCR
/end CHARACTERISTIC
/begin CHARACTERISTIC I_lookup_ax_X_Y_1C89F0 "RE lookup family I_fam_0002 n=2" MAP 0x1C89F0 RL_IDENTITY 0 NO_INPUT_QUANTITY 1.0 FORMAT "%%5.0"
 /begin AXIS_DESCR COM_AXIS NO_INPUT_QUANTITY NO_COMPU_METHOD 4 AXIS_PTS_REF AX_1A2734 /end AXIS_DESCR
 /begin AXIS_DESCR COM_AXIS NO_INPUT_QUANTITY NO_COMPU_METHOD 4 AXIS_PTS_REF AY_1AD8D0 /end AXIS_DESCR
/end CHARACTERISTIC
/begin AXIS_PTS AX_1B7920 "RE axis (code ptr, not OEM AXIS_PTS)" 0x1B7920 RL_IDENTITY 0 NO_INPUT_QUANTITY 1.0 4 FORMAT "%%5.0" /end AXIS_PTS
/begin CHARACTERISTIC I_lookup_ax_X_Y_1C984C "RE curve family I_fam_0013 n=2" CURVE 0x1C984C RL_IDENTITY 0 NO_INPUT_QUANTITY 1.0 FORMAT "%%5.0"
 /begin AXIS_DESCR COM_AXIS NO_INPUT_QUANTITY NO_COMPU_METHOD 4 AXIS_PTS_REF AX_1B7920 /end AXIS_DESCR
/end CHARACTERISTIC
/begin CHARACTERISTIC I_lookup_ax_X_Y_1C887C "RE curve family I_fam_0013 n=2" CURVE 0x1C887C RL_IDENTITY 0 NO_INPUT_QUANTITY 1.0 FORMAT "%%5.0"
 /begin AXIS_DESCR COM_AXIS NO_INPUT_QUANTITY NO_COMPU_METHOD 4 AXIS_PTS_REF AX_1B7920 /end AXIS_DESCR
/end CHARACTERISTIC
/begin AXIS_PTS AX_1B0904 "RE axis (code ptr, not OEM AXIS_PTS)" 0x1B0904 RL_IDENTITY 0 NO_INPUT_QUANTITY 1.0 4 FORMAT "%%5.0" /end AXIS_PTS
/begin CHARACTERISTIC I_lookup_ax_X_Y_1D3EA8 "RE curve family I_fam_0012 n=2" CURVE 0x1D3EA8 RL_IDENTITY 0 NO_INPUT_QUANTITY 1.0 FORMAT "%%5.0"
 /begin AXIS_DESCR COM_AXIS NO_INPUT_QUANTITY NO_COMPU_METHOD 4 AXIS_PTS_REF AX_1B0904 /end AXIS_DESCR
/end CHARACTERISTIC
/begin CHARACTERISTIC I_lookup_ax_X_Y_1D3E9C "RE curve family I_fam_0012 n=2" CURVE 0x1D3E9C RL_IDENTITY 0 NO_INPUT_QUANTITY 1.0 FORMAT "%%5.0"
 /begin AXIS_DESCR COM_AXIS NO_INPUT_QUANTITY NO_COMPU_METHOD 4 AXIS_PTS_REF AX_1B0904 /end AXIS_DESCR
/end CHARACTERISTIC
/begin AXIS_PTS AX_1A6448 "RE axis (code ptr, not OEM AXIS_PTS)" 0x1A6448 RL_IDENTITY 0 NO_INPUT_QUANTITY 1.0 4 FORMAT "%%5.0" /end AXIS_PTS
/begin AXIS_PTS AY_1A9830 "RE axis (code ptr, not OEM AXIS_PTS)" 0x1A9830 RL_IDENTITY 0 NO_INPUT_QUANTITY 1.0 4 FORMAT "%%5.0" /end AXIS_PTS
/begin CHARACTERISTIC I_lookup_D0002FFA_x_D0002FD6_1D485C "RE lookup family I_fam_0003 n=2" MAP 0x1D485C RL_IDENTITY 0 NO_INPUT_QUANTITY 1.0 FORMAT "%%5.0"
 /begin AXIS_DESCR COM_AXIS NO_INPUT_QUANTITY NO_COMPU_METHOD 4 AXIS_PTS_REF AX_1A6448 /end AXIS_DESCR
 /begin AXIS_DESCR COM_AXIS NO_INPUT_QUANTITY NO_COMPU_METHOD 4 AXIS_PTS_REF AY_1A9830 /end AXIS_DESCR
/end CHARACTERISTIC
/begin AXIS_PTS AX_1A2B64 "RE axis (code ptr, not OEM AXIS_PTS)" 0x1A2B64 RL_IDENTITY 0 NO_INPUT_QUANTITY 1.0 4 FORMAT "%%5.0" /end AXIS_PTS
/begin CHARACTERISTIC I_lookup_ax_X_Y_195BC4 "RE curve family I_fam_0009 n=2" CURVE 0x195BC4 RL_IDENTITY 0 NO_INPUT_QUANTITY 1.0 FORMAT "%%5.0"
 /begin AXIS_DESCR COM_AXIS NO_INPUT_QUANTITY NO_COMPU_METHOD 4 AXIS_PTS_REF AX_1A2B64 /end AXIS_DESCR
/end CHARACTERISTIC
/begin AXIS_PTS AX_1A9904 "RE axis (code ptr, not OEM AXIS_PTS)" 0x1A9904 RL_IDENTITY 0 NO_INPUT_QUANTITY 1.0 4 FORMAT "%%5.0" /end AXIS_PTS
/begin AXIS_PTS AY_1B3938 "RE axis (code ptr, not OEM AXIS_PTS)" 0x1B3938 RL_IDENTITY 0 NO_INPUT_QUANTITY 1.0 4 FORMAT "%%5.0" /end AXIS_PTS
/begin CHARACTERISTIC I_lookup_ax_X_Y_1D19EC "RE lookup family I_fam_0006 n=2" MAP 0x1D19EC RL_IDENTITY 0 NO_INPUT_QUANTITY 1.0 FORMAT "%%5.0"
 /begin AXIS_DESCR COM_AXIS NO_INPUT_QUANTITY NO_COMPU_METHOD 4 AXIS_PTS_REF AX_1A9904 /end AXIS_DESCR
 /begin AXIS_DESCR COM_AXIS NO_INPUT_QUANTITY NO_COMPU_METHOD 4 AXIS_PTS_REF AY_1B3938 /end AXIS_DESCR
/end CHARACTERISTIC
/begin AXIS_PTS AX_1BC018 "RE axis (code ptr, not OEM AXIS_PTS)" 0x1BC018 RL_IDENTITY 0 NO_INPUT_QUANTITY 1.0 4 FORMAT "%%5.0" /end AXIS_PTS
/begin CHARACTERISTIC I_lookup_ax_X_Y_19C588 "RE curve family I_fam_0014 n=2" CURVE 0x19C588 RL_IDENTITY 0 NO_INPUT_QUANTITY 1.0 FORMAT "%%5.0"
 /begin AXIS_DESCR COM_AXIS NO_INPUT_QUANTITY NO_COMPU_METHOD 4 AXIS_PTS_REF AX_1BC018 /end AXIS_DESCR
/end CHARACTERISTIC
/begin AXIS_PTS AX_1B78E8 "RE axis (code ptr, not OEM AXIS_PTS)" 0x1B78E8 RL_IDENTITY 0 NO_INPUT_QUANTITY 1.0 4 FORMAT "%%5.0" /end AXIS_PTS
/begin CHARACTERISTIC I_lookup_ax_X_Y_1D70A0 "RE curve family I_fam_0001 n=3" CURVE 0x1D70A0 RL_IDENTITY 0 NO_INPUT_QUANTITY 1.0 FORMAT "%%5.0"
 /begin AXIS_DESCR COM_AXIS NO_INPUT_QUANTITY NO_COMPU_METHOD 4 AXIS_PTS_REF AX_1B78E8 /end AXIS_DESCR
/end CHARACTERISTIC
/begin CHARACTERISTIC I_lookup_ax_X_Y_1C80AC "RE curve family I_fam_0001 n=3" CURVE 0x1C80AC RL_IDENTITY 0 NO_INPUT_QUANTITY 1.0 FORMAT "%%5.0"
 /begin AXIS_DESCR COM_AXIS NO_INPUT_QUANTITY NO_COMPU_METHOD 4 AXIS_PTS_REF AX_1B78E8 /end AXIS_DESCR
/end CHARACTERISTIC
/begin CHARACTERISTIC I_lookup_ax_X_Y_1C9084 "RE curve family I_fam_0001 n=3" CURVE 0x1C9084 RL_IDENTITY 0 NO_INPUT_QUANTITY 1.0 FORMAT "%%5.0"
 /begin AXIS_DESCR COM_AXIS NO_INPUT_QUANTITY NO_COMPU_METHOD 4 AXIS_PTS_REF AX_1B78E8 /end AXIS_DESCR
/end CHARACTERISTIC
/end MODULE
/end PROJECT
