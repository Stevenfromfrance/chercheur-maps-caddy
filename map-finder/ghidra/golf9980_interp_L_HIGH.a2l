ASAP2_VERSION 1 60
/begin PROJECT PCR21_9980_RE "Reverse-engineered stub - NOT OEM A2L"
/begin MODULE PCR21_SM2G0P_9980 "Golf 03L997558A 9980; names from map_interp_L families"
/* Generated by scan_interp_families.py --hub map_interp_L. Do not treat IdNames as Siemens. */
/* HIGH clusters only (n>=4). */
/end MODULE
/end PROJECT
