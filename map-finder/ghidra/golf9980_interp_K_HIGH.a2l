ASAP2_VERSION 1 60
/begin PROJECT PCR21_9980_RE "Reverse-engineered stub - NOT OEM A2L"
/begin MODULE PCR21_SM2G0P_9980 "Golf 03L997558A 9980; names from map_interp_K families"
/* Generated by scan_interp_families.py --hub map_interp_K. Do not treat IdNames as Siemens. */
/* HIGH clusters only (n>=4). */
/begin AXIS_PTS AX_1A0B44 "RE axis (code ptr, not OEM AXIS_PTS)" 0x1A0B44 RL_IDENTITY 0 NO_INPUT_QUANTITY 1.0 4 FORMAT "%%5.0" /end AXIS_PTS
/begin CHARACTERISTIC K_lookup_ax_X_Y_196A98 "RE curve family K_fam_0002 n=2" CURVE 0x196A98 RL_IDENTITY 0 NO_INPUT_QUANTITY 1.0 FORMAT "%%5.0"
 /begin AXIS_DESCR COM_AXIS NO_INPUT_QUANTITY NO_COMPU_METHOD 4 AXIS_PTS_REF AX_1A0B44 /end AXIS_DESCR
/end CHARACTERISTIC
/begin AXIS_PTS AX_1A0B7C "RE axis (code ptr, not OEM AXIS_PTS)" 0x1A0B7C RL_IDENTITY 0 NO_INPUT_QUANTITY 1.0 4 FORMAT "%%5.0" /end AXIS_PTS
/begin CHARACTERISTIC K_lookup_ax_X_Y_197AA8 "RE curve family K_fam_0003 n=2" CURVE 0x197AA8 RL_IDENTITY 0 NO_INPUT_QUANTITY 1.0 FORMAT "%%5.0"
 /begin AXIS_DESCR COM_AXIS NO_INPUT_QUANTITY NO_COMPU_METHOD 4 AXIS_PTS_REF AX_1A0B7C /end AXIS_DESCR
/end CHARACTERISTIC
/end MODULE
/end PROJECT
