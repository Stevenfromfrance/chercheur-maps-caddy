ASAP2_VERSION 1 60
/begin PROJECT PCR21_9980_RE "Reverse-engineered stub - NOT OEM A2L"
/begin MODULE PCR21_SM2G0P_9980 "Golf 03L997558A 9980; names from map_interp_F families"
/* Generated by scan_interp_families.py --hub map_interp_F. Do not treat IdNames as Siemens. */
/* HIGH clusters only (n>=4). */
/begin AXIS_PTS AX_1AC908 "RE axis (code ptr, not OEM AXIS_PTS)" 0x1AC908 RL_IDENTITY 0 NO_INPUT_QUANTITY 1.0 4 FORMAT "%%5.0" /end AXIS_PTS
/begin AXIS_PTS AY_1A9C38 "RE axis (code ptr, not OEM AXIS_PTS)" 0x1A9C38 RL_IDENTITY 0 NO_INPUT_QUANTITY 1.0 4 FORMAT "%%5.0" /end AXIS_PTS
/begin CHARACTERISTIC F_lookup_ax_X_Y_1CE85C "RE lookup family F_fam_0014 n=2" MAP 0x1CE85C RL_IDENTITY 0 NO_INPUT_QUANTITY 1.0 FORMAT "%%5.0"
 /begin AXIS_DESCR COM_AXIS NO_INPUT_QUANTITY NO_COMPU_METHOD 4 AXIS_PTS_REF AX_1AC908 /end AXIS_DESCR
 /begin AXIS_DESCR COM_AXIS NO_INPUT_QUANTITY NO_COMPU_METHOD 4 AXIS_PTS_REF AY_1A9C38 /end AXIS_DESCR
/end CHARACTERISTIC
/begin AXIS_PTS AX_1AB924 "RE axis (code ptr, not OEM AXIS_PTS)" 0x1AB924 RL_IDENTITY 0 NO_INPUT_QUANTITY 1.0 4 FORMAT "%%5.0" /end AXIS_PTS
/begin AXIS_PTS AY_1B7C18 "RE axis (code ptr, not OEM AXIS_PTS)" 0x1B7C18 RL_IDENTITY 0 NO_INPUT_QUANTITY 1.0 4 FORMAT "%%5.0" /end AXIS_PTS
/begin CHARACTERISTIC F_lookup_ax_X_Y_1C985C "RE lookup family F_fam_0013 n=2" MAP 0x1C985C RL_IDENTITY 0 NO_INPUT_QUANTITY 1.0 FORMAT "%%5.0"
 /begin AXIS_DESCR COM_AXIS NO_INPUT_QUANTITY NO_COMPU_METHOD 4 AXIS_PTS_REF AX_1AB924 /end AXIS_DESCR
 /begin AXIS_DESCR COM_AXIS NO_INPUT_QUANTITY NO_COMPU_METHOD 4 AXIS_PTS_REF AY_1B7C18 /end AXIS_DESCR
/end CHARACTERISTIC
/begin AXIS_PTS AX_1B2868 "RE axis (code ptr, not OEM AXIS_PTS)" 0x1B2868 RL_IDENTITY 0 NO_INPUT_QUANTITY 1.0 4 FORMAT "%%5.0" /end AXIS_PTS
/begin AXIS_PTS AY_1BBAD8 "RE axis (code ptr, not OEM AXIS_PTS)" 0x1BBAD8 RL_IDENTITY 0 NO_INPUT_QUANTITY 1.0 4 FORMAT "%%5.0" /end AXIS_PTS
/begin CHARACTERISTIC F_lookup_ax_X_Y_1CEE94 "RE lookup family F_fam_0018 n=2" MAP 0x1CEE94 RL_IDENTITY 0 NO_INPUT_QUANTITY 1.0 FORMAT "%%5.0"
 /begin AXIS_DESCR COM_AXIS NO_INPUT_QUANTITY NO_COMPU_METHOD 4 AXIS_PTS_REF AX_1B2868 /end AXIS_DESCR
 /begin AXIS_DESCR COM_AXIS NO_INPUT_QUANTITY NO_COMPU_METHOD 4 AXIS_PTS_REF AY_1BBAD8 /end AXIS_DESCR
/end CHARACTERISTIC
/begin AXIS_PTS AX_1A145C "RE axis (code ptr, not OEM AXIS_PTS)" 0x1A145C RL_IDENTITY 0 NO_INPUT_QUANTITY 1.0 4 FORMAT "%%5.0" /end AXIS_PTS
/begin AXIS_PTS AY_1B3208 "RE axis (code ptr, not OEM AXIS_PTS)" 0x1B3208 RL_IDENTITY 0 NO_INPUT_QUANTITY 1.0 4 FORMAT "%%5.0" /end AXIS_PTS
/begin CHARACTERISTIC F_lookup_ax_X_Y_198440 "RE lookup family F_fam_0004 n=2" MAP 0x198440 RL_IDENTITY 0 NO_INPUT_QUANTITY 1.0 FORMAT "%%5.0"
 /begin AXIS_DESCR COM_AXIS NO_INPUT_QUANTITY NO_COMPU_METHOD 4 AXIS_PTS_REF AX_1A145C /end AXIS_DESCR
 /begin AXIS_DESCR COM_AXIS NO_INPUT_QUANTITY NO_COMPU_METHOD 4 AXIS_PTS_REF AY_1B3208 /end AXIS_DESCR
/end CHARACTERISTIC
/begin CHARACTERISTIC F_lookup_ax_X_Y_198450 "RE lookup family F_fam_0004 n=2" MAP 0x198450 RL_IDENTITY 0 NO_INPUT_QUANTITY 1.0 FORMAT "%%5.0"
 /begin AXIS_DESCR COM_AXIS NO_INPUT_QUANTITY NO_COMPU_METHOD 4 AXIS_PTS_REF AX_1A145C /end AXIS_DESCR
 /begin AXIS_DESCR COM_AXIS NO_INPUT_QUANTITY NO_COMPU_METHOD 4 AXIS_PTS_REF AY_1B3208 /end AXIS_DESCR
/end CHARACTERISTIC
/begin AXIS_PTS AX_1A0448 "RE axis (code ptr, not OEM AXIS_PTS)" 0x1A0448 RL_IDENTITY 0 NO_INPUT_QUANTITY 1.0 4 FORMAT "%%5.0" /end AXIS_PTS
/begin AXIS_PTS AY_1B0238 "RE axis (code ptr, not OEM AXIS_PTS)" 0x1B0238 RL_IDENTITY 0 NO_INPUT_QUANTITY 1.0 4 FORMAT "%%5.0" /end AXIS_PTS
/begin CHARACTERISTIC F_lookup_ax_X_Y_19F414 "RE lookup family F_fam_0003 n=2" MAP 0x19F414 RL_IDENTITY 0 NO_INPUT_QUANTITY 1.0 FORMAT "%%5.0"
 /begin AXIS_DESCR COM_AXIS NO_INPUT_QUANTITY NO_COMPU_METHOD 4 AXIS_PTS_REF AX_1A0448 /end AXIS_DESCR
 /begin AXIS_DESCR COM_AXIS NO_INPUT_QUANTITY NO_COMPU_METHOD 4 AXIS_PTS_REF AY_1B0238 /end AXIS_DESCR
/end CHARACTERISTIC
/begin CHARACTERISTIC F_lookup_ax_X_Y_19F424 "RE lookup family F_fam_0003 n=2" MAP 0x19F424 RL_IDENTITY 0 NO_INPUT_QUANTITY 1.0 FORMAT "%%5.0"
 /begin AXIS_DESCR COM_AXIS NO_INPUT_QUANTITY NO_COMPU_METHOD 4 AXIS_PTS_REF AX_1A0448 /end AXIS_DESCR
 /begin AXIS_DESCR COM_AXIS NO_INPUT_QUANTITY NO_COMPU_METHOD 4 AXIS_PTS_REF AY_1B0238 /end AXIS_DESCR
/end CHARACTERISTIC
/begin AXIS_PTS AX_1A0B44 "RE axis (code ptr, not OEM AXIS_PTS)" 0x1A0B44 RL_IDENTITY 0 NO_INPUT_QUANTITY 1.0 4 FORMAT "%%5.0" /end AXIS_PTS
/begin CHARACTERISTIC F_lookup_ax_X_Y_188B10 "RE curve family F_fam_0027 n=2" CURVE 0x188B10 RL_IDENTITY 0 NO_INPUT_QUANTITY 1.0 FORMAT "%%5.0"
 /begin AXIS_DESCR COM_AXIS NO_INPUT_QUANTITY NO_COMPU_METHOD 4 AXIS_PTS_REF AX_1A0B44 /end AXIS_DESCR
/end CHARACTERISTIC
/begin AXIS_PTS AX_1A0B7C "RE axis (code ptr, not OEM AXIS_PTS)" 0x1A0B7C RL_IDENTITY 0 NO_INPUT_QUANTITY 1.0 4 FORMAT "%%5.0" /end AXIS_PTS
/begin CHARACTERISTIC F_lookup_ax_X_Y_188B3C "RE curve family F_fam_0028 n=2" CURVE 0x188B3C RL_IDENTITY 0 NO_INPUT_QUANTITY 1.0 FORMAT "%%5.0"
 /begin AXIS_DESCR COM_AXIS NO_INPUT_QUANTITY NO_COMPU_METHOD 4 AXIS_PTS_REF AX_1A0B7C /end AXIS_DESCR
/end CHARACTERISTIC
/begin AXIS_PTS AX_1A2B64 "RE axis (code ptr, not OEM AXIS_PTS)" 0x1A2B64 RL_IDENTITY 0 NO_INPUT_QUANTITY 1.0 4 FORMAT "%%5.0" /end AXIS_PTS
/begin CHARACTERISTIC F_lookup_ax_X_Y_18AB0C "RE curve family F_fam_0029 n=2" CURVE 0x18AB0C RL_IDENTITY 0 NO_INPUT_QUANTITY 1.0 FORMAT "%%5.0"
 /begin AXIS_DESCR COM_AXIS NO_INPUT_QUANTITY NO_COMPU_METHOD 4 AXIS_PTS_REF AX_1A2B64 /end AXIS_DESCR
/end CHARACTERISTIC
/begin AXIS_PTS AX_1A565C "RE axis (code ptr, not OEM AXIS_PTS)" 0x1A565C RL_IDENTITY 0 NO_INPUT_QUANTITY 1.0 4 FORMAT "%%5.0" /end AXIS_PTS
/begin AXIS_PTS AY_1A6660 "RE axis (code ptr, not OEM AXIS_PTS)" 0x1A6660 RL_IDENTITY 0 NO_INPUT_QUANTITY 1.0 5 FORMAT "%%5.0" /end AXIS_PTS
/begin CHARACTERISTIC F_lookup_ax_X_Y_1CF39C "RE lookup family F_fam_0007 n=2" MAP 0x1CF39C RL_IDENTITY 0 NO_INPUT_QUANTITY 1.0 FORMAT "%%5.0"
 /begin AXIS_DESCR COM_AXIS NO_INPUT_QUANTITY NO_COMPU_METHOD 4 AXIS_PTS_REF AX_1A565C /end AXIS_DESCR
 /begin AXIS_DESCR COM_AXIS NO_INPUT_QUANTITY NO_COMPU_METHOD 5 AXIS_PTS_REF AY_1A6660 /end AXIS_DESCR
/end CHARACTERISTIC
/begin AXIS_PTS AX_1AC940 "RE axis (code ptr, not OEM AXIS_PTS)" 0x1AC940 RL_IDENTITY 0 NO_INPUT_QUANTITY 1.0 4 FORMAT "%%5.0" /end AXIS_PTS
/begin AXIS_PTS AY_1AC85C "RE axis (code ptr, not OEM AXIS_PTS)" 0x1AC85C RL_IDENTITY 0 NO_INPUT_QUANTITY 1.0 4 FORMAT "%%5.0" /end AXIS_PTS
/begin CHARACTERISTIC F_lookup_ax_X_Y_1CE97C "RE lookup family F_fam_0015 n=2" MAP 0x1CE97C RL_IDENTITY 0 NO_INPUT_QUANTITY 1.0 FORMAT "%%5.0"
 /begin AXIS_DESCR COM_AXIS NO_INPUT_QUANTITY NO_COMPU_METHOD 4 AXIS_PTS_REF AX_1AC940 /end AXIS_DESCR
 /begin AXIS_DESCR COM_AXIS NO_INPUT_QUANTITY NO_COMPU_METHOD 4 AXIS_PTS_REF AY_1AC85C /end AXIS_DESCR
/end CHARACTERISTIC
/begin AXIS_PTS AX_1A2720 "RE axis (code ptr, not OEM AXIS_PTS)" 0x1A2720 RL_IDENTITY 0 NO_INPUT_QUANTITY 1.0 4 FORMAT "%%5.0" /end AXIS_PTS
/begin CHARACTERISTIC F_lookup_ax_X_Y_1CB388 "RE curve family F_fam_0002 n=3" CURVE 0x1CB388 RL_IDENTITY 0 NO_INPUT_QUANTITY 1.0 FORMAT "%%5.0"
 /begin AXIS_DESCR COM_AXIS NO_INPUT_QUANTITY NO_COMPU_METHOD 4 AXIS_PTS_REF AX_1A2720 /end AXIS_DESCR
/end CHARACTERISTIC
/begin AXIS_PTS AX_1B58D4 "RE axis (code ptr, not OEM AXIS_PTS)" 0x1B58D4 RL_IDENTITY 0 NO_INPUT_QUANTITY 1.0 4 FORMAT "%%5.0" /end AXIS_PTS
/begin AXIS_PTS AY_1AA95C "RE axis (code ptr, not OEM AXIS_PTS)" 0x1AA95C RL_IDENTITY 0 NO_INPUT_QUANTITY 1.0 32 FORMAT "%%5.0" /end AXIS_PTS
/begin CHARACTERISTIC F_lookup_ax_X_Y_1D4F98 "RE lookup family F_fam_0019 n=2" MAP 0x1D4F98 RL_IDENTITY 0 NO_INPUT_QUANTITY 1.0 FORMAT "%%5.0"
 /begin AXIS_DESCR COM_AXIS NO_INPUT_QUANTITY NO_COMPU_METHOD 4 AXIS_PTS_REF AX_1B58D4 /end AXIS_DESCR
 /begin AXIS_DESCR COM_AXIS NO_INPUT_QUANTITY NO_COMPU_METHOD 32 AXIS_PTS_REF AY_1AA95C /end AXIS_DESCR
/end CHARACTERISTIC
/begin CHARACTERISTIC F_lookup_ax_X_Y_1D2FA0 "RE lookup family F_fam_0019 n=2" MAP 0x1D2FA0 RL_IDENTITY 0 NO_INPUT_QUANTITY 1.0 FORMAT "%%5.0"
 /begin AXIS_DESCR COM_AXIS NO_INPUT_QUANTITY NO_COMPU_METHOD 4 AXIS_PTS_REF AX_1B58D4 /end AXIS_DESCR
 /begin AXIS_DESCR COM_AXIS NO_INPUT_QUANTITY NO_COMPU_METHOD 32 AXIS_PTS_REF AY_1AA95C /end AXIS_DESCR
/end CHARACTERISTIC
/begin AXIS_PTS AX_1A577C "RE axis (code ptr, not OEM AXIS_PTS)" 0x1A577C RL_IDENTITY 0 NO_INPUT_QUANTITY 1.0 4 FORMAT "%%5.0" /end AXIS_PTS
/begin AXIS_PTS AY_1AA67C "RE axis (code ptr, not OEM AXIS_PTS)" 0x1AA67C RL_IDENTITY 0 NO_INPUT_QUANTITY 1.0 4 FORMAT "%%5.0" /end AXIS_PTS
/begin CHARACTERISTIC F_lookup_ax_X_Y_198558 "RE lookup family F_fam_0008 n=2" MAP 0x198558 RL_IDENTITY 0 NO_INPUT_QUANTITY 1.0 FORMAT "%%5.0"
 /begin AXIS_DESCR COM_AXIS NO_INPUT_QUANTITY NO_COMPU_METHOD 4 AXIS_PTS_REF AX_1A577C /end AXIS_DESCR
 /begin AXIS_DESCR COM_AXIS NO_INPUT_QUANTITY NO_COMPU_METHOD 4 AXIS_PTS_REF AY_1AA67C /end AXIS_DESCR
/end CHARACTERISTIC
/begin AXIS_PTS AX_1A67A8 "RE axis (code ptr, not OEM AXIS_PTS)" 0x1A67A8 RL_IDENTITY 0 NO_INPUT_QUANTITY 1.0 6 FORMAT "%%5.0" /end AXIS_PTS
/begin CHARACTERISTIC F_lookup_ax_X_Y_1C4DD8 "RE curve family F_fam_0020 n=2" CURVE 0x1C4DD8 RL_IDENTITY 0 NO_INPUT_QUANTITY 1.0 FORMAT "%%5.0"
 /begin AXIS_DESCR COM_AXIS NO_INPUT_QUANTITY NO_COMPU_METHOD 6 AXIS_PTS_REF AX_1A67A8 /end AXIS_DESCR
/end CHARACTERISTIC
/begin AXIS_PTS AX_1A8864 "RE axis (code ptr, not OEM AXIS_PTS)" 0x1A8864 RL_IDENTITY 0 NO_INPUT_QUANTITY 1.0 4 FORMAT "%%5.0" /end AXIS_PTS
/begin AXIS_PTS AY_1AC87C "RE axis (code ptr, not OEM AXIS_PTS)" 0x1AC87C RL_IDENTITY 0 NO_INPUT_QUANTITY 1.0 4 FORMAT "%%5.0" /end AXIS_PTS
/begin CHARACTERISTIC F_lookup_ax_X_Y_1CDAE4 "RE lookup family F_fam_0009 n=2" MAP 0x1CDAE4 RL_IDENTITY 0 NO_INPUT_QUANTITY 1.0 FORMAT "%%5.0"
 /begin AXIS_DESCR COM_AXIS NO_INPUT_QUANTITY NO_COMPU_METHOD 4 AXIS_PTS_REF AX_1A8864 /end AXIS_DESCR
 /begin AXIS_DESCR COM_AXIS NO_INPUT_QUANTITY NO_COMPU_METHOD 4 AXIS_PTS_REF AY_1AC87C /end AXIS_DESCR
/end CHARACTERISTIC
/begin CHARACTERISTIC F_lookup_ax_X_Y_1CFAE4 "RE lookup family F_fam_0009 n=2" MAP 0x1CFAE4 RL_IDENTITY 0 NO_INPUT_QUANTITY 1.0 FORMAT "%%5.0"
 /begin AXIS_DESCR COM_AXIS NO_INPUT_QUANTITY NO_COMPU_METHOD 4 AXIS_PTS_REF AX_1A8864 /end AXIS_DESCR
 /begin AXIS_DESCR COM_AXIS NO_INPUT_QUANTITY NO_COMPU_METHOD 4 AXIS_PTS_REF AY_1AC87C /end AXIS_DESCR
/end CHARACTERISTIC
/begin AXIS_PTS AX_1AC820 "RE axis (code ptr, not OEM AXIS_PTS)" 0x1AC820 RL_IDENTITY 0 NO_INPUT_QUANTITY 1.0 4 FORMAT "%%5.0" /end AXIS_PTS
/begin CHARACTERISTIC F_lookup_ax_X_Y_19A644 "RE curve family F_fam_0021 n=2" CURVE 0x19A644 RL_IDENTITY 0 NO_INPUT_QUANTITY 1.0 FORMAT "%%5.0"
 /begin AXIS_DESCR COM_AXIS NO_INPUT_QUANTITY NO_COMPU_METHOD 4 AXIS_PTS_REF AX_1AC820 /end AXIS_DESCR
/end CHARACTERISTIC
/begin AXIS_PTS AX_1AA898 "RE axis (code ptr, not OEM AXIS_PTS)" 0x1AA898 RL_IDENTITY 0 NO_INPUT_QUANTITY 1.0 32 FORMAT "%%5.0" /end AXIS_PTS
/begin AXIS_PTS AY_1A666C "RE axis (code ptr, not OEM AXIS_PTS)" 0x1A666C RL_IDENTITY 0 NO_INPUT_QUANTITY 1.0 11 FORMAT "%%5.0" /end AXIS_PTS
/begin CHARACTERISTIC F_lookup_ax_X_Y_1C3890 "RE lookup family F_fam_0012 n=2" MAP 0x1C3890 RL_IDENTITY 0 NO_INPUT_QUANTITY 1.0 FORMAT "%%5.0"
 /begin AXIS_DESCR COM_AXIS NO_INPUT_QUANTITY NO_COMPU_METHOD 32 AXIS_PTS_REF AX_1AA898 /end AXIS_DESCR
 /begin AXIS_DESCR COM_AXIS NO_INPUT_QUANTITY NO_COMPU_METHOD 11 AXIS_PTS_REF AY_1A666C /end AXIS_DESCR
/end CHARACTERISTIC
/begin CHARACTERISTIC F_lookup_ax_X_Y_1C4898 "RE lookup family F_fam_0012 n=2" MAP 0x1C4898 RL_IDENTITY 0 NO_INPUT_QUANTITY 1.0 FORMAT "%%5.0"
 /begin AXIS_DESCR COM_AXIS NO_INPUT_QUANTITY NO_COMPU_METHOD 32 AXIS_PTS_REF AX_1AA898 /end AXIS_DESCR
 /begin AXIS_DESCR COM_AXIS NO_INPUT_QUANTITY NO_COMPU_METHOD 11 AXIS_PTS_REF AY_1A666C /end AXIS_DESCR
/end CHARACTERISTIC
/begin AXIS_PTS AX_1ACEB4 "RE axis (code ptr, not OEM AXIS_PTS)" 0x1ACEB4 RL_IDENTITY 0 NO_INPUT_QUANTITY 1.0 4 FORMAT "%%5.0" /end AXIS_PTS
/begin CHARACTERISTIC F_lookup_ax_X_Y_19A728 "RE curve family F_fam_0022 n=2" CURVE 0x19A728 RL_IDENTITY 0 NO_INPUT_QUANTITY 1.0 FORMAT "%%5.0"
 /begin AXIS_DESCR COM_AXIS NO_INPUT_QUANTITY NO_COMPU_METHOD 4 AXIS_PTS_REF AX_1ACEB4 /end AXIS_DESCR
/end CHARACTERISTIC
/begin AXIS_PTS AX_1A9804 "RE axis (code ptr, not OEM AXIS_PTS)" 0x1A9804 RL_IDENTITY 0 NO_INPUT_QUANTITY 1.0 4 FORMAT "%%5.0" /end AXIS_PTS
/begin AXIS_PTS AY_1AD920 "RE axis (code ptr, not OEM AXIS_PTS)" 0x1AD920 RL_IDENTITY 0 NO_INPUT_QUANTITY 1.0 4 FORMAT "%%5.0" /end AXIS_PTS
/begin CHARACTERISTIC F_lookup_ax_X_Y_19C3C0 "RE lookup family F_fam_0010 n=2" MAP 0x19C3C0 RL_IDENTITY 0 NO_INPUT_QUANTITY 1.0 FORMAT "%%5.0"
 /begin AXIS_DESCR COM_AXIS NO_INPUT_QUANTITY NO_COMPU_METHOD 4 AXIS_PTS_REF AX_1A9804 /end AXIS_DESCR
 /begin AXIS_DESCR COM_AXIS NO_INPUT_QUANTITY NO_COMPU_METHOD 4 AXIS_PTS_REF AY_1AD920 /end AXIS_DESCR
/end CHARACTERISTIC
/begin AXIS_PTS AX_1AE888 "RE axis (code ptr, not OEM AXIS_PTS)" 0x1AE888 RL_IDENTITY 0 NO_INPUT_QUANTITY 1.0 4 FORMAT "%%5.0" /end AXIS_PTS
/begin AXIS_PTS AY_1A64E4 "RE axis (code ptr, not OEM AXIS_PTS)" 0x1A64E4 RL_IDENTITY 0 NO_INPUT_QUANTITY 1.0 4 FORMAT "%%5.0" /end AXIS_PTS
/begin CHARACTERISTIC F_lookup_ax_X_Y_1C2754 "RE lookup family F_fam_0016 n=2" MAP 0x1C2754 RL_IDENTITY 0 NO_INPUT_QUANTITY 1.0 FORMAT "%%5.0"
 /begin AXIS_DESCR COM_AXIS NO_INPUT_QUANTITY NO_COMPU_METHOD 4 AXIS_PTS_REF AX_1AE888 /end AXIS_DESCR
 /begin AXIS_DESCR COM_AXIS NO_INPUT_QUANTITY NO_COMPU_METHOD 4 AXIS_PTS_REF AY_1A64E4 /end AXIS_DESCR
/end CHARACTERISTIC
/end MODULE
/end PROJECT
