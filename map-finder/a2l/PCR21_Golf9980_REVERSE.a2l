ASAP2_VERSION 1 60
/begin PROJECT PCR21_Golf9980_REVERSE "RE PCR2.1 9980 SM2G0P - NOT OEM"
/begin MODULE PCR21_SM2G0P_9980 "Golf 03L997558A SW9980; reverse draft"
/* AXIS_PTS 0x17A570 count=? (unknown_use_2) - values not dumped */
/begin AXIS_PTS AX_17A570 "RE axis ptr not OEM" 0x17A570 RL_IDENTITY 0 NO_INPUT_QUANTITY 1.0 2 FORMAT "%%5.0" /end AXIS_PTS
/* AXIS_PTS 0x17B558 count=? (unknown_use_2) - values not dumped */
/begin AXIS_PTS AX_17B558 "RE axis ptr not OEM" 0x17B558 RL_IDENTITY 0 NO_INPUT_QUANTITY 1.0 2 FORMAT "%%5.0" /end AXIS_PTS
/* AXIS_PTS 0x181484 count=? (unknown_use_2) - values not dumped */
/begin AXIS_PTS AX_181484 "RE axis ptr not OEM" 0x181484 RL_IDENTITY 0 NO_INPUT_QUANTITY 1.0 2 FORMAT "%%5.0" /end AXIS_PTS
/* AXIS_PTS 0x18158C count=? (unknown_use_2) - values not dumped */
/begin AXIS_PTS AX_18158C "RE axis ptr not OEM" 0x18158C RL_IDENTITY 0 NO_INPUT_QUANTITY 1.0 2 FORMAT "%%5.0" /end AXIS_PTS
/* AXIS_PTS 0x182558 count=? (unknown_use_2) - values not dumped */
/begin AXIS_PTS AX_182558 "RE axis ptr not OEM" 0x182558 RL_IDENTITY 0 NO_INPUT_QUANTITY 1.0 2 FORMAT "%%5.0" /end AXIS_PTS
/* AXIS_PTS 0x182564 count=? (unknown_use_2) - values not dumped */
/begin AXIS_PTS AX_182564 "RE axis ptr not OEM" 0x182564 RL_IDENTITY 0 NO_INPUT_QUANTITY 1.0 2 FORMAT "%%5.0" /end AXIS_PTS
/* AXIS_PTS 0x183540 count=? (unknown_use_2) - values not dumped */
/begin AXIS_PTS AX_183540 "RE axis ptr not OEM" 0x183540 RL_IDENTITY 0 NO_INPUT_QUANTITY 1.0 2 FORMAT "%%5.0" /end AXIS_PTS
/* AXIS_PTS 0x183550 count=38 (header_u16) - values not dumped */
/begin AXIS_PTS AX_183550 "RE axis ptr not OEM" 0x183550 RL_IDENTITY 0 NO_INPUT_QUANTITY 1.0 38 FORMAT "%%5.0" /end AXIS_PTS
/* AXIS_PTS 0x18355C count=? (unknown_use_2) - values not dumped */
/begin AXIS_PTS AX_18355C "RE axis ptr not OEM" 0x18355C RL_IDENTITY 0 NO_INPUT_QUANTITY 1.0 2 FORMAT "%%5.0" /end AXIS_PTS
/* AXIS_PTS 0x183588 count=? (unknown_use_2) - values not dumped */
/begin AXIS_PTS AX_183588 "RE axis ptr not OEM" 0x183588 RL_IDENTITY 0 NO_INPUT_QUANTITY 1.0 2 FORMAT "%%5.0" /end AXIS_PTS
/* AXIS_PTS 0x185550 count=? (unknown_use_2) - values not dumped */
/begin AXIS_PTS AX_185550 "RE axis ptr not OEM" 0x185550 RL_IDENTITY 0 NO_INPUT_QUANTITY 1.0 2 FORMAT "%%5.0" /end AXIS_PTS
/* AXIS_PTS 0x19848C count=? (unknown_use_2) - values not dumped */
/begin AXIS_PTS AX_19848C "RE axis ptr not OEM" 0x19848C RL_IDENTITY 0 NO_INPUT_QUANTITY 1.0 2 FORMAT "%%5.0" /end AXIS_PTS
/* AXIS_PTS 0x199614 count=? (unknown_use_2) - values not dumped */
/begin AXIS_PTS AX_199614 "RE axis ptr not OEM" 0x199614 RL_IDENTITY 0 NO_INPUT_QUANTITY 1.0 2 FORMAT "%%5.0" /end AXIS_PTS
/* AXIS_PTS 0x199760 count=? (unknown_use_2) - values not dumped */
/begin AXIS_PTS AX_199760 "RE axis ptr not OEM" 0x199760 RL_IDENTITY 0 NO_INPUT_QUANTITY 1.0 2 FORMAT "%%5.0" /end AXIS_PTS
/* AXIS_PTS 0x19A5C8 count=? (unknown_use_2) - values not dumped */
/begin AXIS_PTS AX_19A5C8 "RE axis ptr not OEM" 0x19A5C8 RL_IDENTITY 0 NO_INPUT_QUANTITY 1.0 2 FORMAT "%%5.0" /end AXIS_PTS
/* AXIS_PTS 0x19B3F0 count=? (unknown_use_2) - values not dumped */
/begin AXIS_PTS AX_19B3F0 "RE axis ptr not OEM" 0x19B3F0 RL_IDENTITY 0 NO_INPUT_QUANTITY 1.0 2 FORMAT "%%5.0" /end AXIS_PTS
/* AXIS_PTS 0x19B488 count=? (unknown_use_2) - values not dumped */
/begin AXIS_PTS AX_19B488 "RE axis ptr not OEM" 0x19B488 RL_IDENTITY 0 NO_INPUT_QUANTITY 1.0 2 FORMAT "%%5.0" /end AXIS_PTS
/* AXIS_PTS 0x19B538 count=? (unknown_use_2) - values not dumped */
/begin AXIS_PTS AX_19B538 "RE axis ptr not OEM" 0x19B538 RL_IDENTITY 0 NO_INPUT_QUANTITY 1.0 2 FORMAT "%%5.0" /end AXIS_PTS
/* AXIS_PTS 0x19B658 count=? (unknown_use_2) - values not dumped */
/begin AXIS_PTS AX_19B658 "RE axis ptr not OEM" 0x19B658 RL_IDENTITY 0 NO_INPUT_QUANTITY 1.0 2 FORMAT "%%5.0" /end AXIS_PTS
/* AXIS_PTS 0x19B7D8 count=? (unknown_use_2) - values not dumped */
/begin AXIS_PTS AX_19B7D8 "RE axis ptr not OEM" 0x19B7D8 RL_IDENTITY 0 NO_INPUT_QUANTITY 1.0 2 FORMAT "%%5.0" /end AXIS_PTS
/* AXIS_PTS 0x19B7E8 count=? (unknown_use_2) - values not dumped */
/begin AXIS_PTS AX_19B7E8 "RE axis ptr not OEM" 0x19B7E8 RL_IDENTITY 0 NO_INPUT_QUANTITY 1.0 2 FORMAT "%%5.0" /end AXIS_PTS
/* AXIS_PTS 0x19C3C0 count=? (unknown_use_2) - values not dumped */
/begin AXIS_PTS AX_19C3C0 "RE axis ptr not OEM" 0x19C3C0 RL_IDENTITY 0 NO_INPUT_QUANTITY 1.0 2 FORMAT "%%5.0" /end AXIS_PTS
/* AXIS_PTS 0x19C404 count=? (unknown_use_2) - values not dumped */
/begin AXIS_PTS AX_19C404 "RE axis ptr not OEM" 0x19C404 RL_IDENTITY 0 NO_INPUT_QUANTITY 1.0 2 FORMAT "%%5.0" /end AXIS_PTS
/* AXIS_PTS 0x19C444 count=16 (header_u16) - values not dumped */
/begin AXIS_PTS AX_19C444 "RE axis ptr not OEM" 0x19C444 RL_IDENTITY 0 NO_INPUT_QUANTITY 1.0 16 FORMAT "%%5.0" /end AXIS_PTS
/* AXIS_PTS 0x19C4D0 count=? (unknown_use_2) - values not dumped */
/begin AXIS_PTS AX_19C4D0 "RE axis ptr not OEM" 0x19C4D0 RL_IDENTITY 0 NO_INPUT_QUANTITY 1.0 2 FORMAT "%%5.0" /end AXIS_PTS
/* AXIS_PTS 0x19C598 count=? (unknown_use_2) - values not dumped */
/begin AXIS_PTS AX_19C598 "RE axis ptr not OEM" 0x19C598 RL_IDENTITY 0 NO_INPUT_QUANTITY 1.0 2 FORMAT "%%5.0" /end AXIS_PTS
/* AXIS_PTS 0x19C5A8 count=? (unknown_use_2) - values not dumped */
/begin AXIS_PTS AX_19C5A8 "RE axis ptr not OEM" 0x19C5A8 RL_IDENTITY 0 NO_INPUT_QUANTITY 1.0 2 FORMAT "%%5.0" /end AXIS_PTS
/* AXIS_PTS 0x19C67C count=? (unknown_use_2) - values not dumped */
/begin AXIS_PTS AX_19C67C "RE axis ptr not OEM" 0x19C67C RL_IDENTITY 0 NO_INPUT_QUANTITY 1.0 2 FORMAT "%%5.0" /end AXIS_PTS
/* AXIS_PTS 0x19D40C count=? (unknown_use_2) - values not dumped */
/begin AXIS_PTS AX_19D40C "RE axis ptr not OEM" 0x19D40C RL_IDENTITY 0 NO_INPUT_QUANTITY 1.0 2 FORMAT "%%5.0" /end AXIS_PTS
/* AXIS_PTS 0x19D650 count=? (unknown_use_2) - values not dumped */
/begin AXIS_PTS AX_19D650 "RE axis ptr not OEM" 0x19D650 RL_IDENTITY 0 NO_INPUT_QUANTITY 1.0 2 FORMAT "%%5.0" /end AXIS_PTS
/* AXIS_PTS 0x19D674 count=? (unknown_use_2) - values not dumped */
/begin AXIS_PTS AX_19D674 "RE axis ptr not OEM" 0x19D674 RL_IDENTITY 0 NO_INPUT_QUANTITY 1.0 2 FORMAT "%%5.0" /end AXIS_PTS
/* AXIS_PTS 0x19E408 count=3 (header_u16) - values not dumped */
/begin AXIS_PTS AX_19E408 "RE axis ptr not OEM" 0x19E408 RL_IDENTITY 0 NO_INPUT_QUANTITY 1.0 3 FORMAT "%%5.0" /end AXIS_PTS
/* AXIS_PTS 0x19F4BC count=? (unknown_use_2) - values not dumped */
/begin AXIS_PTS AX_19F4BC "RE axis ptr not OEM" 0x19F4BC RL_IDENTITY 0 NO_INPUT_QUANTITY 1.0 2 FORMAT "%%5.0" /end AXIS_PTS
/* AXIS_PTS 0x19F540 count=? (unknown_use_2) - values not dumped */
/begin AXIS_PTS AX_19F540 "RE axis ptr not OEM" 0x19F540 RL_IDENTITY 0 NO_INPUT_QUANTITY 1.0 2 FORMAT "%%5.0" /end AXIS_PTS
/* AXIS_PTS 0x19F7D0 count=? (unknown_use_2) - values not dumped */
/begin AXIS_PTS AX_19F7D0 "RE axis ptr not OEM" 0x19F7D0 RL_IDENTITY 0 NO_INPUT_QUANTITY 1.0 2 FORMAT "%%5.0" /end AXIS_PTS
/* AXIS_PTS 0x1A0468 count=? (unknown_use_2) - values not dumped */
/begin AXIS_PTS AX_1A0468 "RE axis ptr not OEM" 0x1A0468 RL_IDENTITY 0 NO_INPUT_QUANTITY 1.0 2 FORMAT "%%5.0" /end AXIS_PTS
/* AXIS_PTS 0x1A04D0 count=? (unknown_use_2) - values not dumped */
/begin AXIS_PTS AX_1A04D0 "RE axis ptr not OEM" 0x1A04D0 RL_IDENTITY 0 NO_INPUT_QUANTITY 1.0 2 FORMAT "%%5.0" /end AXIS_PTS
/* AXIS_PTS 0x1A050C count=4 (header_u16) - values not dumped */
/begin AXIS_PTS AX_1A050C "RE axis ptr not OEM" 0x1A050C RL_IDENTITY 0 NO_INPUT_QUANTITY 1.0 4 FORMAT "%%5.0" /end AXIS_PTS
/* AXIS_PTS 0x1A0610 count=? (unknown_use_2) - values not dumped */
/begin AXIS_PTS AX_1A0610 "RE axis ptr not OEM" 0x1A0610 RL_IDENTITY 0 NO_INPUT_QUANTITY 1.0 2 FORMAT "%%5.0" /end AXIS_PTS
/* AXIS_PTS 0x1A06C8 count=? (unknown_use_2) - values not dumped */
/begin AXIS_PTS AX_1A06C8 "RE axis ptr not OEM" 0x1A06C8 RL_IDENTITY 0 NO_INPUT_QUANTITY 1.0 2 FORMAT "%%5.0" /end AXIS_PTS
/* AXIS_PTS 0x1A06EC count=20 (header_u16) - values not dumped */
/begin AXIS_PTS AX_1A06EC "RE axis ptr not OEM" 0x1A06EC RL_IDENTITY 0 NO_INPUT_QUANTITY 1.0 20 FORMAT "%%5.0" /end AXIS_PTS
/* AXIS_PTS 0x1A0B44 count=? (unknown_use_2) - values not dumped */
/begin AXIS_PTS AX_1A0B44 "RE axis ptr not OEM" 0x1A0B44 RL_IDENTITY 0 NO_INPUT_QUANTITY 1.0 2 FORMAT "%%5.0" /end AXIS_PTS
/* AXIS_PTS 0x1A0B7C count=? (unknown_use_2) - values not dumped */
/begin AXIS_PTS AX_1A0B7C "RE axis ptr not OEM" 0x1A0B7C RL_IDENTITY 0 NO_INPUT_QUANTITY 1.0 2 FORMAT "%%5.0" /end AXIS_PTS
/* AXIS_PTS 0x1A0C14 count=? (unknown_use_2) - values not dumped */
/begin AXIS_PTS AX_1A0C14 "RE axis ptr not OEM" 0x1A0C14 RL_IDENTITY 0 NO_INPUT_QUANTITY 1.0 2 FORMAT "%%5.0" /end AXIS_PTS
/* AXIS_PTS 0x1A140C count=? (unknown_use_2) - values not dumped */
/begin AXIS_PTS AX_1A140C "RE axis ptr not OEM" 0x1A140C RL_IDENTITY 0 NO_INPUT_QUANTITY 1.0 2 FORMAT "%%5.0" /end AXIS_PTS
/* AXIS_PTS 0x1A147C count=52 (header_u16) - values not dumped */
/begin AXIS_PTS AX_1A147C "RE axis ptr not OEM" 0x1A147C RL_IDENTITY 0 NO_INPUT_QUANTITY 1.0 52 FORMAT "%%5.0" /end AXIS_PTS
/* AXIS_PTS 0x1A14D8 count=? (unknown_use_2) - values not dumped */
/begin AXIS_PTS AX_1A14D8 "RE axis ptr not OEM" 0x1A14D8 RL_IDENTITY 0 NO_INPUT_QUANTITY 1.0 2 FORMAT "%%5.0" /end AXIS_PTS
/* AXIS_PTS 0x1A1748 count=? (unknown_use_2) - values not dumped */
/begin AXIS_PTS AX_1A1748 "RE axis ptr not OEM" 0x1A1748 RL_IDENTITY 0 NO_INPUT_QUANTITY 1.0 2 FORMAT "%%5.0" /end AXIS_PTS
/* AXIS_PTS 0x1A176C count=? (unknown_use_2) - values not dumped */
/begin AXIS_PTS AX_1A176C "RE axis ptr not OEM" 0x1A176C RL_IDENTITY 0 NO_INPUT_QUANTITY 1.0 2 FORMAT "%%5.0" /end AXIS_PTS
/* AXIS_PTS 0x1A17A8 count=? (unknown_use_2) - values not dumped */
/begin AXIS_PTS AX_1A17A8 "RE axis ptr not OEM" 0x1A17A8 RL_IDENTITY 0 NO_INPUT_QUANTITY 1.0 2 FORMAT "%%5.0" /end AXIS_PTS
/* AXIS_PTS 0x1A1B9C count=? (unknown_use_2) - values not dumped */
/begin AXIS_PTS AX_1A1B9C "RE axis ptr not OEM" 0x1A1B9C RL_IDENTITY 0 NO_INPUT_QUANTITY 1.0 2 FORMAT "%%5.0" /end AXIS_PTS
/* AXIS_PTS 0x1A2490 count=? (unknown_use_2) - values not dumped */
/begin AXIS_PTS AX_1A2490 "RE axis ptr not OEM" 0x1A2490 RL_IDENTITY 0 NO_INPUT_QUANTITY 1.0 2 FORMAT "%%5.0" /end AXIS_PTS
/* AXIS_PTS 0x1A2504 count=? (unknown_use_2) - values not dumped */
/begin AXIS_PTS AX_1A2504 "RE axis ptr not OEM" 0x1A2504 RL_IDENTITY 0 NO_INPUT_QUANTITY 1.0 2 FORMAT "%%5.0" /end AXIS_PTS
/* AXIS_PTS 0x1A2580 count=? (unknown_use_2) - values not dumped */
/begin AXIS_PTS AX_1A2580 "RE axis ptr not OEM" 0x1A2580 RL_IDENTITY 0 NO_INPUT_QUANTITY 1.0 2 FORMAT "%%5.0" /end AXIS_PTS
/* AXIS_PTS 0x1A2610 count=? (unknown_use_2) - values not dumped */
/begin AXIS_PTS AX_1A2610 "RE axis ptr not OEM" 0x1A2610 RL_IDENTITY 0 NO_INPUT_QUANTITY 1.0 2 FORMAT "%%5.0" /end AXIS_PTS
/* AXIS_PTS 0x1A2620 count=? (unknown_use_2) - values not dumped */
/begin AXIS_PTS AX_1A2620 "RE axis ptr not OEM" 0x1A2620 RL_IDENTITY 0 NO_INPUT_QUANTITY 1.0 2 FORMAT "%%5.0" /end AXIS_PTS
/* AXIS_PTS 0x1A2630 count=? (unknown_use_2) - values not dumped */
/begin AXIS_PTS AX_1A2630 "RE axis ptr not OEM" 0x1A2630 RL_IDENTITY 0 NO_INPUT_QUANTITY 1.0 2 FORMAT "%%5.0" /end AXIS_PTS
/* AXIS_PTS 0x1A2650 count=? (unknown_use_2) - values not dumped */
/begin AXIS_PTS AX_1A2650 "RE axis ptr not OEM" 0x1A2650 RL_IDENTITY 0 NO_INPUT_QUANTITY 1.0 2 FORMAT "%%5.0" /end AXIS_PTS
/* AXIS_PTS 0x1A2750 count=? (unknown_use_2) - values not dumped */
/begin AXIS_PTS AX_1A2750 "RE axis ptr not OEM" 0x1A2750 RL_IDENTITY 0 NO_INPUT_QUANTITY 1.0 2 FORMAT "%%5.0" /end AXIS_PTS
/* AXIS_PTS 0x1A2774 count=? (unknown_use_2) - values not dumped */
/begin AXIS_PTS AX_1A2774 "RE axis ptr not OEM" 0x1A2774 RL_IDENTITY 0 NO_INPUT_QUANTITY 1.0 2 FORMAT "%%5.0" /end AXIS_PTS
/* AXIS_PTS 0x1A2B64 count=? (unknown_use_2) - values not dumped */
/begin AXIS_PTS AX_1A2B64 "RE axis ptr not OEM" 0x1A2B64 RL_IDENTITY 0 NO_INPUT_QUANTITY 1.0 2 FORMAT "%%5.0" /end AXIS_PTS
/* AXIS_PTS 0x1A2B84 count=? (unknown_use_2) - values not dumped */
/begin AXIS_PTS AX_1A2B84 "RE axis ptr not OEM" 0x1A2B84 RL_IDENTITY 0 NO_INPUT_QUANTITY 1.0 2 FORMAT "%%5.0" /end AXIS_PTS
/* AXIS_PTS 0x1A3464 count=? (unknown_use_2) - values not dumped */
/begin AXIS_PTS AX_1A3464 "RE axis ptr not OEM" 0x1A3464 RL_IDENTITY 0 NO_INPUT_QUANTITY 1.0 2 FORMAT "%%5.0" /end AXIS_PTS
/* AXIS_PTS 0x1A3538 count=? (unknown_use_2) - values not dumped */
/begin AXIS_PTS AX_1A3538 "RE axis ptr not OEM" 0x1A3538 RL_IDENTITY 0 NO_INPUT_QUANTITY 1.0 2 FORMAT "%%5.0" /end AXIS_PTS
/* AXIS_PTS 0x1A360C count=? (unknown_use_2) - values not dumped */
/begin AXIS_PTS AX_1A360C "RE axis ptr not OEM" 0x1A360C RL_IDENTITY 0 NO_INPUT_QUANTITY 1.0 2 FORMAT "%%5.0" /end AXIS_PTS
/* AXIS_PTS 0x1A3620 count=? (unknown_use_2) - values not dumped */
/begin AXIS_PTS AX_1A3620 "RE axis ptr not OEM" 0x1A3620 RL_IDENTITY 0 NO_INPUT_QUANTITY 1.0 2 FORMAT "%%5.0" /end AXIS_PTS
/* AXIS_PTS 0x1A3630 count=28 (header_u16) - values not dumped */
/begin AXIS_PTS AX_1A3630 "RE axis ptr not OEM" 0x1A3630 RL_IDENTITY 0 NO_INPUT_QUANTITY 1.0 28 FORMAT "%%5.0" /end AXIS_PTS
/* AXIS_PTS 0x1A3668 count=? (unknown_use_2) - values not dumped */
/begin AXIS_PTS AX_1A3668 "RE axis ptr not OEM" 0x1A3668 RL_IDENTITY 0 NO_INPUT_QUANTITY 1.0 2 FORMAT "%%5.0" /end AXIS_PTS
/* AXIS_PTS 0x1A371C count=? (unknown_use_2) - values not dumped */
/begin AXIS_PTS AX_1A371C "RE axis ptr not OEM" 0x1A371C RL_IDENTITY 0 NO_INPUT_QUANTITY 1.0 2 FORMAT "%%5.0" /end AXIS_PTS
/* AXIS_PTS 0x1A378C count=? (unknown_use_2) - values not dumped */
/begin AXIS_PTS AX_1A378C "RE axis ptr not OEM" 0x1A378C RL_IDENTITY 0 NO_INPUT_QUANTITY 1.0 2 FORMAT "%%5.0" /end AXIS_PTS
/* AXIS_PTS 0x1A3B74 count=? (unknown_use_2) - values not dumped */
/begin AXIS_PTS AX_1A3B74 "RE axis ptr not OEM" 0x1A3B74 RL_IDENTITY 0 NO_INPUT_QUANTITY 1.0 2 FORMAT "%%5.0" /end AXIS_PTS
/* AXIS_PTS 0x1A42BA count=8 (header_u16) - values not dumped */
/begin AXIS_PTS AX_1A42BA "RE axis ptr not OEM" 0x1A42BA RL_IDENTITY 0 NO_INPUT_QUANTITY 1.0 8 FORMAT "%%5.0" /end AXIS_PTS
/* AXIS_PTS 0x1A4458 count=? (unknown_use_2) - values not dumped */
/begin AXIS_PTS AX_1A4458 "RE axis ptr not OEM" 0x1A4458 RL_IDENTITY 0 NO_INPUT_QUANTITY 1.0 2 FORMAT "%%5.0" /end AXIS_PTS
/* AXIS_PTS 0x1A446C count=? (unknown_use_2) - values not dumped */
/begin AXIS_PTS AX_1A446C "RE axis ptr not OEM" 0x1A446C RL_IDENTITY 0 NO_INPUT_QUANTITY 1.0 2 FORMAT "%%5.0" /end AXIS_PTS
/* AXIS_PTS 0x1A44D8 count=? (unknown_use_2) - values not dumped */
/begin AXIS_PTS AX_1A44D8 "RE axis ptr not OEM" 0x1A44D8 RL_IDENTITY 0 NO_INPUT_QUANTITY 1.0 2 FORMAT "%%5.0" /end AXIS_PTS
/* AXIS_PTS 0x1A4604 count=6 (header_u16) - values not dumped */
/begin AXIS_PTS AX_1A4604 "RE axis ptr not OEM" 0x1A4604 RL_IDENTITY 0 NO_INPUT_QUANTITY 1.0 6 FORMAT "%%5.0" /end AXIS_PTS
/* AXIS_PTS 0x1A4618 count=? (unknown_use_2) - values not dumped */
/begin AXIS_PTS AX_1A4618 "RE axis ptr not OEM" 0x1A4618 RL_IDENTITY 0 NO_INPUT_QUANTITY 1.0 2 FORMAT "%%5.0" /end AXIS_PTS
/* AXIS_PTS 0x1A463C count=? (unknown_use_2) - values not dumped */
/begin AXIS_PTS AX_1A463C "RE axis ptr not OEM" 0x1A463C RL_IDENTITY 0 NO_INPUT_QUANTITY 1.0 2 FORMAT "%%5.0" /end AXIS_PTS
/* AXIS_PTS 0x1A4640 count=4 (header_u16) - values not dumped */
/begin AXIS_PTS AX_1A4640 "RE axis ptr not OEM" 0x1A4640 RL_IDENTITY 0 NO_INPUT_QUANTITY 1.0 4 FORMAT "%%5.0" /end AXIS_PTS
/* AXIS_PTS 0x1A467C count=? (unknown_use_2) - values not dumped */
/begin AXIS_PTS AX_1A467C "RE axis ptr not OEM" 0x1A467C RL_IDENTITY 0 NO_INPUT_QUANTITY 1.0 2 FORMAT "%%5.0" /end AXIS_PTS
/* AXIS_PTS 0x1A46A0 count=? (unknown_use_2) - values not dumped */
/begin AXIS_PTS AX_1A46A0 "RE axis ptr not OEM" 0x1A46A0 RL_IDENTITY 0 NO_INPUT_QUANTITY 1.0 2 FORMAT "%%5.0" /end AXIS_PTS
/* AXIS_PTS 0x1A46C0 count=? (unknown_use_2) - values not dumped */
/begin AXIS_PTS AX_1A46C0 "RE axis ptr not OEM" 0x1A46C0 RL_IDENTITY 0 NO_INPUT_QUANTITY 1.0 2 FORMAT "%%5.0" /end AXIS_PTS
/* AXIS_PTS 0x1A46D0 count=? (unknown_use_2) - values not dumped */
/begin AXIS_PTS AX_1A46D0 "RE axis ptr not OEM" 0x1A46D0 RL_IDENTITY 0 NO_INPUT_QUANTITY 1.0 2 FORMAT "%%5.0" /end AXIS_PTS
/* AXIS_PTS 0x1A46DC count=8 (header_u16) - values not dumped */
/begin AXIS_PTS AX_1A46DC "RE axis ptr not OEM" 0x1A46DC RL_IDENTITY 0 NO_INPUT_QUANTITY 1.0 8 FORMAT "%%5.0" /end AXIS_PTS
/* AXIS_PTS 0x1A470C count=? (unknown_use_2) - values not dumped */
/begin AXIS_PTS AX_1A470C "RE axis ptr not OEM" 0x1A470C RL_IDENTITY 0 NO_INPUT_QUANTITY 1.0 2 FORMAT "%%5.0" /end AXIS_PTS
/* AXIS_PTS 0x1A4720 count=8 (header_u16) - values not dumped */
/begin AXIS_PTS AX_1A4720 "RE axis ptr not OEM" 0x1A4720 RL_IDENTITY 0 NO_INPUT_QUANTITY 1.0 8 FORMAT "%%5.0" /end AXIS_PTS
/* AXIS_PTS 0x1A472C count=? (unknown_use_2) - values not dumped */
/begin AXIS_PTS AX_1A472C "RE axis ptr not OEM" 0x1A472C RL_IDENTITY 0 NO_INPUT_QUANTITY 1.0 2 FORMAT "%%5.0" /end AXIS_PTS
/* AXIS_PTS 0x1A4B9C count=? (unknown_use_2) - values not dumped */
/begin AXIS_PTS AX_1A4B9C "RE axis ptr not OEM" 0x1A4B9C RL_IDENTITY 0 NO_INPUT_QUANTITY 1.0 2 FORMAT "%%5.0" /end AXIS_PTS
/* AXIS_PTS 0x1A4C70 count=? (unknown_use_2) - values not dumped */
/begin AXIS_PTS AX_1A4C70 "RE axis ptr not OEM" 0x1A4C70 RL_IDENTITY 0 NO_INPUT_QUANTITY 1.0 2 FORMAT "%%5.0" /end AXIS_PTS
/* AXIS_PTS 0x1A53D4 count=? (unknown_use_2) - values not dumped */
/begin AXIS_PTS AX_1A53D4 "RE axis ptr not OEM" 0x1A53D4 RL_IDENTITY 0 NO_INPUT_QUANTITY 1.0 2 FORMAT "%%5.0" /end AXIS_PTS
/* AXIS_PTS 0x1A5460 count=? (unknown_use_2) - values not dumped */
/begin AXIS_PTS AX_1A5460 "RE axis ptr not OEM" 0x1A5460 RL_IDENTITY 0 NO_INPUT_QUANTITY 1.0 2 FORMAT "%%5.0" /end AXIS_PTS
/* AXIS_PTS 0x1A5474 count=? (unknown_use_2) - values not dumped */
/begin AXIS_PTS AX_1A5474 "RE axis ptr not OEM" 0x1A5474 RL_IDENTITY 0 NO_INPUT_QUANTITY 1.0 2 FORMAT "%%5.0" /end AXIS_PTS
/* AXIS_PTS 0x1A54C0 count=? (unknown_use_2) - values not dumped */
/begin AXIS_PTS AX_1A54C0 "RE axis ptr not OEM" 0x1A54C0 RL_IDENTITY 0 NO_INPUT_QUANTITY 1.0 2 FORMAT "%%5.0" /end AXIS_PTS
/* AXIS_PTS 0x1A54E4 count=? (unknown_use_2) - values not dumped */
/begin AXIS_PTS AX_1A54E4 "RE axis ptr not OEM" 0x1A54E4 RL_IDENTITY 0 NO_INPUT_QUANTITY 1.0 2 FORMAT "%%5.0" /end AXIS_PTS
/* AXIS_PTS 0x1A5620 count=? (unknown_use_2) - values not dumped */
/begin AXIS_PTS AX_1A5620 "RE axis ptr not OEM" 0x1A5620 RL_IDENTITY 0 NO_INPUT_QUANTITY 1.0 2 FORMAT "%%5.0" /end AXIS_PTS
/* AXIS_PTS 0x1A5634 count=? (unknown_use_2) - values not dumped */
/begin AXIS_PTS AX_1A5634 "RE axis ptr not OEM" 0x1A5634 RL_IDENTITY 0 NO_INPUT_QUANTITY 1.0 2 FORMAT "%%5.0" /end AXIS_PTS
/* AXIS_PTS 0x1A5674 count=8 (header_u16) - values not dumped */
/begin AXIS_PTS AX_1A5674 "RE axis ptr not OEM" 0x1A5674 RL_IDENTITY 0 NO_INPUT_QUANTITY 1.0 8 FORMAT "%%5.0" /end AXIS_PTS
/* AXIS_PTS 0x1A5680 count=? (unknown_use_2) - values not dumped */
/begin AXIS_PTS AX_1A5680 "RE axis ptr not OEM" 0x1A5680 RL_IDENTITY 0 NO_INPUT_QUANTITY 1.0 2 FORMAT "%%5.0" /end AXIS_PTS
/* AXIS_PTS 0x1A56AC count=? (unknown_use_2) - values not dumped */
/begin AXIS_PTS AX_1A56AC "RE axis ptr not OEM" 0x1A56AC RL_IDENTITY 0 NO_INPUT_QUANTITY 1.0 2 FORMAT "%%5.0" /end AXIS_PTS
/* AXIS_PTS 0x1A56E0 count=4 (header_u16) - values not dumped */
/begin AXIS_PTS AX_1A56E0 "RE axis ptr not OEM" 0x1A56E0 RL_IDENTITY 0 NO_INPUT_QUANTITY 1.0 4 FORMAT "%%5.0" /end AXIS_PTS
/* AXIS_PTS 0x1A5B74 count=? (unknown_use_2) - values not dumped */
/begin AXIS_PTS AX_1A5B74 "RE axis ptr not OEM" 0x1A5B74 RL_IDENTITY 0 NO_INPUT_QUANTITY 1.0 2 FORMAT "%%5.0" /end AXIS_PTS
/* AXIS_PTS 0x1A6222 count=6 (header_u16) - values not dumped */
/begin AXIS_PTS AX_1A6222 "RE axis ptr not OEM" 0x1A6222 RL_IDENTITY 0 NO_INPUT_QUANTITY 1.0 6 FORMAT "%%5.0" /end AXIS_PTS
/* AXIS_PTS 0x1A6232 count=16 (header_u16) - values not dumped */
/begin AXIS_PTS AX_1A6232 "RE axis ptr not OEM" 0x1A6232 RL_IDENTITY 0 NO_INPUT_QUANTITY 1.0 16 FORMAT "%%5.0" /end AXIS_PTS
/* AXIS_PTS 0x1A6256 count=16 (header_u16) - values not dumped */
/begin AXIS_PTS AX_1A6256 "RE axis ptr not OEM" 0x1A6256 RL_IDENTITY 0 NO_INPUT_QUANTITY 1.0 16 FORMAT "%%5.0" /end AXIS_PTS
/* AXIS_PTS 0x1A63C4 count=? (unknown_use_2) - values not dumped */
/begin AXIS_PTS AX_1A63C4 "RE axis ptr not OEM" 0x1A63C4 RL_IDENTITY 0 NO_INPUT_QUANTITY 1.0 2 FORMAT "%%5.0" /end AXIS_PTS
/* AXIS_PTS 0x1A63F0 count=? (unknown_use_2) - values not dumped */
/begin AXIS_PTS AX_1A63F0 "RE axis ptr not OEM" 0x1A63F0 RL_IDENTITY 0 NO_INPUT_QUANTITY 1.0 2 FORMAT "%%5.0" /end AXIS_PTS
/* AXIS_PTS 0x1A6448 count=5 (header_u16) - values not dumped */
/begin AXIS_PTS AX_1A6448 "RE axis ptr not OEM" 0x1A6448 RL_IDENTITY 0 NO_INPUT_QUANTITY 1.0 5 FORMAT "%%5.0" /end AXIS_PTS
/* AXIS_PTS 0x1A645C count=? (unknown_use_2) - values not dumped */
/begin AXIS_PTS AX_1A645C "RE axis ptr not OEM" 0x1A645C RL_IDENTITY 0 NO_INPUT_QUANTITY 1.0 2 FORMAT "%%5.0" /end AXIS_PTS
/* AXIS_PTS 0x1A647C count=5 (header_u16) - values not dumped */
/begin AXIS_PTS AX_1A647C "RE axis ptr not OEM" 0x1A647C RL_IDENTITY 0 NO_INPUT_QUANTITY 1.0 5 FORMAT "%%5.0" /end AXIS_PTS
/* AXIS_PTS 0x1A6524 count=? (unknown_use_2) - values not dumped */
/begin AXIS_PTS AX_1A6524 "RE axis ptr not OEM" 0x1A6524 RL_IDENTITY 0 NO_INPUT_QUANTITY 1.0 2 FORMAT "%%5.0" /end AXIS_PTS
/* AXIS_PTS 0x1A6538 count=? (unknown_use_2) - values not dumped */
/begin AXIS_PTS AX_1A6538 "RE axis ptr not OEM" 0x1A6538 RL_IDENTITY 0 NO_INPUT_QUANTITY 1.0 2 FORMAT "%%5.0" /end AXIS_PTS
/* AXIS_PTS 0x1A6614 count=? (unknown_use_2) - values not dumped */
/begin AXIS_PTS AX_1A6614 "RE axis ptr not OEM" 0x1A6614 RL_IDENTITY 0 NO_INPUT_QUANTITY 1.0 2 FORMAT "%%5.0" /end AXIS_PTS
/* AXIS_PTS 0x1A6628 count=? (unknown_use_2) - values not dumped */
/begin AXIS_PTS AX_1A6628 "RE axis ptr not OEM" 0x1A6628 RL_IDENTITY 0 NO_INPUT_QUANTITY 1.0 2 FORMAT "%%5.0" /end AXIS_PTS
/* AXIS_PTS 0x1A6680 count=? (unknown_use_2) - values not dumped */
/begin AXIS_PTS AX_1A6680 "RE axis ptr not OEM" 0x1A6680 RL_IDENTITY 0 NO_INPUT_QUANTITY 1.0 2 FORMAT "%%5.0" /end AXIS_PTS
/* AXIS_PTS 0x1A6690 count=? (unknown_use_2) - values not dumped */
/begin AXIS_PTS AX_1A6690 "RE axis ptr not OEM" 0x1A6690 RL_IDENTITY 0 NO_INPUT_QUANTITY 1.0 2 FORMAT "%%5.0" /end AXIS_PTS
/* AXIS_PTS 0x1A669C count=41 (header_u16) - values not dumped */
/begin AXIS_PTS AX_1A669C "RE axis ptr not OEM" 0x1A669C RL_IDENTITY 0 NO_INPUT_QUANTITY 1.0 41 FORMAT "%%5.0" /end AXIS_PTS
/* AXIS_PTS 0x1A66E0 count=51 (header_u16) - values not dumped */
/begin AXIS_PTS AX_1A66E0 "RE axis ptr not OEM" 0x1A66E0 RL_IDENTITY 0 NO_INPUT_QUANTITY 1.0 51 FORMAT "%%5.0" /end AXIS_PTS
/* AXIS_PTS 0x1A6700 count=? (unknown_use_2) - values not dumped */
/begin AXIS_PTS AX_1A6700 "RE axis ptr not OEM" 0x1A6700 RL_IDENTITY 0 NO_INPUT_QUANTITY 1.0 2 FORMAT "%%5.0" /end AXIS_PTS
/* AXIS_PTS 0x1A6738 count=? (unknown_use_2) - values not dumped */
/begin AXIS_PTS AX_1A6738 "RE axis ptr not OEM" 0x1A6738 RL_IDENTITY 0 NO_INPUT_QUANTITY 1.0 2 FORMAT "%%5.0" /end AXIS_PTS
/* AXIS_PTS 0x1A6C2D count=8 (from_map) - values not dumped */
/begin AXIS_PTS AX_1A6C2D "RE axis ptr not OEM" 0x1A6C2D RL_IDENTITY 0 NO_INPUT_QUANTITY 1.0 8 FORMAT "%%5.0" /end AXIS_PTS
/* AXIS_PTS 0x1A6D1E count=16 (header_u16) - values not dumped */
/begin AXIS_PTS AX_1A6D1E "RE axis ptr not OEM" 0x1A6D1E RL_IDENTITY 0 NO_INPUT_QUANTITY 1.0 16 FORMAT "%%5.0" /end AXIS_PTS
/* AXIS_PTS 0x1A6DD9 count=16 (from_map) - values not dumped */
/begin AXIS_PTS AX_1A6DD9 "RE axis ptr not OEM" 0x1A6DD9 RL_IDENTITY 0 NO_INPUT_QUANTITY 1.0 16 FORMAT "%%5.0" /end AXIS_PTS
/* AXIS_PTS 0x1A73FC count=12 (header_u16) - values not dumped */
/begin AXIS_PTS AX_1A73FC "RE axis ptr not OEM" 0x1A73FC RL_IDENTITY 0 NO_INPUT_QUANTITY 1.0 12 FORMAT "%%5.0" /end AXIS_PTS
/* AXIS_PTS 0x1A74F4 count=? (unknown_use_2) - values not dumped */
/begin AXIS_PTS AX_1A74F4 "RE axis ptr not OEM" 0x1A74F4 RL_IDENTITY 0 NO_INPUT_QUANTITY 1.0 2 FORMAT "%%5.0" /end AXIS_PTS
/* AXIS_PTS 0x1A760C count=? (unknown_use_2) - values not dumped */
/begin AXIS_PTS AX_1A760C "RE axis ptr not OEM" 0x1A760C RL_IDENTITY 0 NO_INPUT_QUANTITY 1.0 2 FORMAT "%%5.0" /end AXIS_PTS
/* AXIS_PTS 0x1A7630 count=? (unknown_use_2) - values not dumped */
/begin AXIS_PTS AX_1A7630 "RE axis ptr not OEM" 0x1A7630 RL_IDENTITY 0 NO_INPUT_QUANTITY 1.0 2 FORMAT "%%5.0" /end AXIS_PTS
/* AXIS_PTS 0x1A763C count=8 (header_u16) - values not dumped */
/begin AXIS_PTS AX_1A763C "RE axis ptr not OEM" 0x1A763C RL_IDENTITY 0 NO_INPUT_QUANTITY 1.0 8 FORMAT "%%5.0" /end AXIS_PTS
/* AXIS_PTS 0x1A765C count=? (unknown_use_2) - values not dumped */
/begin AXIS_PTS AX_1A765C "RE axis ptr not OEM" 0x1A765C RL_IDENTITY 0 NO_INPUT_QUANTITY 1.0 2 FORMAT "%%5.0" /end AXIS_PTS
/* AXIS_PTS 0x1A7680 count=? (unknown_use_2) - values not dumped */
/begin AXIS_PTS AX_1A7680 "RE axis ptr not OEM" 0x1A7680 RL_IDENTITY 0 NO_INPUT_QUANTITY 1.0 2 FORMAT "%%5.0" /end AXIS_PTS
/* AXIS_PTS 0x1A76D8 count=? (unknown_use_2) - values not dumped */
/begin AXIS_PTS AX_1A76D8 "RE axis ptr not OEM" 0x1A76D8 RL_IDENTITY 0 NO_INPUT_QUANTITY 1.0 2 FORMAT "%%5.0" /end AXIS_PTS
/* AXIS_PTS 0x1A7724 count=? (unknown_use_2) - values not dumped */
/begin AXIS_PTS AX_1A7724 "RE axis ptr not OEM" 0x1A7724 RL_IDENTITY 0 NO_INPUT_QUANTITY 1.0 2 FORMAT "%%5.0" /end AXIS_PTS
/* AXIS_PTS 0x1A7B74 count=? (unknown_use_2) - values not dumped */
/begin AXIS_PTS AX_1A7B74 "RE axis ptr not OEM" 0x1A7B74 RL_IDENTITY 0 NO_INPUT_QUANTITY 1.0 2 FORMAT "%%5.0" /end AXIS_PTS
/* AXIS_PTS 0x1A7BC8 count=? (unknown_use_2) - values not dumped */
/begin AXIS_PTS AX_1A7BC8 "RE axis ptr not OEM" 0x1A7BC8 RL_IDENTITY 0 NO_INPUT_QUANTITY 1.0 2 FORMAT "%%5.0" /end AXIS_PTS
/* AXIS_PTS 0x1A7BE0 count=? (unknown_use_2) - values not dumped */
/begin AXIS_PTS AX_1A7BE0 "RE axis ptr not OEM" 0x1A7BE0 RL_IDENTITY 0 NO_INPUT_QUANTITY 1.0 2 FORMAT "%%5.0" /end AXIS_PTS
/* AXIS_PTS 0x1A882C count=? (unknown_use_2) - values not dumped */
/begin AXIS_PTS AX_1A882C "RE axis ptr not OEM" 0x1A882C RL_IDENTITY 0 NO_INPUT_QUANTITY 1.0 2 FORMAT "%%5.0" /end AXIS_PTS
/* AXIS_PTS 0x1A8864 count=? (unknown_use_2) - values not dumped */
/begin AXIS_PTS AX_1A8864 "RE axis ptr not OEM" 0x1A8864 RL_IDENTITY 0 NO_INPUT_QUANTITY 1.0 2 FORMAT "%%5.0" /end AXIS_PTS
/* AXIS_PTS 0x1A88C4 count=? (unknown_use_2) - values not dumped */
/begin AXIS_PTS AX_1A88C4 "RE axis ptr not OEM" 0x1A88C4 RL_IDENTITY 0 NO_INPUT_QUANTITY 1.0 2 FORMAT "%%5.0" /end AXIS_PTS
/* AXIS_PTS 0x1A8BD8 count=? (unknown_use_2) - values not dumped */
/begin AXIS_PTS AX_1A8BD8 "RE axis ptr not OEM" 0x1A8BD8 RL_IDENTITY 0 NO_INPUT_QUANTITY 1.0 2 FORMAT "%%5.0" /end AXIS_PTS
/* AXIS_PTS 0x1A8CFA count=26 (header_u16) - values not dumped */
/begin AXIS_PTS AX_1A8CFA "RE axis ptr not OEM" 0x1A8CFA RL_IDENTITY 0 NO_INPUT_QUANTITY 1.0 26 FORMAT "%%5.0" /end AXIS_PTS
/* AXIS_PTS 0x1A91D0 count=? (unknown_use_2) - values not dumped */
/begin AXIS_PTS AX_1A91D0 "RE axis ptr not OEM" 0x1A91D0 RL_IDENTITY 0 NO_INPUT_QUANTITY 1.0 2 FORMAT "%%5.0" /end AXIS_PTS
/* AXIS_PTS 0x1A9730 count=? (unknown_use_2) - values not dumped */
/begin AXIS_PTS AX_1A9730 "RE axis ptr not OEM" 0x1A9730 RL_IDENTITY 0 NO_INPUT_QUANTITY 1.0 2 FORMAT "%%5.0" /end AXIS_PTS
/* AXIS_PTS 0x1A9830 count=? (unknown_use_2) - values not dumped */
/begin AXIS_PTS AX_1A9830 "RE axis ptr not OEM" 0x1A9830 RL_IDENTITY 0 NO_INPUT_QUANTITY 1.0 2 FORMAT "%%5.0" /end AXIS_PTS
/* AXIS_PTS 0x1A98D8 count=? (unknown_use_2) - values not dumped */
/begin AXIS_PTS AX_1A98D8 "RE axis ptr not OEM" 0x1A98D8 RL_IDENTITY 0 NO_INPUT_QUANTITY 1.0 2 FORMAT "%%5.0" /end AXIS_PTS
/* AXIS_PTS 0x1A98F4 count=? (unknown_use_2) - values not dumped */
/begin AXIS_PTS AX_1A98F4 "RE axis ptr not OEM" 0x1A98F4 RL_IDENTITY 0 NO_INPUT_QUANTITY 1.0 2 FORMAT "%%5.0" /end AXIS_PTS
/* AXIS_PTS 0x1A9928 count=? (unknown_use_2) - values not dumped */
/begin AXIS_PTS AX_1A9928 "RE axis ptr not OEM" 0x1A9928 RL_IDENTITY 0 NO_INPUT_QUANTITY 1.0 2 FORMAT "%%5.0" /end AXIS_PTS
/* AXIS_PTS 0x1A9B4C count=? (unknown_use_2) - values not dumped */
/begin AXIS_PTS AX_1A9B4C "RE axis ptr not OEM" 0x1A9B4C RL_IDENTITY 0 NO_INPUT_QUANTITY 1.0 2 FORMAT "%%5.0" /end AXIS_PTS
/* AXIS_PTS 0x1AA22C count=? (unknown_use_2) - values not dumped */
/begin AXIS_PTS AX_1AA22C "RE axis ptr not OEM" 0x1AA22C RL_IDENTITY 0 NO_INPUT_QUANTITY 1.0 2 FORMAT "%%5.0" /end AXIS_PTS
/* AXIS_PTS 0x1AA23C count=? (unknown_use_2) - values not dumped */
/begin AXIS_PTS AX_1AA23C "RE axis ptr not OEM" 0x1AA23C RL_IDENTITY 0 NO_INPUT_QUANTITY 1.0 2 FORMAT "%%5.0" /end AXIS_PTS
/* AXIS_PTS 0x1AA800 count=? (unknown_use_2) - values not dumped */
/begin AXIS_PTS AX_1AA800 "RE axis ptr not OEM" 0x1AA800 RL_IDENTITY 0 NO_INPUT_QUANTITY 1.0 2 FORMAT "%%5.0" /end AXIS_PTS
/* AXIS_PTS 0x1AA838 count=? (unknown_use_2) - values not dumped */
/begin AXIS_PTS AX_1AA838 "RE axis ptr not OEM" 0x1AA838 RL_IDENTITY 0 NO_INPUT_QUANTITY 1.0 2 FORMAT "%%5.0" /end AXIS_PTS
/* AXIS_PTS 0x1AA8E4 count=8 (from_map) - values not dumped */
/begin AXIS_PTS AX_1AA8E4 "RE axis ptr not OEM" 0x1AA8E4 RL_IDENTITY 0 NO_INPUT_QUANTITY 1.0 8 FORMAT "%%5.0" /end AXIS_PTS
/* AXIS_PTS 0x1AA914 count=? (unknown_use_2) - values not dumped */
/begin AXIS_PTS AX_1AA914 "RE axis ptr not OEM" 0x1AA914 RL_IDENTITY 0 NO_INPUT_QUANTITY 1.0 2 FORMAT "%%5.0" /end AXIS_PTS
/* AXIS_PTS 0x1AA930 count=? (unknown_use_2) - values not dumped */
/begin AXIS_PTS AX_1AA930 "RE axis ptr not OEM" 0x1AA930 RL_IDENTITY 0 NO_INPUT_QUANTITY 1.0 2 FORMAT "%%5.0" /end AXIS_PTS
/* AXIS_PTS 0x1AA95C count=? (unknown_use_2) - values not dumped */
/begin AXIS_PTS AX_1AA95C "RE axis ptr not OEM" 0x1AA95C RL_IDENTITY 0 NO_INPUT_QUANTITY 1.0 2 FORMAT "%%5.0" /end AXIS_PTS
/* AXIS_PTS 0x1AA974 count=? (unknown_use_2) - values not dumped */
/begin AXIS_PTS AX_1AA974 "RE axis ptr not OEM" 0x1AA974 RL_IDENTITY 0 NO_INPUT_QUANTITY 1.0 2 FORMAT "%%5.0" /end AXIS_PTS
/* AXIS_PTS 0x1AA9A8 count=? (unknown_use_2) - values not dumped */
/begin AXIS_PTS AX_1AA9A8 "RE axis ptr not OEM" 0x1AA9A8 RL_IDENTITY 0 NO_INPUT_QUANTITY 1.0 2 FORMAT "%%5.0" /end AXIS_PTS
/* AXIS_PTS 0x1AB20C count=? (unknown_use_2) - values not dumped */
/begin AXIS_PTS AX_1AB20C "RE axis ptr not OEM" 0x1AB20C RL_IDENTITY 0 NO_INPUT_QUANTITY 1.0 2 FORMAT "%%5.0" /end AXIS_PTS
/* AXIS_PTS 0x1AB88C count=? (unknown_use_2) - values not dumped */
/begin AXIS_PTS AX_1AB88C "RE axis ptr not OEM" 0x1AB88C RL_IDENTITY 0 NO_INPUT_QUANTITY 1.0 2 FORMAT "%%5.0" /end AXIS_PTS
/* AXIS_PTS 0x1AB8C8 count=? (unknown_use_2) - values not dumped */
/begin AXIS_PTS AX_1AB8C8 "RE axis ptr not OEM" 0x1AB8C8 RL_IDENTITY 0 NO_INPUT_QUANTITY 1.0 2 FORMAT "%%5.0" /end AXIS_PTS
/* AXIS_PTS 0x1AB8F8 count=? (unknown_use_2) - values not dumped */
/begin AXIS_PTS AX_1AB8F8 "RE axis ptr not OEM" 0x1AB8F8 RL_IDENTITY 0 NO_INPUT_QUANTITY 1.0 2 FORMAT "%%5.0" /end AXIS_PTS
/* AXIS_PTS 0x1ABAC8 count=? (unknown_use_2) - values not dumped */
/begin AXIS_PTS AX_1ABAC8 "RE axis ptr not OEM" 0x1ABAC8 RL_IDENTITY 0 NO_INPUT_QUANTITY 1.0 2 FORMAT "%%5.0" /end AXIS_PTS
/* AXIS_PTS 0x1ABB54 count=? (unknown_use_2) - values not dumped */
/begin AXIS_PTS AX_1ABB54 "RE axis ptr not OEM" 0x1ABB54 RL_IDENTITY 0 NO_INPUT_QUANTITY 1.0 2 FORMAT "%%5.0" /end AXIS_PTS
/* AXIS_PTS 0x1AC1B4 count=? (unknown_use_2) - values not dumped */
/begin AXIS_PTS AX_1AC1B4 "RE axis ptr not OEM" 0x1AC1B4 RL_IDENTITY 0 NO_INPUT_QUANTITY 1.0 2 FORMAT "%%5.0" /end AXIS_PTS
/* AXIS_PTS 0x1AC284 count=? (unknown_use_2) - values not dumped */
/begin AXIS_PTS AX_1AC284 "RE axis ptr not OEM" 0x1AC284 RL_IDENTITY 0 NO_INPUT_QUANTITY 1.0 2 FORMAT "%%5.0" /end AXIS_PTS
/* AXIS_PTS 0x1AC3F0 count=? (unknown_use_2) - values not dumped */
/begin AXIS_PTS AX_1AC3F0 "RE axis ptr not OEM" 0x1AC3F0 RL_IDENTITY 0 NO_INPUT_QUANTITY 1.0 2 FORMAT "%%5.0" /end AXIS_PTS
/* AXIS_PTS 0x1AC814 count=? (unknown_use_2) - values not dumped */
/begin AXIS_PTS AX_1AC814 "RE axis ptr not OEM" 0x1AC814 RL_IDENTITY 0 NO_INPUT_QUANTITY 1.0 2 FORMAT "%%5.0" /end AXIS_PTS
/* AXIS_PTS 0x1AC820 count=? (unknown_use_2) - values not dumped */
/begin AXIS_PTS AX_1AC820 "RE axis ptr not OEM" 0x1AC820 RL_IDENTITY 0 NO_INPUT_QUANTITY 1.0 2 FORMAT "%%5.0" /end AXIS_PTS
/* AXIS_PTS 0x1AC87C count=? (unknown_use_2) - values not dumped */
/begin AXIS_PTS AX_1AC87C "RE axis ptr not OEM" 0x1AC87C RL_IDENTITY 0 NO_INPUT_QUANTITY 1.0 2 FORMAT "%%5.0" /end AXIS_PTS
/* AXIS_PTS 0x1AC8F0 count=? (unknown_use_2) - values not dumped */
/begin AXIS_PTS AX_1AC8F0 "RE axis ptr not OEM" 0x1AC8F0 RL_IDENTITY 0 NO_INPUT_QUANTITY 1.0 2 FORMAT "%%5.0" /end AXIS_PTS
/* AXIS_PTS 0x1AC92C count=? (unknown_use_2) - values not dumped */
/begin AXIS_PTS AX_1AC92C "RE axis ptr not OEM" 0x1AC92C RL_IDENTITY 0 NO_INPUT_QUANTITY 1.0 2 FORMAT "%%5.0" /end AXIS_PTS
/* AXIS_PTS 0x1ACC18 count=? (unknown_use_2) - values not dumped */
/begin AXIS_PTS AX_1ACC18 "RE axis ptr not OEM" 0x1ACC18 RL_IDENTITY 0 NO_INPUT_QUANTITY 1.0 2 FORMAT "%%5.0" /end AXIS_PTS
/* AXIS_PTS 0x1ACEB4 count=? (unknown_use_2) - values not dumped */
/begin AXIS_PTS AX_1ACEB4 "RE axis ptr not OEM" 0x1ACEB4 RL_IDENTITY 0 NO_INPUT_QUANTITY 1.0 2 FORMAT "%%5.0" /end AXIS_PTS
/* AXIS_PTS 0x1AD6D8 count=? (unknown_use_2) - values not dumped */
/begin AXIS_PTS AX_1AD6D8 "RE axis ptr not OEM" 0x1AD6D8 RL_IDENTITY 0 NO_INPUT_QUANTITY 1.0 2 FORMAT "%%5.0" /end AXIS_PTS
/* AXIS_PTS 0x1AE1D0 count=? (unknown_use_2) - values not dumped */
/begin AXIS_PTS AX_1AE1D0 "RE axis ptr not OEM" 0x1AE1D0 RL_IDENTITY 0 NO_INPUT_QUANTITY 1.0 2 FORMAT "%%5.0" /end AXIS_PTS
/* AXIS_PTS 0x1AE6D8 count=? (unknown_use_2) - values not dumped */
/begin AXIS_PTS AX_1AE6D8 "RE axis ptr not OEM" 0x1AE6D8 RL_IDENTITY 0 NO_INPUT_QUANTITY 1.0 2 FORMAT "%%5.0" /end AXIS_PTS
/* AXIS_PTS 0x1AE738 count=? (unknown_use_2) - values not dumped */
/begin AXIS_PTS AX_1AE738 "RE axis ptr not OEM" 0x1AE738 RL_IDENTITY 0 NO_INPUT_QUANTITY 1.0 2 FORMAT "%%5.0" /end AXIS_PTS
/* AXIS_PTS 0x1AE848 count=? (unknown_use_2) - values not dumped */
/begin AXIS_PTS AX_1AE848 "RE axis ptr not OEM" 0x1AE848 RL_IDENTITY 0 NO_INPUT_QUANTITY 1.0 2 FORMAT "%%5.0" /end AXIS_PTS
/* AXIS_PTS 0x1AE8D4 count=? (unknown_use_2) - values not dumped */
/begin AXIS_PTS AX_1AE8D4 "RE axis ptr not OEM" 0x1AE8D4 RL_IDENTITY 0 NO_INPUT_QUANTITY 1.0 2 FORMAT "%%5.0" /end AXIS_PTS
/* AXIS_PTS 0x1AE95C count=? (unknown_use_2) - values not dumped */
/begin AXIS_PTS AX_1AE95C "RE axis ptr not OEM" 0x1AE95C RL_IDENTITY 0 NO_INPUT_QUANTITY 1.0 2 FORMAT "%%5.0" /end AXIS_PTS
/* AXIS_PTS 0x1AF82C count=? (unknown_use_2) - values not dumped */
/begin AXIS_PTS AX_1AF82C "RE axis ptr not OEM" 0x1AF82C RL_IDENTITY 0 NO_INPUT_QUANTITY 1.0 2 FORMAT "%%5.0" /end AXIS_PTS
/* AXIS_PTS 0x1AF890 count=? (unknown_use_2) - values not dumped */
/begin AXIS_PTS AX_1AF890 "RE axis ptr not OEM" 0x1AF890 RL_IDENTITY 0 NO_INPUT_QUANTITY 1.0 2 FORMAT "%%5.0" /end AXIS_PTS
/* AXIS_PTS 0x1AFA84 count=? (unknown_use_2) - values not dumped */
/begin AXIS_PTS AX_1AFA84 "RE axis ptr not OEM" 0x1AFA84 RL_IDENTITY 0 NO_INPUT_QUANTITY 1.0 2 FORMAT "%%5.0" /end AXIS_PTS
/* AXIS_PTS 0x1AFC18 count=? (unknown_use_2) - values not dumped */
/begin AXIS_PTS AX_1AFC18 "RE axis ptr not OEM" 0x1AFC18 RL_IDENTITY 0 NO_INPUT_QUANTITY 1.0 2 FORMAT "%%5.0" /end AXIS_PTS
/* AXIS_PTS 0x1B0718 count=? (unknown_use_2) - values not dumped */
/begin AXIS_PTS AX_1B0718 "RE axis ptr not OEM" 0x1B0718 RL_IDENTITY 0 NO_INPUT_QUANTITY 1.0 2 FORMAT "%%5.0" /end AXIS_PTS
/* AXIS_PTS 0x1B0740 count=? (unknown_use_2) - values not dumped */
/begin AXIS_PTS AX_1B0740 "RE axis ptr not OEM" 0x1B0740 RL_IDENTITY 0 NO_INPUT_QUANTITY 1.0 2 FORMAT "%%5.0" /end AXIS_PTS
/* AXIS_PTS 0x1B0880 count=? (unknown_use_2) - values not dumped */
/begin AXIS_PTS AX_1B0880 "RE axis ptr not OEM" 0x1B0880 RL_IDENTITY 0 NO_INPUT_QUANTITY 1.0 2 FORMAT "%%5.0" /end AXIS_PTS
/* AXIS_PTS 0x1B0904 count=? (unknown_use_2) - values not dumped */
/begin AXIS_PTS AX_1B0904 "RE axis ptr not OEM" 0x1B0904 RL_IDENTITY 0 NO_INPUT_QUANTITY 1.0 2 FORMAT "%%5.0" /end AXIS_PTS
/* AXIS_PTS 0x1B0914 count=? (unknown_use_2) - values not dumped */
/begin AXIS_PTS AX_1B0914 "RE axis ptr not OEM" 0x1B0914 RL_IDENTITY 0 NO_INPUT_QUANTITY 1.0 2 FORMAT "%%5.0" /end AXIS_PTS
/* AXIS_PTS 0x1B0B10 count=? (unknown_use_2) - values not dumped */
/begin AXIS_PTS AX_1B0B10 "RE axis ptr not OEM" 0x1B0B10 RL_IDENTITY 0 NO_INPUT_QUANTITY 1.0 2 FORMAT "%%5.0" /end AXIS_PTS
/* AXIS_PTS 0x1B0C20 count=? (unknown_use_2) - values not dumped */
/begin AXIS_PTS AX_1B0C20 "RE axis ptr not OEM" 0x1B0C20 RL_IDENTITY 0 NO_INPUT_QUANTITY 1.0 2 FORMAT "%%5.0" /end AXIS_PTS
/* AXIS_PTS 0x1B181C count=? (unknown_use_2) - values not dumped */
/begin AXIS_PTS AX_1B181C "RE axis ptr not OEM" 0x1B181C RL_IDENTITY 0 NO_INPUT_QUANTITY 1.0 2 FORMAT "%%5.0" /end AXIS_PTS
/* AXIS_PTS 0x1B182C count=? (unknown_use_2) - values not dumped */
/begin AXIS_PTS AX_1B182C "RE axis ptr not OEM" 0x1B182C RL_IDENTITY 0 NO_INPUT_QUANTITY 1.0 2 FORMAT "%%5.0" /end AXIS_PTS
/* AXIS_PTS 0x1B1908 count=? (unknown_use_2) - values not dumped */
/begin AXIS_PTS AX_1B1908 "RE axis ptr not OEM" 0x1B1908 RL_IDENTITY 0 NO_INPUT_QUANTITY 1.0 2 FORMAT "%%5.0" /end AXIS_PTS
/* AXIS_PTS 0x1B22B4 count=? (unknown_use_2) - values not dumped */
/begin AXIS_PTS AX_1B22B4 "RE axis ptr not OEM" 0x1B22B4 RL_IDENTITY 0 NO_INPUT_QUANTITY 1.0 2 FORMAT "%%5.0" /end AXIS_PTS
/* AXIS_PTS 0x1B26FC count=? (unknown_use_2) - values not dumped */
/begin AXIS_PTS AX_1B26FC "RE axis ptr not OEM" 0x1B26FC RL_IDENTITY 0 NO_INPUT_QUANTITY 1.0 2 FORMAT "%%5.0" /end AXIS_PTS
/* AXIS_PTS 0x1B2810 count=? (unknown_use_2) - values not dumped */
/begin AXIS_PTS AX_1B2810 "RE axis ptr not OEM" 0x1B2810 RL_IDENTITY 0 NO_INPUT_QUANTITY 1.0 2 FORMAT "%%5.0" /end AXIS_PTS
/* AXIS_PTS 0x1B2868 count=? (unknown_use_2) - values not dumped */
/begin AXIS_PTS AX_1B2868 "RE axis ptr not OEM" 0x1B2868 RL_IDENTITY 0 NO_INPUT_QUANTITY 1.0 2 FORMAT "%%5.0" /end AXIS_PTS
/* AXIS_PTS 0x1B2904 count=? (unknown_use_2) - values not dumped */
/begin AXIS_PTS AX_1B2904 "RE axis ptr not OEM" 0x1B2904 RL_IDENTITY 0 NO_INPUT_QUANTITY 1.0 2 FORMAT "%%5.0" /end AXIS_PTS
/* AXIS_PTS 0x1B29A0 count=? (unknown_use_2) - values not dumped */
/begin AXIS_PTS AX_1B29A0 "RE axis ptr not OEM" 0x1B29A0 RL_IDENTITY 0 NO_INPUT_QUANTITY 1.0 2 FORMAT "%%5.0" /end AXIS_PTS
/* AXIS_PTS 0x1B3838 count=? (unknown_use_2) - values not dumped */
/begin AXIS_PTS AX_1B3838 "RE axis ptr not OEM" 0x1B3838 RL_IDENTITY 0 NO_INPUT_QUANTITY 1.0 2 FORMAT "%%5.0" /end AXIS_PTS
/* AXIS_PTS 0x1B38C0 count=? (unknown_use_2) - values not dumped */
/begin AXIS_PTS AX_1B38C0 "RE axis ptr not OEM" 0x1B38C0 RL_IDENTITY 0 NO_INPUT_QUANTITY 1.0 2 FORMAT "%%5.0" /end AXIS_PTS
/* AXIS_PTS 0x1B38F8 count=? (unknown_use_2) - values not dumped */
/begin AXIS_PTS AX_1B38F8 "RE axis ptr not OEM" 0x1B38F8 RL_IDENTITY 0 NO_INPUT_QUANTITY 1.0 2 FORMAT "%%5.0" /end AXIS_PTS
/* AXIS_PTS 0x1B3900 count=16 (from_map) - values not dumped */
/begin AXIS_PTS AX_1B3900 "RE axis ptr not OEM" 0x1B3900 RL_IDENTITY 0 NO_INPUT_QUANTITY 1.0 16 FORMAT "%%5.0" /end AXIS_PTS
/* AXIS_PTS 0x1B39E8 count=? (unknown_use_2) - values not dumped */
/begin AXIS_PTS AX_1B39E8 "RE axis ptr not OEM" 0x1B39E8 RL_IDENTITY 0 NO_INPUT_QUANTITY 1.0 2 FORMAT "%%5.0" /end AXIS_PTS
/* AXIS_PTS 0x1B4284 count=? (unknown_use_2) - values not dumped */
/begin AXIS_PTS AX_1B4284 "RE axis ptr not OEM" 0x1B4284 RL_IDENTITY 0 NO_INPUT_QUANTITY 1.0 2 FORMAT "%%5.0" /end AXIS_PTS
/* AXIS_PTS 0x1B483C count=? (unknown_use_2) - values not dumped */
/begin AXIS_PTS AX_1B483C "RE axis ptr not OEM" 0x1B483C RL_IDENTITY 0 NO_INPUT_QUANTITY 1.0 2 FORMAT "%%5.0" /end AXIS_PTS
/* AXIS_PTS 0x1B4894 count=? (unknown_use_2) - values not dumped */
/begin AXIS_PTS AX_1B4894 "RE axis ptr not OEM" 0x1B4894 RL_IDENTITY 0 NO_INPUT_QUANTITY 1.0 2 FORMAT "%%5.0" /end AXIS_PTS
/* AXIS_PTS 0x1B491C count=? (unknown_use_2) - values not dumped */
/begin AXIS_PTS AX_1B491C "RE axis ptr not OEM" 0x1B491C RL_IDENTITY 0 NO_INPUT_QUANTITY 1.0 2 FORMAT "%%5.0" /end AXIS_PTS
/* AXIS_PTS 0x1B4B0C count=? (unknown_use_2) - values not dumped */
/begin AXIS_PTS AX_1B4B0C "RE axis ptr not OEM" 0x1B4B0C RL_IDENTITY 0 NO_INPUT_QUANTITY 1.0 2 FORMAT "%%5.0" /end AXIS_PTS
/* AXIS_PTS 0x1B5808 count=? (unknown_use_2) - values not dumped */
/begin AXIS_PTS AX_1B5808 "RE axis ptr not OEM" 0x1B5808 RL_IDENTITY 0 NO_INPUT_QUANTITY 1.0 2 FORMAT "%%5.0" /end AXIS_PTS
/* AXIS_PTS 0x1B58D4 count=? (unknown_use_2) - values not dumped */
/begin AXIS_PTS AX_1B58D4 "RE axis ptr not OEM" 0x1B58D4 RL_IDENTITY 0 NO_INPUT_QUANTITY 1.0 2 FORMAT "%%5.0" /end AXIS_PTS
/* AXIS_PTS 0x1B58E4 count=? (unknown_use_2) - values not dumped */
/begin AXIS_PTS AX_1B58E4 "RE axis ptr not OEM" 0x1B58E4 RL_IDENTITY 0 NO_INPUT_QUANTITY 1.0 2 FORMAT "%%5.0" /end AXIS_PTS
/* AXIS_PTS 0x1B58F4 count=? (unknown_use_2) - values not dumped */
/begin AXIS_PTS AX_1B58F4 "RE axis ptr not OEM" 0x1B58F4 RL_IDENTITY 0 NO_INPUT_QUANTITY 1.0 2 FORMAT "%%5.0" /end AXIS_PTS
/* AXIS_PTS 0x1B66FC count=? (unknown_use_2) - values not dumped */
/begin AXIS_PTS AX_1B66FC "RE axis ptr not OEM" 0x1B66FC RL_IDENTITY 0 NO_INPUT_QUANTITY 1.0 2 FORMAT "%%5.0" /end AXIS_PTS
/* AXIS_PTS 0x1B6718 count=? (unknown_use_2) - values not dumped */
/begin AXIS_PTS AX_1B6718 "RE axis ptr not OEM" 0x1B6718 RL_IDENTITY 0 NO_INPUT_QUANTITY 1.0 2 FORMAT "%%5.0" /end AXIS_PTS
/* AXIS_PTS 0x1B674C count=? (unknown_use_2) - values not dumped */
/begin AXIS_PTS AX_1B674C "RE axis ptr not OEM" 0x1B674C RL_IDENTITY 0 NO_INPUT_QUANTITY 1.0 2 FORMAT "%%5.0" /end AXIS_PTS
/* AXIS_PTS 0x1B676C count=? (unknown_use_2) - values not dumped */
/begin AXIS_PTS AX_1B676C "RE axis ptr not OEM" 0x1B676C RL_IDENTITY 0 NO_INPUT_QUANTITY 1.0 2 FORMAT "%%5.0" /end AXIS_PTS
/* AXIS_PTS 0x1B677C count=? (unknown_use_2) - values not dumped */
/begin AXIS_PTS AX_1B677C "RE axis ptr not OEM" 0x1B677C RL_IDENTITY 0 NO_INPUT_QUANTITY 1.0 2 FORMAT "%%5.0" /end AXIS_PTS
/* AXIS_PTS 0x1B6818 count=? (unknown_use_2) - values not dumped */
/begin AXIS_PTS AX_1B6818 "RE axis ptr not OEM" 0x1B6818 RL_IDENTITY 0 NO_INPUT_QUANTITY 1.0 2 FORMAT "%%5.0" /end AXIS_PTS
/* AXIS_PTS 0x1B682C count=? (unknown_use_2) - values not dumped */
/begin AXIS_PTS AX_1B682C "RE axis ptr not OEM" 0x1B682C RL_IDENTITY 0 NO_INPUT_QUANTITY 1.0 2 FORMAT "%%5.0" /end AXIS_PTS
/* AXIS_PTS 0x1B6864 count=? (unknown_use_2) - values not dumped */
/begin AXIS_PTS AX_1B6864 "RE axis ptr not OEM" 0x1B6864 RL_IDENTITY 0 NO_INPUT_QUANTITY 1.0 2 FORMAT "%%5.0" /end AXIS_PTS
/* AXIS_PTS 0x1B68A8 count=? (unknown_use_2) - values not dumped */
/begin AXIS_PTS AX_1B68A8 "RE axis ptr not OEM" 0x1B68A8 RL_IDENTITY 0 NO_INPUT_QUANTITY 1.0 2 FORMAT "%%5.0" /end AXIS_PTS
/* AXIS_PTS 0x1B68D8 count=? (unknown_use_2) - values not dumped */
/begin AXIS_PTS AX_1B68D8 "RE axis ptr not OEM" 0x1B68D8 RL_IDENTITY 0 NO_INPUT_QUANTITY 1.0 2 FORMAT "%%5.0" /end AXIS_PTS
/* AXIS_PTS 0x1B68FC count=? (unknown_use_2) - values not dumped */
/begin AXIS_PTS AX_1B68FC "RE axis ptr not OEM" 0x1B68FC RL_IDENTITY 0 NO_INPUT_QUANTITY 1.0 2 FORMAT "%%5.0" /end AXIS_PTS
/* AXIS_PTS 0x1B6C34 count=? (unknown_use_2) - values not dumped */
/begin AXIS_PTS AX_1B6C34 "RE axis ptr not OEM" 0x1B6C34 RL_IDENTITY 0 NO_INPUT_QUANTITY 1.0 2 FORMAT "%%5.0" /end AXIS_PTS
/* AXIS_PTS 0x1B76C8 count=? (unknown_use_2) - values not dumped */
/begin AXIS_PTS AX_1B76C8 "RE axis ptr not OEM" 0x1B76C8 RL_IDENTITY 0 NO_INPUT_QUANTITY 1.0 2 FORMAT "%%5.0" /end AXIS_PTS
/* AXIS_PTS 0x1B76F0 count=? (unknown_use_2) - values not dumped */
/begin AXIS_PTS AX_1B76F0 "RE axis ptr not OEM" 0x1B76F0 RL_IDENTITY 0 NO_INPUT_QUANTITY 1.0 2 FORMAT "%%5.0" /end AXIS_PTS
/* AXIS_PTS 0x1B774C count=? (unknown_use_2) - values not dumped */
/begin AXIS_PTS AX_1B774C "RE axis ptr not OEM" 0x1B774C RL_IDENTITY 0 NO_INPUT_QUANTITY 1.0 2 FORMAT "%%5.0" /end AXIS_PTS
/* AXIS_PTS 0x1B7820 count=? (unknown_use_2) - values not dumped */
/begin AXIS_PTS AX_1B7820 "RE axis ptr not OEM" 0x1B7820 RL_IDENTITY 0 NO_INPUT_QUANTITY 1.0 2 FORMAT "%%5.0" /end AXIS_PTS
/* AXIS_PTS 0x1B78E8 count=? (unknown_use_2) - values not dumped */
/begin AXIS_PTS AX_1B78E8 "RE axis ptr not OEM" 0x1B78E8 RL_IDENTITY 0 NO_INPUT_QUANTITY 1.0 2 FORMAT "%%5.0" /end AXIS_PTS
/* AXIS_PTS 0x1B7920 count=? (unknown_use_2) - values not dumped */
/begin AXIS_PTS AX_1B7920 "RE axis ptr not OEM" 0x1B7920 RL_IDENTITY 0 NO_INPUT_QUANTITY 1.0 2 FORMAT "%%5.0" /end AXIS_PTS
/* AXIS_PTS 0x1B792C count=? (unknown_use_2) - values not dumped */
/begin AXIS_PTS AX_1B792C "RE axis ptr not OEM" 0x1B792C RL_IDENTITY 0 NO_INPUT_QUANTITY 1.0 2 FORMAT "%%5.0" /end AXIS_PTS
/* AXIS_PTS 0x1B7964 count=? (unknown_use_2) - values not dumped */
/begin AXIS_PTS AX_1B7964 "RE axis ptr not OEM" 0x1B7964 RL_IDENTITY 0 NO_INPUT_QUANTITY 1.0 2 FORMAT "%%5.0" /end AXIS_PTS
/* AXIS_PTS 0x1B8788 count=? (unknown_use_2) - values not dumped */
/begin AXIS_PTS AX_1B8788 "RE axis ptr not OEM" 0x1B8788 RL_IDENTITY 0 NO_INPUT_QUANTITY 1.0 2 FORMAT "%%5.0" /end AXIS_PTS
/* AXIS_PTS 0x1B8798 count=? (unknown_use_2) - values not dumped */
/begin AXIS_PTS AX_1B8798 "RE axis ptr not OEM" 0x1B8798 RL_IDENTITY 0 NO_INPUT_QUANTITY 1.0 2 FORMAT "%%5.0" /end AXIS_PTS
/* AXIS_PTS 0x1B9A34 count=? (unknown_use_2) - values not dumped */
/begin AXIS_PTS AX_1B9A34 "RE axis ptr not OEM" 0x1B9A34 RL_IDENTITY 0 NO_INPUT_QUANTITY 1.0 2 FORMAT "%%5.0" /end AXIS_PTS
/* AXIS_PTS 0x1B9AC4 count=? (unknown_use_2) - values not dumped */
/begin AXIS_PTS AX_1B9AC4 "RE axis ptr not OEM" 0x1B9AC4 RL_IDENTITY 0 NO_INPUT_QUANTITY 1.0 2 FORMAT "%%5.0" /end AXIS_PTS
/* AXIS_PTS 0x1B9AD0 count=? (unknown_use_2) - values not dumped */
/begin AXIS_PTS AX_1B9AD0 "RE axis ptr not OEM" 0x1B9AD0 RL_IDENTITY 0 NO_INPUT_QUANTITY 1.0 2 FORMAT "%%5.0" /end AXIS_PTS
/* AXIS_PTS 0x1B9AF4 count=? (unknown_use_2) - values not dumped */
/begin AXIS_PTS AX_1B9AF4 "RE axis ptr not OEM" 0x1B9AF4 RL_IDENTITY 0 NO_INPUT_QUANTITY 1.0 2 FORMAT "%%5.0" /end AXIS_PTS
/* AXIS_PTS 0x1BA9B8 count=? (unknown_use_2) - values not dumped */
/begin AXIS_PTS AX_1BA9B8 "RE axis ptr not OEM" 0x1BA9B8 RL_IDENTITY 0 NO_INPUT_QUANTITY 1.0 2 FORMAT "%%5.0" /end AXIS_PTS
/* AXIS_PTS 0x1BAAC4 count=? (unknown_use_2) - values not dumped */
/begin AXIS_PTS AX_1BAAC4 "RE axis ptr not OEM" 0x1BAAC4 RL_IDENTITY 0 NO_INPUT_QUANTITY 1.0 2 FORMAT "%%5.0" /end AXIS_PTS
/* AXIS_PTS 0x1BB920 count=? (unknown_use_2) - values not dumped */
/begin AXIS_PTS AX_1BB920 "RE axis ptr not OEM" 0x1BB920 RL_IDENTITY 0 NO_INPUT_QUANTITY 1.0 2 FORMAT "%%5.0" /end AXIS_PTS
/* AXIS_PTS 0x1BB9C0 count=? (unknown_use_2) - values not dumped */
/begin AXIS_PTS AX_1BB9C0 "RE axis ptr not OEM" 0x1BB9C0 RL_IDENTITY 0 NO_INPUT_QUANTITY 1.0 2 FORMAT "%%5.0" /end AXIS_PTS
/* AXIS_PTS 0x1BB9D0 count=? (unknown_use_2) - values not dumped */
/begin AXIS_PTS AX_1BB9D0 "RE axis ptr not OEM" 0x1BB9D0 RL_IDENTITY 0 NO_INPUT_QUANTITY 1.0 2 FORMAT "%%5.0" /end AXIS_PTS
/* AXIS_PTS 0x1BC018 count=? (unknown_use_2) - values not dumped */
/begin AXIS_PTS AX_1BC018 "RE axis ptr not OEM" 0x1BC018 RL_IDENTITY 0 NO_INPUT_QUANTITY 1.0 2 FORMAT "%%5.0" /end AXIS_PTS
/* AXIS_PTS 0x1BC030 count=? (unknown_use_2) - values not dumped */
/begin AXIS_PTS AX_1BC030 "RE axis ptr not OEM" 0x1BC030 RL_IDENTITY 0 NO_INPUT_QUANTITY 1.0 2 FORMAT "%%5.0" /end AXIS_PTS
/* AXIS_PTS 0x1BC03C count=? (unknown_use_2) - values not dumped */
/begin AXIS_PTS AX_1BC03C "RE axis ptr not OEM" 0x1BC03C RL_IDENTITY 0 NO_INPUT_QUANTITY 1.0 2 FORMAT "%%5.0" /end AXIS_PTS
/* AXIS_PTS 0x1BCA3C count=? (unknown_use_2) - values not dumped */
/begin AXIS_PTS AX_1BCA3C "RE axis ptr not OEM" 0x1BCA3C RL_IDENTITY 0 NO_INPUT_QUANTITY 1.0 2 FORMAT "%%5.0" /end AXIS_PTS
/* AXIS_PTS 0x1BD9C4 count=? (unknown_use_2) - values not dumped */
/begin AXIS_PTS AX_1BD9C4 "RE axis ptr not OEM" 0x1BD9C4 RL_IDENTITY 0 NO_INPUT_QUANTITY 1.0 2 FORMAT "%%5.0" /end AXIS_PTS
/* AXIS_PTS 0x1BE6AC count=? (unknown_use_2) - values not dumped */
/begin AXIS_PTS AX_1BE6AC "RE axis ptr not OEM" 0x1BE6AC RL_IDENTITY 0 NO_INPUT_QUANTITY 1.0 2 FORMAT "%%5.0" /end AXIS_PTS
/* AXIS_PTS 0x1BF024 count=? (unknown_use_2) - values not dumped */
/begin AXIS_PTS AX_1BF024 "RE axis ptr not OEM" 0x1BF024 RL_IDENTITY 0 NO_INPUT_QUANTITY 1.0 2 FORMAT "%%5.0" /end AXIS_PTS
/* AXIS_PTS 0x1BF944 count=? (unknown_use_2) - values not dumped */
/begin AXIS_PTS AX_1BF944 "RE axis ptr not OEM" 0x1BF944 RL_IDENTITY 0 NO_INPUT_QUANTITY 1.0 2 FORMAT "%%5.0" /end AXIS_PTS
/* AXIS_PTS 0x1BFA78 count=? (unknown_use_2) - values not dumped */
/begin AXIS_PTS AX_1BFA78 "RE axis ptr not OEM" 0x1BFA78 RL_IDENTITY 0 NO_INPUT_QUANTITY 1.0 2 FORMAT "%%5.0" /end AXIS_PTS
/* AXIS_PTS 0x1BFAA4 count=? (unknown_use_2) - values not dumped */
/begin AXIS_PTS AX_1BFAA4 "RE axis ptr not OEM" 0x1BFAA4 RL_IDENTITY 0 NO_INPUT_QUANTITY 1.0 2 FORMAT "%%5.0" /end AXIS_PTS
/* AXIS_PTS 0x1BFAB4 count=? (unknown_use_2) - values not dumped */
/begin AXIS_PTS AX_1BFAB4 "RE axis ptr not OEM" 0x1BFAB4 RL_IDENTITY 0 NO_INPUT_QUANTITY 1.0 2 FORMAT "%%5.0" /end AXIS_PTS
/* AXIS_PTS 0x1BFAD0 count=? (unknown_use_2) - values not dumped */
/begin AXIS_PTS AX_1BFAD0 "RE axis ptr not OEM" 0x1BFAD0 RL_IDENTITY 0 NO_INPUT_QUANTITY 1.0 2 FORMAT "%%5.0" /end AXIS_PTS
/* AXIS_PTS 0x1CD450 count=? (unknown_use_2) - values not dumped */
/begin AXIS_PTS AX_1CD450 "RE axis ptr not OEM" 0x1CD450 RL_IDENTITY 0 NO_INPUT_QUANTITY 1.0 2 FORMAT "%%5.0" /end AXIS_PTS
/* AXIS_PTS 0x1CD470 count=? (unknown_use_2) - values not dumped */
/begin AXIS_PTS AX_1CD470 "RE axis ptr not OEM" 0x1CD470 RL_IDENTITY 0 NO_INPUT_QUANTITY 1.0 2 FORMAT "%%5.0" /end AXIS_PTS
/* AXIS_PTS 0x1CE440 count=? (unknown_use_2) - values not dumped */
/begin AXIS_PTS AX_1CE440 "RE axis ptr not OEM" 0x1CE440 RL_IDENTITY 0 NO_INPUT_QUANTITY 1.0 2 FORMAT "%%5.0" /end AXIS_PTS
/* AXIS_PTS 0x1CE450 count=? (unknown_use_2) - values not dumped */
/begin AXIS_PTS AX_1CE450 "RE axis ptr not OEM" 0x1CE450 RL_IDENTITY 0 NO_INPUT_QUANTITY 1.0 2 FORMAT "%%5.0" /end AXIS_PTS
/* AXIS_PTS 0x1CE464 count=? (unknown_use_2) - values not dumped */
/begin AXIS_PTS AX_1CE464 "RE axis ptr not OEM" 0x1CE464 RL_IDENTITY 0 NO_INPUT_QUANTITY 1.0 2 FORMAT "%%5.0" /end AXIS_PTS
/* AXIS_PTS 0x1CE478 count=? (unknown_use_2) - values not dumped */
/begin AXIS_PTS AX_1CE478 "RE axis ptr not OEM" 0x1CE478 RL_IDENTITY 0 NO_INPUT_QUANTITY 1.0 2 FORMAT "%%5.0" /end AXIS_PTS
/* AXIS_PTS 0x1D04B8 count=? (unknown_use_2) - values not dumped */
/begin AXIS_PTS AX_1D04B8 "RE axis ptr not OEM" 0x1D04B8 RL_IDENTITY 0 NO_INPUT_QUANTITY 1.0 2 FORMAT "%%5.0" /end AXIS_PTS
/* AXIS_PTS 0x1D1488 count=? (unknown_use_2) - values not dumped */
/begin AXIS_PTS AX_1D1488 "RE axis ptr not OEM" 0x1D1488 RL_IDENTITY 0 NO_INPUT_QUANTITY 1.0 2 FORMAT "%%5.0" /end AXIS_PTS
/* AXIS_PTS 0x1D34A0 count=? (unknown_use_2) - values not dumped */
/begin AXIS_PTS AX_1D34A0 "RE axis ptr not OEM" 0x1D34A0 RL_IDENTITY 0 NO_INPUT_QUANTITY 1.0 2 FORMAT "%%5.0" /end AXIS_PTS
/* AXIS_PTS 0x1D34B4 count=? (unknown_use_2) - values not dumped */
/begin AXIS_PTS AX_1D34B4 "RE axis ptr not OEM" 0x1D34B4 RL_IDENTITY 0 NO_INPUT_QUANTITY 1.0 2 FORMAT "%%5.0" /end AXIS_PTS
/* AXIS_PTS 0x1D5430 count=? (unknown_use_2) - values not dumped */
/begin AXIS_PTS AX_1D5430 "RE axis ptr not OEM" 0x1D5430 RL_IDENTITY 0 NO_INPUT_QUANTITY 1.0 2 FORMAT "%%5.0" /end AXIS_PTS
/* AXIS_PTS 0x1D5488 count=? (unknown_use_2) - values not dumped */
/begin AXIS_PTS AX_1D5488 "RE axis ptr not OEM" 0x1D5488 RL_IDENTITY 0 NO_INPUT_QUANTITY 1.0 2 FORMAT "%%5.0" /end AXIS_PTS
/* AXIS_PTS 0x1D5880 count=20 (header_u16) - values not dumped */
/begin AXIS_PTS AX_1D5880 "RE axis ptr not OEM" 0x1D5880 RL_IDENTITY 0 NO_INPUT_QUANTITY 1.0 20 FORMAT "%%5.0" /end AXIS_PTS
/* AXIS_PTS 0x1D59A6 count=20 (header_u16) - values not dumped */
/begin AXIS_PTS AX_1D59A6 "RE axis ptr not OEM" 0x1D59A6 RL_IDENTITY 0 NO_INPUT_QUANTITY 1.0 20 FORMAT "%%5.0" /end AXIS_PTS
/* AXIS_PTS 0x1D6408 count=? (unknown_use_2) - values not dumped */
/begin AXIS_PTS AX_1D6408 "RE axis ptr not OEM" 0x1D6408 RL_IDENTITY 0 NO_INPUT_QUANTITY 1.0 2 FORMAT "%%5.0" /end AXIS_PTS
/* AXIS_PTS 0x1D6420 count=? (unknown_use_2) - values not dumped */
/begin AXIS_PTS AX_1D6420 "RE axis ptr not OEM" 0x1D6420 RL_IDENTITY 0 NO_INPUT_QUANTITY 1.0 2 FORMAT "%%5.0" /end AXIS_PTS
/* AXIS_PTS 0x1D6438 count=? (unknown_use_2) - values not dumped */
/begin AXIS_PTS AX_1D6438 "RE axis ptr not OEM" 0x1D6438 RL_IDENTITY 0 NO_INPUT_QUANTITY 1.0 2 FORMAT "%%5.0" /end AXIS_PTS
/* AXIS_PTS 0x1D65CE count=16 (header_u16) - values not dumped */
/begin AXIS_PTS AX_1D65CE "RE axis ptr not OEM" 0x1D65CE RL_IDENTITY 0 NO_INPUT_QUANTITY 1.0 16 FORMAT "%%5.0" /end AXIS_PTS
/* AXIS_PTS 0x1D65F0 count=16 (header_u16) - values not dumped */
/begin AXIS_PTS AX_1D65F0 "RE axis ptr not OEM" 0x1D65F0 RL_IDENTITY 0 NO_INPUT_QUANTITY 1.0 16 FORMAT "%%5.0" /end AXIS_PTS
/* AXIS_PTS 0x1D6612 count=16 (header_u16) - values not dumped */
/begin AXIS_PTS AX_1D6612 "RE axis ptr not OEM" 0x1D6612 RL_IDENTITY 0 NO_INPUT_QUANTITY 1.0 16 FORMAT "%%5.0" /end AXIS_PTS
/* AXIS_PTS 0x1D6634 count=16 (header_u16) - values not dumped */
/begin AXIS_PTS AX_1D6634 "RE axis ptr not OEM" 0x1D6634 RL_IDENTITY 0 NO_INPUT_QUANTITY 1.0 16 FORMAT "%%5.0" /end AXIS_PTS
/* AXIS_PTS 0x1D6656 count=16 (header_u16) - values not dumped */
/begin AXIS_PTS AX_1D6656 "RE axis ptr not OEM" 0x1D6656 RL_IDENTITY 0 NO_INPUT_QUANTITY 1.0 16 FORMAT "%%5.0" /end AXIS_PTS
/* AXIS_PTS 0x1D6678 count=16 (header_u16) - values not dumped */
/begin AXIS_PTS AX_1D6678 "RE axis ptr not OEM" 0x1D6678 RL_IDENTITY 0 NO_INPUT_QUANTITY 1.0 16 FORMAT "%%5.0" /end AXIS_PTS
/* AXIS_PTS 0x1D669A count=16 (header_u16) - values not dumped */
/begin AXIS_PTS AX_1D669A "RE axis ptr not OEM" 0x1D669A RL_IDENTITY 0 NO_INPUT_QUANTITY 1.0 16 FORMAT "%%5.0" /end AXIS_PTS
/* AXIS_PTS 0x1D66BC count=16 (header_u16) - values not dumped */
/begin AXIS_PTS AX_1D66BC "RE axis ptr not OEM" 0x1D66BC RL_IDENTITY 0 NO_INPUT_QUANTITY 1.0 16 FORMAT "%%5.0" /end AXIS_PTS
/* AXIS_PTS 0x1D66DE count=16 (header_u16) - values not dumped */
/begin AXIS_PTS AX_1D66DE "RE axis ptr not OEM" 0x1D66DE RL_IDENTITY 0 NO_INPUT_QUANTITY 1.0 16 FORMAT "%%5.0" /end AXIS_PTS
/* AXIS_PTS 0x1D6700 count=16 (header_u16) - values not dumped */
/begin AXIS_PTS AX_1D6700 "RE axis ptr not OEM" 0x1D6700 RL_IDENTITY 0 NO_INPUT_QUANTITY 1.0 16 FORMAT "%%5.0" /end AXIS_PTS
/* AXIS_PTS 0x1D6722 count=16 (header_u16) - values not dumped */
/begin AXIS_PTS AX_1D6722 "RE axis ptr not OEM" 0x1D6722 RL_IDENTITY 0 NO_INPUT_QUANTITY 1.0 16 FORMAT "%%5.0" /end AXIS_PTS
/* AXIS_PTS 0x1D6744 count=16 (header_u16) - values not dumped */
/begin AXIS_PTS AX_1D6744 "RE axis ptr not OEM" 0x1D6744 RL_IDENTITY 0 NO_INPUT_QUANTITY 1.0 16 FORMAT "%%5.0" /end AXIS_PTS
/* AXIS_PTS 0x1D6766 count=16 (header_u16) - values not dumped */
/begin AXIS_PTS AX_1D6766 "RE axis ptr not OEM" 0x1D6766 RL_IDENTITY 0 NO_INPUT_QUANTITY 1.0 16 FORMAT "%%5.0" /end AXIS_PTS
/* AXIS_PTS 0x1D6788 count=16 (header_u16) - values not dumped */
/begin AXIS_PTS AX_1D6788 "RE axis ptr not OEM" 0x1D6788 RL_IDENTITY 0 NO_INPUT_QUANTITY 1.0 16 FORMAT "%%5.0" /end AXIS_PTS
/* AXIS_PTS 0x1D67AA count=16 (header_u16) - values not dumped */
/begin AXIS_PTS AX_1D67AA "RE axis ptr not OEM" 0x1D67AA RL_IDENTITY 0 NO_INPUT_QUANTITY 1.0 16 FORMAT "%%5.0" /end AXIS_PTS
/* AXIS_PTS 0x1D67CC count=16 (header_u16) - values not dumped */
/begin AXIS_PTS AX_1D67CC "RE axis ptr not OEM" 0x1D67CC RL_IDENTITY 0 NO_INPUT_QUANTITY 1.0 16 FORMAT "%%5.0" /end AXIS_PTS
/* AXIS_PTS 0x1D67EE count=16 (header_u16) - values not dumped */
/begin AXIS_PTS AX_1D67EE "RE axis ptr not OEM" 0x1D67EE RL_IDENTITY 0 NO_INPUT_QUANTITY 1.0 16 FORMAT "%%5.0" /end AXIS_PTS
/* AXIS_PTS 0x1D6810 count=16 (header_u16) - values not dumped */
/begin AXIS_PTS AX_1D6810 "RE axis ptr not OEM" 0x1D6810 RL_IDENTITY 0 NO_INPUT_QUANTITY 1.0 16 FORMAT "%%5.0" /end AXIS_PTS
/* AXIS_PTS 0x1D6832 count=16 (header_u16) - values not dumped */
/begin AXIS_PTS AX_1D6832 "RE axis ptr not OEM" 0x1D6832 RL_IDENTITY 0 NO_INPUT_QUANTITY 1.0 16 FORMAT "%%5.0" /end AXIS_PTS
/* AXIS_PTS 0x1D6854 count=16 (header_u16) - values not dumped */
/begin AXIS_PTS AX_1D6854 "RE axis ptr not OEM" 0x1D6854 RL_IDENTITY 0 NO_INPUT_QUANTITY 1.0 16 FORMAT "%%5.0" /end AXIS_PTS
/* AXIS_PTS 0x1D6876 count=16 (header_u16) - values not dumped */
/begin AXIS_PTS AX_1D6876 "RE axis ptr not OEM" 0x1D6876 RL_IDENTITY 0 NO_INPUT_QUANTITY 1.0 16 FORMAT "%%5.0" /end AXIS_PTS
/* AXIS_PTS 0x1D6898 count=16 (header_u16) - values not dumped */
/begin AXIS_PTS AX_1D6898 "RE axis ptr not OEM" 0x1D6898 RL_IDENTITY 0 NO_INPUT_QUANTITY 1.0 16 FORMAT "%%5.0" /end AXIS_PTS
/* AXIS_PTS 0x1D68BA count=16 (header_u16) - values not dumped */
/begin AXIS_PTS AX_1D68BA "RE axis ptr not OEM" 0x1D68BA RL_IDENTITY 0 NO_INPUT_QUANTITY 1.0 16 FORMAT "%%5.0" /end AXIS_PTS
/* AXIS_PTS 0x1D68DC count=16 (header_u16) - values not dumped */
/begin AXIS_PTS AX_1D68DC "RE axis ptr not OEM" 0x1D68DC RL_IDENTITY 0 NO_INPUT_QUANTITY 1.0 16 FORMAT "%%5.0" /end AXIS_PTS
/* AXIS_PTS 0x1D68FE count=16 (header_u16) - values not dumped */
/begin AXIS_PTS AX_1D68FE "RE axis ptr not OEM" 0x1D68FE RL_IDENTITY 0 NO_INPUT_QUANTITY 1.0 16 FORMAT "%%5.0" /end AXIS_PTS
/* AXIS_PTS 0x1D6920 count=16 (header_u16) - values not dumped */
/begin AXIS_PTS AX_1D6920 "RE axis ptr not OEM" 0x1D6920 RL_IDENTITY 0 NO_INPUT_QUANTITY 1.0 16 FORMAT "%%5.0" /end AXIS_PTS
/* AXIS_PTS 0x1D6942 count=16 (header_u16) - values not dumped */
/begin AXIS_PTS AX_1D6942 "RE axis ptr not OEM" 0x1D6942 RL_IDENTITY 0 NO_INPUT_QUANTITY 1.0 16 FORMAT "%%5.0" /end AXIS_PTS
/* AXIS_PTS 0x1D6964 count=16 (header_u16) - values not dumped */
/begin AXIS_PTS AX_1D6964 "RE axis ptr not OEM" 0x1D6964 RL_IDENTITY 0 NO_INPUT_QUANTITY 1.0 16 FORMAT "%%5.0" /end AXIS_PTS
/* AXIS_PTS 0x1D6986 count=16 (header_u16) - values not dumped */
/begin AXIS_PTS AX_1D6986 "RE axis ptr not OEM" 0x1D6986 RL_IDENTITY 0 NO_INPUT_QUANTITY 1.0 16 FORMAT "%%5.0" /end AXIS_PTS
/* AXIS_PTS 0x1D69A8 count=16 (header_u16) - values not dumped */
/begin AXIS_PTS AX_1D69A8 "RE axis ptr not OEM" 0x1D69A8 RL_IDENTITY 0 NO_INPUT_QUANTITY 1.0 16 FORMAT "%%5.0" /end AXIS_PTS
/* AXIS_PTS 0x1D69CA count=16 (header_u16) - values not dumped */
/begin AXIS_PTS AX_1D69CA "RE axis ptr not OEM" 0x1D69CA RL_IDENTITY 0 NO_INPUT_QUANTITY 1.0 16 FORMAT "%%5.0" /end AXIS_PTS
/* AXIS_PTS 0x1D69EC count=16 (header_u16) - values not dumped */
/begin AXIS_PTS AX_1D69EC "RE axis ptr not OEM" 0x1D69EC RL_IDENTITY 0 NO_INPUT_QUANTITY 1.0 16 FORMAT "%%5.0" /end AXIS_PTS
/* AXIS_PTS 0x1D741C count=? (unknown_use_2) - values not dumped */
/begin AXIS_PTS AX_1D741C "RE axis ptr not OEM" 0x1D741C RL_IDENTITY 0 NO_INPUT_QUANTITY 1.0 2 FORMAT "%%5.0" /end AXIS_PTS
/* AXIS_PTS 0x1E8E42 count=16 (header_u16) - values not dumped */
/begin AXIS_PTS AX_1E8E42 "RE axis ptr not OEM" 0x1E8E42 RL_IDENTITY 0 NO_INPUT_QUANTITY 1.0 16 FORMAT "%%5.0" /end AXIS_PTS
/* AXIS_PTS 0x1E8FDE count=16 (header_u16) - values not dumped */
/begin AXIS_PTS AX_1E8FDE "RE axis ptr not OEM" 0x1E8FDE RL_IDENTITY 0 NO_INPUT_QUANTITY 1.0 16 FORMAT "%%5.0" /end AXIS_PTS
/* AXIS_PTS 0x1EDC4C count=? (unknown_use_2) - values not dumped */
/begin AXIS_PTS AX_1EDC4C "RE axis ptr not OEM" 0x1EDC4C RL_IDENTITY 0 NO_INPUT_QUANTITY 1.0 2 FORMAT "%%5.0" /end AXIS_PTS
/* AXIS_PTS 0x1EDC74 count=? (unknown_use_2) - values not dumped */
/begin AXIS_PTS AX_1EDC74 "RE axis ptr not OEM" 0x1EDC74 RL_IDENTITY 0 NO_INPUT_QUANTITY 1.0 2 FORMAT "%%5.0" /end AXIS_PTS
/* AXIS_PTS 0x1EEDD0 count=? (unknown_use_2) - values not dumped */
/begin AXIS_PTS AX_1EEDD0 "RE axis ptr not OEM" 0x1EEDD0 RL_IDENTITY 0 NO_INPUT_QUANTITY 1.0 2 FORMAT "%%5.0" /end AXIS_PTS
/* AXIS_PTS 0x1EEDDC count=? (unknown_use_2) - values not dumped */
/begin AXIS_PTS AX_1EEDDC "RE axis ptr not OEM" 0x1EEDDC RL_IDENTITY 0 NO_INPUT_QUANTITY 1.0 2 FORMAT "%%5.0" /end AXIS_PTS
/* AXIS_PTS 0x1EFBF0 count=? (unknown_use_2) - values not dumped */
/begin AXIS_PTS AX_1EFBF0 "RE axis ptr not OEM" 0x1EFBF0 RL_IDENTITY 0 NO_INPUT_QUANTITY 1.0 2 FORMAT "%%5.0" /end AXIS_PTS
/* AXIS_PTS 0x1F0C24 count=? (unknown_use_2) - values not dumped */
/begin AXIS_PTS AX_1F0C24 "RE axis ptr not OEM" 0x1F0C24 RL_IDENTITY 0 NO_INPUT_QUANTITY 1.0 2 FORMAT "%%5.0" /end AXIS_PTS
/* AXIS_PTS 0x1F0DB0 count=? (unknown_use_2) - values not dumped */
/begin AXIS_PTS AX_1F0DB0 "RE axis ptr not OEM" 0x1F0DB0 RL_IDENTITY 0 NO_INPUT_QUANTITY 1.0 2 FORMAT "%%5.0" /end AXIS_PTS
/* AXIS_PTS 0x1F1D80 count=? (unknown_use_2) - values not dumped */
/begin AXIS_PTS AX_1F1D80 "RE axis ptr not OEM" 0x1F1D80 RL_IDENTITY 0 NO_INPUT_QUANTITY 1.0 2 FORMAT "%%5.0" /end AXIS_PTS
/* AXIS_PTS 0x1F1D90 count=? (unknown_use_2) - values not dumped */
/begin AXIS_PTS AX_1F1D90 "RE axis ptr not OEM" 0x1F1D90 RL_IDENTITY 0 NO_INPUT_QUANTITY 1.0 2 FORMAT "%%5.0" /end AXIS_PTS
/* AXIS_PTS 0x1F1DA0 count=? (unknown_use_2) - values not dumped */
/begin AXIS_PTS AX_1F1DA0 "RE axis ptr not OEM" 0x1F1DA0 RL_IDENTITY 0 NO_INPUT_QUANTITY 1.0 2 FORMAT "%%5.0" /end AXIS_PTS
/* AXIS_PTS 0x1F2D88 count=? (unknown_use_2) - values not dumped */
/begin AXIS_PTS AX_1F2D88 "RE axis ptr not OEM" 0x1F2D88 RL_IDENTITY 0 NO_INPUT_QUANTITY 1.0 2 FORMAT "%%5.0" /end AXIS_PTS
/* AXIS_PTS 0x1F2DBC count=? (unknown_use_2) - values not dumped */
/begin AXIS_PTS AX_1F2DBC "RE axis ptr not OEM" 0x1F2DBC RL_IDENTITY 0 NO_INPUT_QUANTITY 1.0 2 FORMAT "%%5.0" /end AXIS_PTS
/* AXIS_PTS 0x1F4DB4 count=? (unknown_use_2) - values not dumped */
/begin AXIS_PTS AX_1F4DB4 "RE axis ptr not OEM" 0x1F4DB4 RL_IDENTITY 0 NO_INPUT_QUANTITY 1.0 2 FORMAT "%%5.0" /end AXIS_PTS
/* AXIS_PTS 0x1F5D84 count=? (unknown_use_2) - values not dumped */
/begin AXIS_PTS AX_1F5D84 "RE axis ptr not OEM" 0x1F5D84 RL_IDENTITY 0 NO_INPUT_QUANTITY 1.0 2 FORMAT "%%5.0" /end AXIS_PTS
/* AXIS_PTS 0x1F5D94 count=? (unknown_use_2) - values not dumped */
/begin AXIS_PTS AX_1F5D94 "RE axis ptr not OEM" 0x1F5D94 RL_IDENTITY 0 NO_INPUT_QUANTITY 1.0 2 FORMAT "%%5.0" /end AXIS_PTS
/* AXIS_PTS 0x1F5DA4 count=? (unknown_use_2) - values not dumped */
/begin AXIS_PTS AX_1F5DA4 "RE axis ptr not OEM" 0x1F5DA4 RL_IDENTITY 0 NO_INPUT_QUANTITY 1.0 2 FORMAT "%%5.0" /end AXIS_PTS
/* AXIS_PTS 0x1F5DB4 count=? (unknown_use_2) - values not dumped */
/begin AXIS_PTS AX_1F5DB4 "RE axis ptr not OEM" 0x1F5DB4 RL_IDENTITY 0 NO_INPUT_QUANTITY 1.0 2 FORMAT "%%5.0" /end AXIS_PTS
/* AXIS_PTS 0x1F7D98 count=? (unknown_use_2) - values not dumped */
/begin AXIS_PTS AX_1F7D98 "RE axis ptr not OEM" 0x1F7D98 RL_IDENTITY 0 NO_INPUT_QUANTITY 1.0 2 FORMAT "%%5.0" /end AXIS_PTS
/* src=families fam=fam_0011 ax=0x1A66E0 ay=0x1A74F4 */
/begin CHARACTERISTIC map_horsA2L_1D30EC "RE interp_2d fam_0011 call=0x80087A56" MAP 0x1D30EC RL_IDENTITY 0 NO_INPUT_QUANTITY 1.0 FORMAT "%%5.0"
 /begin AXIS_DESCR COM_AXIS NO_INPUT_QUANTITY NO_COMPU_METHOD 51 AXIS_PTS_REF AX_1A66E0 /end AXIS_DESCR
 /begin AXIS_DESCR COM_AXIS NO_INPUT_QUANTITY NO_COMPU_METHOD 2 AXIS_PTS_REF AX_1A74F4 /end AXIS_DESCR
/end CHARACTERISTIC
/* src=atlas9979 fam=- ax=0x1A42BA ay=0x1A8CFA */
/begin CHARACTERISTIC tqlim_base_pu_4A "atlas9979 tqlim_base_pu_4A / Torque limiter (IdName Caddy 9979 - verifier sur 99" MAP 0x1D3190 RL_IDENTITY 0 NO_INPUT_QUANTITY 1.0 FORMAT "%%5.0"
 /begin AXIS_DESCR COM_AXIS NO_INPUT_QUANTITY NO_COMPU_METHOD 8 AXIS_PTS_REF AX_1A42BA /end AXIS_DESCR
 /begin AXIS_DESCR COM_AXIS NO_INPUT_QUANTITY NO_COMPU_METHOD 26 AXIS_PTS_REF AX_1A8CFA /end AXIS_DESCR
/end CHARACTERISTIC
/begin CHARACTERISTIC B_fam_0003_1D32CC "RE interp_2d_B B_fam_0003 call=0x8008736E" MAP 0x1D32CC RL_IDENTITY 0 NO_INPUT_QUANTITY 1.0 FORMAT "%%5.0"
 /begin AXIS_DESCR COM_AXIS NO_INPUT_QUANTITY NO_COMPU_METHOD 2 AXIS_PTS_REF AX_1B4894 /end AXIS_DESCR
 /begin AXIS_DESCR COM_AXIS NO_INPUT_QUANTITY NO_COMPU_METHOD 2 AXIS_PTS_REF AX_1B2868 /end AXIS_DESCR
/end CHARACTERISTIC
/* src=families fam=C_fam_0153 ax=0x1A760C ay=0x- */ /* STUB unknown size; axis_x=0x1A760C axis_y=0x- */
/begin CHARACTERISTIC C_fam_0153_1D330C "RE map_interp_C C_fam_0153 call=0x800DDACE" VALUE 0x1D330C RL_IDENTITY 0 NO_INPUT_QUANTITY 1.0 /end CHARACTERISTIC
/* src=families fam=E_fam_0010 ax=0x1B792C ay=0x- */ /* STUB unknown size; axis_x=0x1B792C axis_y=0x- */
/begin CHARACTERISTIC E_fam_0010_1D332C "RE map_interp_E E_fam_0010 call=0x800DDA36" VALUE 0x1D332C RL_IDENTITY 0 NO_INPUT_QUANTITY 1.0 /end CHARACTERISTIC
/* src=atlas9979 fam=- ax=0x1A6C2D ay=0x1A6222 */
/begin CHARACTERISTIC trq__nm_corr_tmot "atlas9979 trq__nm_corr_tmot / Torque limiter correction by engine temperature (I" MAP 0x1D3330 RL_IDENTITY 0 NO_INPUT_QUANTITY 1.0 FORMAT "%%5.0"
 /begin AXIS_DESCR COM_AXIS NO_INPUT_QUANTITY NO_COMPU_METHOD 8 AXIS_PTS_REF AX_1A6C2D /end AXIS_DESCR
 /begin AXIS_DESCR COM_AXIS NO_INPUT_QUANTITY NO_COMPU_METHOD 6 AXIS_PTS_REF AX_1A6222 /end AXIS_DESCR
/end CHARACTERISTIC
/* src=families fam=E_fam_0010 ax=0x1B792C ay=0x- */ /* STUB unknown size; axis_x=0x1B792C axis_y=0x- */
/begin CHARACTERISTIC E_fam_0010_1D333C "RE map_interp_E E_fam_0010 call=0x800DDA4C" VALUE 0x1D333C RL_IDENTITY 0 NO_INPUT_QUANTITY 1.0 /end CHARACTERISTIC
/* src=atlas9979 fam=- ax=0x1A6DD9 ay=0x1A6232 */
/begin CHARACTERISTIC tqlim_fuel_temp2A "atlas9979 tqlim_fuel_temp2A / Torque limiter by fuel temperature (IdName Caddy 9" MAP 0x1D3390 RL_IDENTITY 0 NO_INPUT_QUANTITY 1.0 FORMAT "%%5.0"
 /begin AXIS_DESCR COM_AXIS NO_INPUT_QUANTITY NO_COMPU_METHOD 16 AXIS_PTS_REF AX_1A6DD9 /end AXIS_DESCR
 /begin AXIS_DESCR COM_AXIS NO_INPUT_QUANTITY NO_COMPU_METHOD 16 AXIS_PTS_REF AX_1A6232 /end AXIS_DESCR
/end CHARACTERISTIC
/* src=atlas9979 fam=- ax=0x1A6D1E ay=0x1A6256 */
/begin CHARACTERISTIC tqlim_tegt_temp "atlas9979 tqlim_tegt_temp / Torque limiter by EGT temperature (IdName Caddy 9979" MAP 0x1D35A8 RL_IDENTITY 0 NO_INPUT_QUANTITY 1.0 FORMAT "%%5.0"
 /begin AXIS_DESCR COM_AXIS NO_INPUT_QUANTITY NO_COMPU_METHOD 16 AXIS_PTS_REF AX_1A6D1E /end AXIS_DESCR
 /begin AXIS_DESCR COM_AXIS NO_INPUT_QUANTITY NO_COMPU_METHOD 16 AXIS_PTS_REF AX_1A6256 /end AXIS_DESCR
/end CHARACTERISTIC
/* src=families fam=D_fam_0017 ax=0x- ay=0x- */
/begin CHARACTERISTIC D_fam_0017_1D3618 "RE map_interp_D D_fam_0017 call=0x80097294" VALUE 0x1D3618 RL_IDENTITY 0 NO_INPUT_QUANTITY 1.0 /end CHARACTERISTIC
/* src=families fam=K_fam_0065 ax=0x- ay=0x- */
/begin CHARACTERISTIC K_fam_0065_1D3670 "RE map_interp_K K_fam_0065 call=0x8009725C" VALUE 0x1D3670 RL_IDENTITY 0 NO_INPUT_QUANTITY 1.0 /end CHARACTERISTIC
/* src=families fam=H_fam_0073 ax=0x- ay=0x- */
/begin CHARACTERISTIC H_fam_0073_1D3712 "RE map_interp_H H_fam_0073 call=0x8009900A" VALUE 0x1D3712 RL_IDENTITY 0 NO_INPUT_QUANTITY 1.0 /end CHARACTERISTIC
/* src=families fam=H_fam_0086 ax=0x- ay=0x- */
/begin CHARACTERISTIC H_fam_0086_1D3738 "RE map_interp_H H_fam_0086 call=0x800991D4" VALUE 0x1D3738 RL_IDENTITY 0 NO_INPUT_QUANTITY 1.0 /end CHARACTERISTIC
/* src=families fam=I_fam_0018 ax=0x- ay=0x- */
/begin CHARACTERISTIC I_fam_0018_1D37A4 "RE map_interp_I I_fam_0018 call=0x800975AE" VALUE 0x1D37A4 RL_IDENTITY 0 NO_INPUT_QUANTITY 1.0 /end CHARACTERISTIC
/* src=families fam=I_fam_0088 ax=0x- ay=0x- */
/begin CHARACTERISTIC I_fam_0088_1D37E4 "RE map_interp_I I_fam_0088 call=0x80093D4A" VALUE 0x1D37E4 RL_IDENTITY 0 NO_INPUT_QUANTITY 1.0 /end CHARACTERISTIC
/* src=families fam=fam_0014 ax=0x1AC284 ay=0x1A765C */
/begin CHARACTERISTIC map_horsA2L_1D382C "RE interp_2d fam_0014 call=0x800EA66A" MAP 0x1D382C RL_IDENTITY 0 NO_INPUT_QUANTITY 1.0 FORMAT "%%5.0"
 /begin AXIS_DESCR COM_AXIS NO_INPUT_QUANTITY NO_COMPU_METHOD 2 AXIS_PTS_REF AX_1AC284 /end AXIS_DESCR
 /begin AXIS_DESCR COM_AXIS NO_INPUT_QUANTITY NO_COMPU_METHOD 2 AXIS_PTS_REF AX_1A765C /end AXIS_DESCR
/end CHARACTERISTIC
/* src=families fam=B_fam_0061 ax=0x- ay=0x- */
/begin CHARACTERISTIC B_fam_0061_1D389C "RE interp_2d_B B_fam_0061 call=0x800F00D4" VALUE 0x1D389C RL_IDENTITY 0 NO_INPUT_QUANTITY 1.0 /end CHARACTERISTIC
/* src=families fam=C_fam_0043 ax=0x1A371C ay=0x- */ /* STUB unknown size; axis_x=0x1A371C axis_y=0x- */
/begin CHARACTERISTIC C_fam_0043_1D391C "RE map_interp_C C_fam_0043 call=0x800F1BD0" VALUE 0x1D391C RL_IDENTITY 0 NO_INPUT_QUANTITY 1.0 /end CHARACTERISTIC
/* src=families fam=C_fam_0012 ax=0x1A140C ay=0x1A3538 */
/begin CHARACTERISTIC C_fam_0012_1D3928 "RE map_interp_C C_fam_0012 call=0x800BDF28; RE map_interp_F F_fam_0047 call=0x80" MAP 0x1D3928 RL_IDENTITY 0 NO_INPUT_QUANTITY 1.0 FORMAT "%%5.0"
 /begin AXIS_DESCR COM_AXIS NO_INPUT_QUANTITY NO_COMPU_METHOD 2 AXIS_PTS_REF AX_1A140C /end AXIS_DESCR
 /begin AXIS_DESCR COM_AXIS NO_INPUT_QUANTITY NO_COMPU_METHOD 2 AXIS_PTS_REF AX_1A3538 /end AXIS_DESCR
/end CHARACTERISTIC
/* src=families fam=C_fam_0075 ax=0x1A446C ay=0x1A4458 */
/begin CHARACTERISTIC C_fam_0075_1D39C4 "RE map_interp_C C_fam_0075 call=0x800FA894" MAP 0x1D39C4 RL_IDENTITY 0 NO_INPUT_QUANTITY 1.0 FORMAT "%%5.0"
 /begin AXIS_DESCR COM_AXIS NO_INPUT_QUANTITY NO_COMPU_METHOD 2 AXIS_PTS_REF AX_1A446C /end AXIS_DESCR
 /begin AXIS_DESCR COM_AXIS NO_INPUT_QUANTITY NO_COMPU_METHOD 2 AXIS_PTS_REF AX_1A4458 /end AXIS_DESCR
/end CHARACTERISTIC
/* src=families fam=C_fam_0288 ax=0x1B674C ay=0x- */ /* STUB unknown size; axis_x=0x1B674C axis_y=0x- */
/begin CHARACTERISTIC C_fam_0288_1D39D8 "RE map_interp_C C_fam_0288 call=0x80074222" VALUE 0x1D39D8 RL_IDENTITY 0 NO_INPUT_QUANTITY 1.0 /end CHARACTERISTIC
/* src=families fam=E_fam_0066 ax=0x- ay=0x- */
/begin CHARACTERISTIC E_fam_0066_1D39E8 "RE map_interp_E E_fam_0066 call=0x8008068A" VALUE 0x1D39E8 RL_IDENTITY 0 NO_INPUT_QUANTITY 1.0 /end CHARACTERISTIC
/* src=families fam=C_fam_0130 ax=0x- ay=0x1A2650 */ /* STUB unknown size; axis_x=0x- axis_y=0x1A2650 */
/begin CHARACTERISTIC C_fam_0130_1D39F4 "RE map_interp_C C_fam_0130 call=0x8007D5A8" VALUE 0x1D39F4 RL_IDENTITY 0 NO_INPUT_QUANTITY 1.0 /end CHARACTERISTIC
/* src=families fam=M_fam_0007 ax=0x1A76D8 ay=0x1A2650 */
/begin CHARACTERISTIC M_fam_0007_1D3A70 "RE map_interp_M M_fam_0007 call=0x8007D562" MAP 0x1D3A70 RL_IDENTITY 0 NO_INPUT_QUANTITY 1.0 FORMAT "%%5.0"
 /begin AXIS_DESCR COM_AXIS NO_INPUT_QUANTITY NO_COMPU_METHOD 2 AXIS_PTS_REF AX_1A76D8 /end AXIS_DESCR
 /begin AXIS_DESCR COM_AXIS NO_INPUT_QUANTITY NO_COMPU_METHOD 2 AXIS_PTS_REF AX_1A2650 /end AXIS_DESCR
/end CHARACTERISTIC
/* src=families fam=B_fam_0036 ax=0x- ay=0x- */
/begin CHARACTERISTIC B_fam_0036_1D3ACC "RE interp_2d_B B_fam_0036 call=0x800DDFA8" VALUE 0x1D3ACC RL_IDENTITY 0 NO_INPUT_QUANTITY 1.0 /end CHARACTERISTIC
/* src=families fam=I_fam_0012 ax=0x1B0904 ay=0x- */ /* STUB unknown size; axis_x=0x1B0904 axis_y=0x- */
/begin CHARACTERISTIC I_fam_0012_1D3E9C "RE map_interp_I I_fam_0012 call=0x8008B18E" VALUE 0x1D3E9C RL_IDENTITY 0 NO_INPUT_QUANTITY 1.0 /end CHARACTERISTIC
/* src=families fam=I_fam_0012 ax=0x1B0904 ay=0x- */ /* STUB unknown size; axis_x=0x1B0904 axis_y=0x- */
/begin CHARACTERISTIC I_fam_0012_1D3EA8 "RE map_interp_I I_fam_0012 call=0x8008B17E" VALUE 0x1D3EA8 RL_IDENTITY 0 NO_INPUT_QUANTITY 1.0 /end CHARACTERISTIC
/* src=families fam=C_fam_0219 ax=0x1A2610 ay=0x- */ /* STUB unknown size; axis_x=0x1A2610 axis_y=0x- */
/begin CHARACTERISTIC C_fam_0219_1D3EE4 "RE map_interp_C C_fam_0219 call=0x8009227A" VALUE 0x1D3EE4 RL_IDENTITY 0 NO_INPUT_QUANTITY 1.0 /end CHARACTERISTIC
/* src=families fam=C_fam_0182 ax=0x1A2620 ay=0x1A2610 */
/begin CHARACTERISTIC C_fam_0182_1D3EF0 "RE map_interp_C C_fam_0182 call=0x800922C6" MAP 0x1D3EF0 RL_IDENTITY 0 NO_INPUT_QUANTITY 1.0 FORMAT "%%5.0"
 /begin AXIS_DESCR COM_AXIS NO_INPUT_QUANTITY NO_COMPU_METHOD 2 AXIS_PTS_REF AX_1A2620 /end AXIS_DESCR
 /begin AXIS_DESCR COM_AXIS NO_INPUT_QUANTITY NO_COMPU_METHOD 2 AXIS_PTS_REF AX_1A2610 /end AXIS_DESCR
/end CHARACTERISTIC
/* src=families fam=C_fam_0325 ax=0x- ay=0x- */
/begin CHARACTERISTIC C_fam_0325_1D3EFC "RE map_interp_C C_fam_0325 call=0x800F335A" VALUE 0x1D3EFC RL_IDENTITY 0 NO_INPUT_QUANTITY 1.0 /end CHARACTERISTIC
/* src=families fam=fam_0044 ax=0x1A472C ay=0x1A63F0 */
/begin CHARACTERISTIC map_horsA2L_1D3F00 "RE interp_2d fam_0044 call=0x800FBDDC" MAP 0x1D3F00 RL_IDENTITY 0 NO_INPUT_QUANTITY 1.0 FORMAT "%%5.0"
 /begin AXIS_DESCR COM_AXIS NO_INPUT_QUANTITY NO_COMPU_METHOD 2 AXIS_PTS_REF AX_1A472C /end AXIS_DESCR
 /begin AXIS_DESCR COM_AXIS NO_INPUT_QUANTITY NO_COMPU_METHOD 2 AXIS_PTS_REF AX_1A63F0 /end AXIS_DESCR
/end CHARACTERISTIC
/begin CHARACTERISTIC fam_0001_1D3FC0 "RE interp_2d fam_0001 call=0x800CC612; AccPed-like 8x16 placeholder (APP_r/nmot " MAP 0x1D3FC0 RL_IDENTITY 0 NO_INPUT_QUANTITY 1.0 FORMAT "%%5.0"
 /begin AXIS_DESCR COM_AXIS NO_INPUT_QUANTITY NO_COMPU_METHOD 8 AXIS_PTS_REF AX_1AA8E4 /end AXIS_DESCR
 /begin AXIS_DESCR COM_AXIS NO_INPUT_QUANTITY NO_COMPU_METHOD 16 AXIS_PTS_REF AX_1B3900 /end AXIS_DESCR
/end CHARACTERISTIC
/* src=families fam=C_fam_0121 ax=0x1B58F4 ay=0x1B68D8 */
/begin CHARACTERISTIC C_fam_0121_1D4000 "RE map_interp_C C_fam_0121 call=0x800DD974" MAP 0x1D4000 RL_IDENTITY 0 NO_INPUT_QUANTITY 1.0 FORMAT "%%5.0"
 /begin AXIS_DESCR COM_AXIS NO_INPUT_QUANTITY NO_COMPU_METHOD 2 AXIS_PTS_REF AX_1B58F4 /end AXIS_DESCR
 /begin AXIS_DESCR COM_AXIS NO_INPUT_QUANTITY NO_COMPU_METHOD 2 AXIS_PTS_REF AX_1B68D8 /end AXIS_DESCR
/end CHARACTERISTIC
/begin CHARACTERISTIC C_fam_0006_1D4020 "RE map_interp_C C_fam_0006 call=0x800DD9BC" VALUE 0x1D4020 RL_IDENTITY 0 NO_INPUT_QUANTITY 1.0 /end CHARACTERISTIC
/* src=families fam=fam_0023 ax=0x1A5620 ay=0x19B538 */
/begin CHARACTERISTIC map_horsA2L_1D4090 "RE interp_2d fam_0023 call=0x80095F24" MAP 0x1D4090 RL_IDENTITY 0 NO_INPUT_QUANTITY 1.0 FORMAT "%%5.0"
 /begin AXIS_DESCR COM_AXIS NO_INPUT_QUANTITY NO_COMPU_METHOD 2 AXIS_PTS_REF AX_1A5620 /end AXIS_DESCR
 /begin AXIS_DESCR COM_AXIS NO_INPUT_QUANTITY NO_COMPU_METHOD 2 AXIS_PTS_REF AX_19B538 /end AXIS_DESCR
/end CHARACTERISTIC
/* src=families fam=F_fam_0092 ax=0x1B2904 ay=0x- */ /* STUB unknown size; axis_x=0x1B2904 axis_y=0x- */
/begin CHARACTERISTIC F_fam_0092_1D41D8 "RE map_interp_F F_fam_0092 call=0x80087730" VALUE 0x1D41D8 RL_IDENTITY 0 NO_INPUT_QUANTITY 1.0 /end CHARACTERISTIC
/* src=families fam=C_fam_0155 ax=0x1A763C ay=0x- */ /* STUB unknown size; axis_x=0x1A763C axis_y=0x- */
/begin CHARACTERISTIC C_fam_0155_1D430C "RE map_interp_C C_fam_0155 call=0x800B3C44" VALUE 0x1D430C RL_IDENTITY 0 NO_INPUT_QUANTITY 1.0 /end CHARACTERISTIC
/* src=families fam=C_fam_0232 ax=0x- ay=0x- */
/begin CHARACTERISTIC C_fam_0232_1D4318 "RE map_interp_C C_fam_0232 call=0x800DFDE2" VALUE 0x1D4318 RL_IDENTITY 0 NO_INPUT_QUANTITY 1.0 /end CHARACTERISTIC
/* src=families fam=C_fam_0265 ax=0x- ay=0x- */
/begin CHARACTERISTIC C_fam_0265_1D4328 "RE map_interp_C C_fam_0265 call=0x800963C2" VALUE 0x1D4328 RL_IDENTITY 0 NO_INPUT_QUANTITY 1.0 /end CHARACTERISTIC
/* src=families fam=C_fam_0306 ax=0x- ay=0x- */
/begin CHARACTERISTIC C_fam_0306_1D43A8 "RE map_interp_C C_fam_0306 call=0x800CD050" VALUE 0x1D43A8 RL_IDENTITY 0 NO_INPUT_QUANTITY 1.0 /end CHARACTERISTIC
/* src=families fam=B_fam_0009 ax=0x1BB9C0 ay=0x- */
/begin CHARACTERISTIC B_fam_0009_1D43B4 "RE interp_2d_B B_fam_0009 call=0x800AE160" VALUE 0x1D43B4 RL_IDENTITY 0 NO_INPUT_QUANTITY 1.0 /end CHARACTERISTIC
/* src=families fam=C_fam_0014 ax=0x1AA838 ay=0x1AC3F0 */
/begin CHARACTERISTIC C_fam_0014_1D442C "RE map_interp_C C_fam_0014 call=0x800E45D0" MAP 0x1D442C RL_IDENTITY 0 NO_INPUT_QUANTITY 1.0 FORMAT "%%5.0"
 /begin AXIS_DESCR COM_AXIS NO_INPUT_QUANTITY NO_COMPU_METHOD 2 AXIS_PTS_REF AX_1AA838 /end AXIS_DESCR
 /begin AXIS_DESCR COM_AXIS NO_INPUT_QUANTITY NO_COMPU_METHOD 2 AXIS_PTS_REF AX_1AC3F0 /end AXIS_DESCR
/end CHARACTERISTIC
/* src=families fam=B_fam_0035 ax=0x- ay=0x- */
/begin CHARACTERISTIC B_fam_0035_1D4454 "RE interp_2d_B B_fam_0035 call=0x801066CE" VALUE 0x1D4454 RL_IDENTITY 0 NO_INPUT_QUANTITY 1.0 /end CHARACTERISTIC
/* src=families fam=D_fam_0237 ax=0x- ay=0x- */
/begin CHARACTERISTIC D_fam_0237_1D4488 "RE map_interp_D D_fam_0237 call=0x801481B2; RE map_interp_I I_fam_0125 call=0x80" VALUE 0x1D4488 RL_IDENTITY 0 NO_INPUT_QUANTITY 1.0 /end CHARACTERISTIC
/* src=families fam=J_fam_0057 ax=0x- ay=0x- */
/begin CHARACTERISTIC J_fam_0057_1D44DC "RE map_interp_J J_fam_0057 call=0x80100910" VALUE 0x1D44DC RL_IDENTITY 0 NO_INPUT_QUANTITY 1.0 /end CHARACTERISTIC
/* src=families fam=F_fam_0089 ax=0x- ay=0x- */
/begin CHARACTERISTIC F_fam_0089_1D4548 "RE map_interp_F F_fam_0089 call=0x80100A24" VALUE 0x1D4548 RL_IDENTITY 0 NO_INPUT_QUANTITY 1.0 /end CHARACTERISTIC
/* src=families fam=D_fam_0018 ax=0x- ay=0x- */
/begin CHARACTERISTIC D_fam_0018_1D4604 "RE map_interp_D D_fam_0018 call=0x80097330" VALUE 0x1D4604 RL_IDENTITY 0 NO_INPUT_QUANTITY 1.0 /end CHARACTERISTIC
/* src=families fam=K_fam_0004 ax=0x- ay=0x- */
/begin CHARACTERISTIC K_fam_0004_1D465C "RE map_interp_K K_fam_0004 call=0x800972F8" VALUE 0x1D465C RL_IDENTITY 0 NO_INPUT_QUANTITY 1.0 /end CHARACTERISTIC
/* src=families fam=G_fam_0021 ax=0x- ay=0x- */
/begin CHARACTERISTIC G_fam_0021_1D46EC "RE map_interp_G G_fam_0021 call=0x80097548" VALUE 0x1D46EC RL_IDENTITY 0 NO_INPUT_QUANTITY 1.0 /end CHARACTERISTIC
/* src=families fam=I_fam_0025 ax=0x- ay=0x- */
/begin CHARACTERISTIC I_fam_0025_1D47C8 "RE map_interp_I I_fam_0025 call=0x80097274" VALUE 0x1D47C8 RL_IDENTITY 0 NO_INPUT_QUANTITY 1.0 /end CHARACTERISTIC
/* src=families fam=fam_0051 ax=0x1A6448 ay=0x1A9830 */
/begin CHARACTERISTIC map_horsA2L_1D485C "RE interp_2d fam_0051 call=0x8008D7F4; RE map_interp_I I_fam_0003 call=0x8008D82" MAP 0x1D485C RL_IDENTITY 0 NO_INPUT_QUANTITY 1.0 FORMAT "%%5.0"
 /begin AXIS_DESCR COM_AXIS NO_INPUT_QUANTITY NO_COMPU_METHOD 5 AXIS_PTS_REF AX_1A6448 /end AXIS_DESCR
 /begin AXIS_DESCR COM_AXIS NO_INPUT_QUANTITY NO_COMPU_METHOD 2 AXIS_PTS_REF AX_1A9830 /end AXIS_DESCR
/end CHARACTERISTIC
/* src=families fam=C_fam_0323 ax=0x- ay=0x- */
/begin CHARACTERISTIC C_fam_0323_1D48AC "RE map_interp_C C_fam_0323 call=0x800F1C8C" VALUE 0x1D48AC RL_IDENTITY 0 NO_INPUT_QUANTITY 1.0 /end CHARACTERISTIC
/* src=families fam=I_fam_0066 ax=0x- ay=0x- */
/begin CHARACTERISTIC I_fam_0066_1D49C4 "RE map_interp_I I_fam_0066 call=0x8008E8BA" VALUE 0x1D49C4 RL_IDENTITY 0 NO_INPUT_QUANTITY 1.0 /end CHARACTERISTIC
/* src=families fam=C_fam_0129 ax=0x- ay=0x1A0468 */ /* STUB unknown size; axis_x=0x- axis_y=0x1A0468 */
/begin CHARACTERISTIC C_fam_0129_1D49D4 "RE map_interp_C C_fam_0129 call=0x8008D99A" VALUE 0x1D49D4 RL_IDENTITY 0 NO_INPUT_QUANTITY 1.0 /end CHARACTERISTIC
/* src=families fam=I_fam_0061 ax=0x- ay=0x- */
/begin CHARACTERISTIC I_fam_0061_1D49E4 "RE map_interp_I I_fam_0061 call=0x8008D098" VALUE 0x1D49E4 RL_IDENTITY 0 NO_INPUT_QUANTITY 1.0 /end CHARACTERISTIC
/* src=families fam=C_fam_0226 ax=0x1A050C ay=0x- */ /* STUB unknown size; axis_x=0x1A050C axis_y=0x- */
/begin CHARACTERISTIC C_fam_0226_1D49F4 "RE map_interp_C C_fam_0226 call=0x80100590" VALUE 0x1D49F4 RL_IDENTITY 0 NO_INPUT_QUANTITY 1.0 /end CHARACTERISTIC
/* src=families fam=fam_0012 ax=0x1AA930 ay=0x1AC92C */
/begin CHARACTERISTIC map_horsA2L_1D4A28 "RE interp_2d fam_0012 call=0x8012E720" MAP 0x1D4A28 RL_IDENTITY 0 NO_INPUT_QUANTITY 1.0 FORMAT "%%5.0"
 /begin AXIS_DESCR COM_AXIS NO_INPUT_QUANTITY NO_COMPU_METHOD 2 AXIS_PTS_REF AX_1AA930 /end AXIS_DESCR
 /begin AXIS_DESCR COM_AXIS NO_INPUT_QUANTITY NO_COMPU_METHOD 2 AXIS_PTS_REF AX_1AC92C /end AXIS_DESCR
/end CHARACTERISTIC
/begin CHARACTERISTIC C_fam_0005_1D4ED0 "RE map_interp_C C_fam_0005 call=0x800F3388" VALUE 0x1D4ED0 RL_IDENTITY 0 NO_INPUT_QUANTITY 1.0 /end CHARACTERISTIC
/* src=families fam=C_fam_0137 ax=0x1A4604 ay=0x- */ /* STUB unknown size; axis_x=0x1A4604 axis_y=0x- */
/begin CHARACTERISTIC C_fam_0137_1D4EE4 "RE map_interp_C C_fam_0137 call=0x800FBC4E" VALUE 0x1D4EE4 RL_IDENTITY 0 NO_INPUT_QUANTITY 1.0 /end CHARACTERISTIC
/* src=families fam=C_fam_0168 ax=0x1B483C ay=0x- */ /* STUB unknown size; axis_x=0x1B483C axis_y=0x- */
/begin CHARACTERISTIC C_fam_0168_1D4EF4 "RE map_interp_C C_fam_0168 call=0x800FC894" VALUE 0x1D4EF4 RL_IDENTITY 0 NO_INPUT_QUANTITY 1.0 /end CHARACTERISTIC
/* src=families fam=I_fam_0063 ax=0x1A3620 ay=0x- */ /* STUB unknown size; axis_x=0x1A3620 axis_y=0x- */
/begin CHARACTERISTIC I_fam_0063_1D4F08 "RE map_interp_I I_fam_0063 call=0x800B1074" VALUE 0x1D4F08 RL_IDENTITY 0 NO_INPUT_QUANTITY 1.0 /end CHARACTERISTIC
/* src=families fam=C_fam_0069 ax=0x1A3630 ay=0x1A63F0 */
/begin CHARACTERISTIC C_fam_0069_1D4F14 "RE map_interp_C C_fam_0069 call=0x800FBE62" MAP 0x1D4F14 RL_IDENTITY 0 NO_INPUT_QUANTITY 1.0 FORMAT "%%5.0"
 /begin AXIS_DESCR COM_AXIS NO_INPUT_QUANTITY NO_COMPU_METHOD 28 AXIS_PTS_REF AX_1A3630 /end AXIS_DESCR
 /begin AXIS_DESCR COM_AXIS NO_INPUT_QUANTITY NO_COMPU_METHOD 2 AXIS_PTS_REF AX_1A63F0 /end AXIS_DESCR
/end CHARACTERISTIC
/* src=families fam=C_fam_0156 ax=0x1A7724 ay=0x- */ /* STUB unknown size; axis_x=0x1A7724 axis_y=0x- */
/begin CHARACTERISTIC C_fam_0156_1D4F24 "RE map_interp_C C_fam_0156 call=0x800F47BC" VALUE 0x1D4F24 RL_IDENTITY 0 NO_INPUT_QUANTITY 1.0 /end CHARACTERISTIC
/* src=families fam=C_fam_0269 ax=0x1B5808 ay=0x- */ /* STUB unknown size; axis_x=0x1B5808 axis_y=0x- */
/begin CHARACTERISTIC C_fam_0269_1D4F30 "RE map_interp_C C_fam_0269 call=0x800FC84A" VALUE 0x1D4F30 RL_IDENTITY 0 NO_INPUT_QUANTITY 1.0 /end CHARACTERISTIC
/* src=families fam=C_fam_0149 ax=0x1A6700 ay=0x- */ /* STUB unknown size; axis_x=0x1A6700 axis_y=0x- */
/begin CHARACTERISTIC C_fam_0149_1D4F3C "RE map_interp_C C_fam_0149 call=0x800F4638" VALUE 0x1D4F3C RL_IDENTITY 0 NO_INPUT_QUANTITY 1.0 /end CHARACTERISTIC
/* src=families fam=F_fam_0019 ax=0x1B58D4 ay=0x1AA95C */
/begin CHARACTERISTIC F_fam_0019_1D4F98 "RE map_interp_F F_fam_0019 call=0x800DEF88" MAP 0x1D4F98 RL_IDENTITY 0 NO_INPUT_QUANTITY 1.0 FORMAT "%%5.0"
 /begin AXIS_DESCR COM_AXIS NO_INPUT_QUANTITY NO_COMPU_METHOD 2 AXIS_PTS_REF AX_1B58D4 /end AXIS_DESCR
 /begin AXIS_DESCR COM_AXIS NO_INPUT_QUANTITY NO_COMPU_METHOD 2 AXIS_PTS_REF AX_1AA95C /end AXIS_DESCR
/end CHARACTERISTIC
/* src=families fam=C_fam_0125 ax=0x1B68D8 ay=0x1B491C */
/begin CHARACTERISTIC C_fam_0125_1D5000 "RE map_interp_C C_fam_0125 call=0x800DD920" MAP 0x1D5000 RL_IDENTITY 0 NO_INPUT_QUANTITY 1.0 FORMAT "%%5.0"
 /begin AXIS_DESCR COM_AXIS NO_INPUT_QUANTITY NO_COMPU_METHOD 2 AXIS_PTS_REF AX_1B68D8 /end AXIS_DESCR
 /begin AXIS_DESCR COM_AXIS NO_INPUT_QUANTITY NO_COMPU_METHOD 2 AXIS_PTS_REF AX_1B491C /end AXIS_DESCR
/end CHARACTERISTIC
/begin CHARACTERISTIC C_fam_0006_1D5020 "RE map_interp_C C_fam_0006 call=0x800DD998" VALUE 0x1D5020 RL_IDENTITY 0 NO_INPUT_QUANTITY 1.0 /end CHARACTERISTIC
/* src=families fam=O_fam_0004 ax=0x1A8928 ay=0x- */ /* STUB unknown size; axis_x=0x1A8928 axis_y=0x- */
/begin CHARACTERISTIC O_fam_0004_1D5040 "RE map_interp_O O_fam_0004 call=0x80096BFC" VALUE 0x1D5040 RL_IDENTITY 0 NO_INPUT_QUANTITY 1.0 /end CHARACTERISTIC
/* src=families fam=D_fam_0085 ax=0x1AB8C8 ay=0x- */ /* STUB unknown size; axis_x=0x1AB8C8 axis_y=0x- */
/begin CHARACTERISTIC D_fam_0085_1D52CC "RE map_interp_D D_fam_0085 call=0x800D6DEE; RE map_interp_I I_fam_0027 call=0x80" VALUE 0x1D52CC RL_IDENTITY 0 NO_INPUT_QUANTITY 1.0 /end CHARACTERISTIC
/* src=families fam=I_fam_0027 ax=0x- ay=0x- */
/begin CHARACTERISTIC I_fam_0027_1D52DC "RE map_interp_I I_fam_0027 call=0x800D6DB2" VALUE 0x1D52DC RL_IDENTITY 0 NO_INPUT_QUANTITY 1.0 /end CHARACTERISTIC
/begin CHARACTERISTIC B_fam_0003_1D52EC "RE interp_2d_B B_fam_0003 call=0x800873C0" MAP 0x1D52EC RL_IDENTITY 0 NO_INPUT_QUANTITY 1.0 FORMAT "%%5.0"
 /begin AXIS_DESCR COM_AXIS NO_INPUT_QUANTITY NO_COMPU_METHOD 2 AXIS_PTS_REF AX_1B4894 /end AXIS_DESCR
 /begin AXIS_DESCR COM_AXIS NO_INPUT_QUANTITY NO_COMPU_METHOD 2 AXIS_PTS_REF AX_1B2868 /end AXIS_DESCR
/end CHARACTERISTIC
/* src=families fam=fam_0131 ax=0x1A98D8 ay=0x19E408 */
/begin CHARACTERISTIC map_horsA2L_1D5308 "RE interp_2d fam_0131 call=0x800BFCC2" MAP 0x1D5308 RL_IDENTITY 0 NO_INPUT_QUANTITY 1.0 FORMAT "%%5.0"
 /begin AXIS_DESCR COM_AXIS NO_INPUT_QUANTITY NO_COMPU_METHOD 2 AXIS_PTS_REF AX_1A98D8 /end AXIS_DESCR
 /begin AXIS_DESCR COM_AXIS NO_INPUT_QUANTITY NO_COMPU_METHOD 3 AXIS_PTS_REF AX_19E408 /end AXIS_DESCR
/end CHARACTERISTIC
/* src=families fam=fam_0077 ax=0x1B2810 ay=0x1B3838 */
/begin CHARACTERISTIC map_horsA2L_1D53D8 "RE interp_2d fam_0077 call=0x800EDCC6" MAP 0x1D53D8 RL_IDENTITY 0 NO_INPUT_QUANTITY 1.0 FORMAT "%%5.0"
 /begin AXIS_DESCR COM_AXIS NO_INPUT_QUANTITY NO_COMPU_METHOD 2 AXIS_PTS_REF AX_1B2810 /end AXIS_DESCR
 /begin AXIS_DESCR COM_AXIS NO_INPUT_QUANTITY NO_COMPU_METHOD 2 AXIS_PTS_REF AX_1B3838 /end AXIS_DESCR
/end CHARACTERISTIC
/* src=horsA2L fam=- ax=0x1D6420 ay=0x1D5430 */ /* STUB unknown size; axis_x=0x1D6420 axis_y=0x1D5430 */
/begin CHARACTERISTIC map_horsA2L_1D5430_1D5430 "low: pas dans l A2L/atlas 9979 (299 maps WinOLS) - nommer a la main si besoin; i" VALUE 0x1D5430 RL_IDENTITY 0 NO_INPUT_QUANTITY 1.0 /end CHARACTERISTIC
/* src=families fam=F_fam_0196 ax=0x1D1488 ay=0x1D5488 */
/begin CHARACTERISTIC F_fam_0196_1D5488 "RE map_interp_F F_fam_0196 call=0x80105658; RE map_interp_G G_fam_0149 call=0x80" MAP 0x1D5488 RL_IDENTITY 0 NO_INPUT_QUANTITY 1.0 FORMAT "%%5.0"
 /begin AXIS_DESCR COM_AXIS NO_INPUT_QUANTITY NO_COMPU_METHOD 2 AXIS_PTS_REF AX_1D1488 /end AXIS_DESCR
 /begin AXIS_DESCR COM_AXIS NO_INPUT_QUANTITY NO_COMPU_METHOD 2 AXIS_PTS_REF AX_1D5488 /end AXIS_DESCR
/end CHARACTERISTIC
/* src=families fam=F_fam_0194 ax=0x- ay=0x- */
/begin CHARACTERISTIC F_fam_0194_1D54B4 "RE map_interp_F F_fam_0194 call=0x8010084E; RE map_interp_G G_fam_0145 call=0x80" VALUE 0x1D54B4 RL_IDENTITY 0 NO_INPUT_QUANTITY 1.0 /end CHARACTERISTIC
/* src=families fam=E_fam_0079 ax=0x- ay=0x- */
/begin CHARACTERISTIC E_fam_0079_1D54F4 "RE map_interp_E E_fam_0079 call=0x801218E8" VALUE 0x1D54F4 RL_IDENTITY 0 NO_INPUT_QUANTITY 1.0 /end CHARACTERISTIC
/* src=families fam=D_fam_0001 ax=0x- ay=0x- */
/begin CHARACTERISTIC D_fam_0001_1D5614 "RE map_interp_D D_fam_0001 call=0x800973CA" VALUE 0x1D5614 RL_IDENTITY 0 NO_INPUT_QUANTITY 1.0 /end CHARACTERISTIC
/* src=families fam=K_fam_0005 ax=0x- ay=0x- */
/begin CHARACTERISTIC K_fam_0005_1D566C "RE map_interp_K K_fam_0005 call=0x80097392" VALUE 0x1D566C RL_IDENTITY 0 NO_INPUT_QUANTITY 1.0 /end CHARACTERISTIC
/* src=families fam=G_fam_0022 ax=0x- ay=0x- */
/begin CHARACTERISTIC G_fam_0022_1D56FC "RE map_interp_G G_fam_0022 call=0x800975E4" VALUE 0x1D56FC RL_IDENTITY 0 NO_INPUT_QUANTITY 1.0 /end CHARACTERISTIC
/* src=families fam=H_fam_0082 ax=0x- ay=0x- */
/begin CHARACTERISTIC H_fam_0082_1D576C "RE map_interp_H H_fam_0082 call=0x80099126" VALUE 0x1D576C RL_IDENTITY 0 NO_INPUT_QUANTITY 1.0 /end CHARACTERISTIC
/* src=families fam=C_fam_0189 ax=0x- ay=0x- */
/begin CHARACTERISTIC C_fam_0189_1D5788 "RE map_interp_C C_fam_0189 call=0x80098426" VALUE 0x1D5788 RL_IDENTITY 0 NO_INPUT_QUANTITY 1.0 /end CHARACTERISTIC
/* src=families fam=I_fam_0085 ax=0x- ay=0x- */
/begin CHARACTERISTIC I_fam_0085_1D57A0 "RE map_interp_I I_fam_0085 call=0x80093A5A" VALUE 0x1D57A0 RL_IDENTITY 0 NO_INPUT_QUANTITY 1.0 /end CHARACTERISTIC
/* src=families fam=I_fam_0015 ax=0x- ay=0x- */
/begin CHARACTERISTIC I_fam_0015_1D57D0 "RE map_interp_I I_fam_0015 call=0x80097310" VALUE 0x1D57D0 RL_IDENTITY 0 NO_INPUT_QUANTITY 1.0 /end CHARACTERISTIC
/* src=families fam=fam_0052 ax=0x1A645C ay=0x1AA800 */
/begin CHARACTERISTIC map_horsA2L_1D587C "RE interp_2d fam_0052 call=0x8008CD5A" MAP 0x1D587C RL_IDENTITY 0 NO_INPUT_QUANTITY 1.0 FORMAT "%%5.0"
 /begin AXIS_DESCR COM_AXIS NO_INPUT_QUANTITY NO_COMPU_METHOD 2 AXIS_PTS_REF AX_1A645C /end AXIS_DESCR
 /begin AXIS_DESCR COM_AXIS NO_INPUT_QUANTITY NO_COMPU_METHOD 2 AXIS_PTS_REF AX_1AA800 /end AXIS_DESCR
/end CHARACTERISTIC
/* src=families fam=fam_0106 ax=0x19D650 ay=0x19C444 */
/begin CHARACTERISTIC map_horsA2L_1D5884 "RE interp_2d fam_0106 call=0x800F915A" MAP 0x1D5884 RL_IDENTITY 0 NO_INPUT_QUANTITY 1.0 FORMAT "%%5.0"
 /begin AXIS_DESCR COM_AXIS NO_INPUT_QUANTITY NO_COMPU_METHOD 2 AXIS_PTS_REF AX_19D650 /end AXIS_DESCR
 /begin AXIS_DESCR COM_AXIS NO_INPUT_QUANTITY NO_COMPU_METHOD 16 AXIS_PTS_REF AX_19C444 /end AXIS_DESCR
/end CHARACTERISTIC
/* src=families fam=B_fam_0009 ax=0x1BB920 ay=0x- */ /* STUB unknown size; axis_x=0x1BB920 axis_y=0x- */
/begin CHARACTERISTIC B_fam_0009_1D59C4 "RE interp_2d_B B_fam_0009 call=0x800AE18E; RE map_interp_C C_fam_0253 call=0x800" VALUE 0x1D59C4 RL_IDENTITY 0 NO_INPUT_QUANTITY 1.0 /end CHARACTERISTIC
/* src=families fam=C_fam_0320 ax=0x- ay=0x- */
/begin CHARACTERISTIC C_fam_0320_1D5ACC "RE map_interp_C C_fam_0320 call=0x800EBFBE" VALUE 0x1D5ACC RL_IDENTITY 0 NO_INPUT_QUANTITY 1.0 /end CHARACTERISTIC
/begin CHARACTERISTIC map_horsA2L_1D5AE4 "RE interp_2d fam_0002 call=0x800EC1D8; RE map_interp_D D_fam_0038 call=0x800EC1F" MAP 0x1D5AE4 RL_IDENTITY 0 NO_INPUT_QUANTITY 1.0 FORMAT "%%5.0"
 /begin AXIS_DESCR COM_AXIS NO_INPUT_QUANTITY NO_COMPU_METHOD 2 AXIS_PTS_REF AX_1A8864 /end AXIS_DESCR
 /begin AXIS_DESCR COM_AXIS NO_INPUT_QUANTITY NO_COMPU_METHOD 2 AXIS_PTS_REF AX_1AC87C /end AXIS_DESCR
/end CHARACTERISTIC
/* src=families fam=C_fam_0255 ax=0x1A2630 ay=0x- */ /* STUB unknown size; axis_x=0x1A2630 axis_y=0x- */
/begin CHARACTERISTIC C_fam_0255_1D5EC0 "RE map_interp_C C_fam_0255 call=0x80078C04" VALUE 0x1D5EC0 RL_IDENTITY 0 NO_INPUT_QUANTITY 1.0 /end CHARACTERISTIC
/* src=families fam=D_fam_0009 ax=0x1AB88C ay=0x- */ /* STUB unknown size; axis_x=0x1AB88C axis_y=0x- */
/begin CHARACTERISTIC D_fam_0009_1D5ED8 "RE map_interp_D D_fam_0009 call=0x800B0F8A; RE map_interp_I I_fam_0050 call=0x80" VALUE 0x1D5ED8 RL_IDENTITY 0 NO_INPUT_QUANTITY 1.0 /end CHARACTERISTIC
/* src=families fam=C_fam_0250 ax=0x1A63C4 ay=0x- */ /* STUB unknown size; axis_x=0x1A63C4 axis_y=0x- */
/begin CHARACTERISTIC C_fam_0250_1D5F08 "RE map_interp_C C_fam_0250 call=0x800F2B00" VALUE 0x1D5F08 RL_IDENTITY 0 NO_INPUT_QUANTITY 1.0 /end CHARACTERISTIC
/* src=families fam=C_fam_0326 ax=0x- ay=0x- */
/begin CHARACTERISTIC C_fam_0326_1D5F18 "RE map_interp_C C_fam_0326 call=0x800F3B0C" VALUE 0x1D5F18 RL_IDENTITY 0 NO_INPUT_QUANTITY 1.0 /end CHARACTERISTIC
/* src=families fam=fam_0097 ax=0x1B38C0 ay=0x19C67C */
/begin CHARACTERISTIC map_horsA2L_1D5F28 "RE interp_2d fam_0097 call=0x800F48F4" MAP 0x1D5F28 RL_IDENTITY 0 NO_INPUT_QUANTITY 1.0 FORMAT "%%5.0"
 /begin AXIS_DESCR COM_AXIS NO_INPUT_QUANTITY NO_COMPU_METHOD 2 AXIS_PTS_REF AX_1B38C0 /end AXIS_DESCR
 /begin AXIS_DESCR COM_AXIS NO_INPUT_QUANTITY NO_COMPU_METHOD 2 AXIS_PTS_REF AX_19C67C /end AXIS_DESCR
/end CHARACTERISTIC
/begin CHARACTERISTIC C_fam_0006_1D6000 "RE map_interp_C C_fam_0006 call=0x800DD9E0" VALUE 0x1D6000 RL_IDENTITY 0 NO_INPUT_QUANTITY 1.0 /end CHARACTERISTIC
/* src=families fam=C_fam_0172 ax=0x1B68D8 ay=0x- */ /* STUB unknown size; axis_x=0x1B68D8 axis_y=0x- */
/begin CHARACTERISTIC C_fam_0172_1D6020 "RE map_interp_C C_fam_0172 call=0x800DD948" VALUE 0x1D6020 RL_IDENTITY 0 NO_INPUT_QUANTITY 1.0 /end CHARACTERISTIC
/* src=families fam=C_fam_0267 ax=0x- ay=0x- */
/begin CHARACTERISTIC C_fam_0267_1D6090 "RE map_interp_C C_fam_0267 call=0x8009650A" VALUE 0x1D6090 RL_IDENTITY 0 NO_INPUT_QUANTITY 1.0 /end CHARACTERISTIC
/* src=families fam=C_fam_0264 ax=0x1A17A8 ay=0x- */ /* STUB unknown size; axis_x=0x1A17A8 axis_y=0x- */
/begin CHARACTERISTIC C_fam_0264_1D60B0 "RE map_interp_C C_fam_0264 call=0x80096320" VALUE 0x1D60B0 RL_IDENTITY 0 NO_INPUT_QUANTITY 1.0 /end CHARACTERISTIC
/* src=families fam=B_fam_0023 ax=0x1B38F8 ay=0x1A14D8 */
/begin CHARACTERISTIC B_fam_0023_1D6310 "RE interp_2d_B B_fam_0023 call=0x800BFBE0" MAP 0x1D6310 RL_IDENTITY 0 NO_INPUT_QUANTITY 1.0 FORMAT "%%5.0"
 /begin AXIS_DESCR COM_AXIS NO_INPUT_QUANTITY NO_COMPU_METHOD 2 AXIS_PTS_REF AX_1B38F8 /end AXIS_DESCR
 /begin AXIS_DESCR COM_AXIS NO_INPUT_QUANTITY NO_COMPU_METHOD 2 AXIS_PTS_REF AX_1A14D8 /end AXIS_DESCR
/end CHARACTERISTIC
/* src=families fam=B_fam_0032 ax=0x- ay=0x- */
/begin CHARACTERISTIC B_fam_0032_1D6350 "RE interp_2d_B B_fam_0032 call=0x800BFE18" VALUE 0x1D6350 RL_IDENTITY 0 NO_INPUT_QUANTITY 1.0 /end CHARACTERISTIC
/* src=families fam=fam_0132 ax=0x199614 ay=0x1A46DC */
/begin CHARACTERISTIC map_horsA2L_1D6368 "RE interp_2d fam_0132 call=0x800BFD5A" MAP 0x1D6368 RL_IDENTITY 0 NO_INPUT_QUANTITY 1.0 FORMAT "%%5.0"
 /begin AXIS_DESCR COM_AXIS NO_INPUT_QUANTITY NO_COMPU_METHOD 2 AXIS_PTS_REF AX_199614 /end AXIS_DESCR
 /begin AXIS_DESCR COM_AXIS NO_INPUT_QUANTITY NO_COMPU_METHOD 8 AXIS_PTS_REF AX_1A46DC /end AXIS_DESCR
/end CHARACTERISTIC
/* src=horsA2L fam=- ax=0x1D6438 ay=0x1D6408 */ /* STUB unknown size; axis_x=0x1D6438 axis_y=0x1D6408 */
/begin CHARACTERISTIC map_horsA2L_1D6408_1D6408 "low: pas dans l A2L/atlas 9979 (299 maps WinOLS) - nommer a la main si besoin; i" VALUE 0x1D6408 RL_IDENTITY 0 NO_INPUT_QUANTITY 1.0 /end CHARACTERISTIC
/* src=families fam=D_fam_0234 ax=0x- ay=0x- */
/begin CHARACTERISTIC D_fam_0234_1D64AC "RE map_interp_D D_fam_0234 call=0x80116564; RE map_interp_I I_fam_0123 call=0x80" VALUE 0x1D64AC RL_IDENTITY 0 NO_INPUT_QUANTITY 1.0 /end CHARACTERISTIC
/begin CHARACTERISTIC C_fam_0011_1D64C4 "RE map_interp_C C_fam_0011 call=0x80121826" VALUE 0x1D64C4 RL_IDENTITY 0 NO_INPUT_QUANTITY 1.0 /end CHARACTERISTIC
/begin CHARACTERISTIC C_fam_0011_1D64D4 "RE map_interp_C C_fam_0011 call=0x8012183E" VALUE 0x1D64D4 RL_IDENTITY 0 NO_INPUT_QUANTITY 1.0 /end CHARACTERISTIC
/begin CHARACTERISTIC C_fam_0011_1D64E4 "RE map_interp_C C_fam_0011 call=0x801217C6" VALUE 0x1D64E4 RL_IDENTITY 0 NO_INPUT_QUANTITY 1.0 /end CHARACTERISTIC
/* src=families fam=C_fam_0272 ax=0x- ay=0x- */
/begin CHARACTERISTIC C_fam_0272_1D64F4 "RE map_interp_C C_fam_0272 call=0x80121E68" VALUE 0x1D64F4 RL_IDENTITY 0 NO_INPUT_QUANTITY 1.0 /end CHARACTERISTIC
/* src=families fam=fam_0122 ax=0x- ay=0x- */
/begin CHARACTERISTIC map_horsA2L_1D6558 "RE interp_2d fam_0122 call=0x80105F66" VALUE 0x1D6558 RL_IDENTITY 0 NO_INPUT_QUANTITY 1.0 /end CHARACTERISTIC
/* src=families fam=D_fam_0185 ax=0x- ay=0x- */
/begin CHARACTERISTIC D_fam_0185_1D6610 "RE map_interp_D D_fam_0185 call=0x800BB6E2" VALUE 0x1D6610 RL_IDENTITY 0 NO_INPUT_QUANTITY 1.0 /end CHARACTERISTIC
/* src=families fam=D_fam_0186 ax=0x- ay=0x- */
/begin CHARACTERISTIC D_fam_0186_1D6630 "RE map_interp_D D_fam_0186 call=0x800BB732" VALUE 0x1D6630 RL_IDENTITY 0 NO_INPUT_QUANTITY 1.0 /end CHARACTERISTIC
/* src=families fam=C_fam_0215 ax=0x- ay=0x- */
/begin CHARACTERISTIC C_fam_0215_1D6668 "RE map_interp_C C_fam_0215 call=0x8007937E" VALUE 0x1D6668 RL_IDENTITY 0 NO_INPUT_QUANTITY 1.0 /end CHARACTERISTIC
/* src=families fam=N_fam_0029 ax=0x- ay=0x- */
/begin CHARACTERISTIC N_fam_0029_1D6674 "RE map_interp_N N_fam_0029 call=0x800D284E" VALUE 0x1D6674 RL_IDENTITY 0 NO_INPUT_QUANTITY 1.0 /end CHARACTERISTIC
/* src=families fam=M_fam_0011 ax=0x- ay=0x1A6680 */ /* STUB unknown size; axis_x=0x- axis_y=0x1A6680 */
/begin CHARACTERISTIC M_fam_0011_1D6A20 "RE map_interp_M M_fam_0011 call=0x8009DEC6" VALUE 0x1D6A20 RL_IDENTITY 0 NO_INPUT_QUANTITY 1.0 /end CHARACTERISTIC
/* src=families fam=fam_0021 ax=0x1BCA3C ay=0x- */ /* STUB unknown size; axis_x=0x1BCA3C axis_y=0x- */
/begin CHARACTERISTIC map_horsA2L_1D6EBC "RE interp_2d fam_0021 call=0x800E4172" VALUE 0x1D6EBC RL_IDENTITY 0 NO_INPUT_QUANTITY 1.0 /end CHARACTERISTIC
/* src=families fam=I_fam_0057 ax=0x1B68FC ay=0x- */
/begin CHARACTERISTIC I_fam_0057_1D6EC0 "RE map_interp_I I_fam_0057 call=0x800B100C" VALUE 0x1D6EC0 RL_IDENTITY 0 NO_INPUT_QUANTITY 1.0 /end CHARACTERISTIC
/* src=families fam=D_fam_0010 ax=0x1B68FC ay=0x- */
/begin CHARACTERISTIC D_fam_0010_1D6EE8 "RE map_interp_D D_fam_0010 call=0x800B0FE2" VALUE 0x1D6EE8 RL_IDENTITY 0 NO_INPUT_QUANTITY 1.0 /end CHARACTERISTIC
/* src=families fam=B_fam_0013 ax=0x1A4618 ay=0x1A06EC */
/begin CHARACTERISTIC B_fam_0013_1D6F58 "RE interp_2d_B B_fam_0013 call=0x800BFC5A; RE map_interp_C C_fam_0078 call=0x800" MAP 0x1D6F58 RL_IDENTITY 0 NO_INPUT_QUANTITY 1.0 FORMAT "%%5.0"
 /begin AXIS_DESCR COM_AXIS NO_INPUT_QUANTITY NO_COMPU_METHOD 2 AXIS_PTS_REF AX_1A4618 /end AXIS_DESCR
 /begin AXIS_DESCR COM_AXIS NO_INPUT_QUANTITY NO_COMPU_METHOD 20 AXIS_PTS_REF AX_1A06EC /end AXIS_DESCR
/end CHARACTERISTIC
/* src=families fam=I_fam_0118 ax=0x- ay=0x- */
/begin CHARACTERISTIC I_fam_0118_1D6F90 "RE map_interp_I I_fam_0118 call=0x800F95F4" VALUE 0x1D6F90 RL_IDENTITY 0 NO_INPUT_QUANTITY 1.0 /end CHARACTERISTIC
/* src=families fam=I_fam_0040 ax=0x1B491C ay=0x1AA9A8 */
/begin CHARACTERISTIC I_fam_0040_1D6F9C "RE map_interp_I I_fam_0040 call=0x800F95B4" MAP 0x1D6F9C RL_IDENTITY 0 NO_INPUT_QUANTITY 1.0 FORMAT "%%5.0"
 /begin AXIS_DESCR COM_AXIS NO_INPUT_QUANTITY NO_COMPU_METHOD 2 AXIS_PTS_REF AX_1B491C /end AXIS_DESCR
 /begin AXIS_DESCR COM_AXIS NO_INPUT_QUANTITY NO_COMPU_METHOD 2 AXIS_PTS_REF AX_1AA9A8 /end AXIS_DESCR
/end CHARACTERISTIC
/* src=families fam=I_fam_0119 ax=0x- ay=0x- */
/begin CHARACTERISTIC I_fam_0119_1D6FA8 "RE map_interp_I I_fam_0119 call=0x800F9614" VALUE 0x1D6FA8 RL_IDENTITY 0 NO_INPUT_QUANTITY 1.0 /end CHARACTERISTIC
/* src=families fam=I_fam_0055 ax=0x1B58E4 ay=0x- */ /* STUB unknown size; axis_x=0x1B58E4 axis_y=0x- */
/begin CHARACTERISTIC I_fam_0055_1D6FB4 "RE map_interp_I I_fam_0055 call=0x800F95D4" VALUE 0x1D6FB4 RL_IDENTITY 0 NO_INPUT_QUANTITY 1.0 /end CHARACTERISTIC
/* src=families fam=C_fam_0262 ax=0x1A176C ay=0x- */ /* STUB unknown size; axis_x=0x1A176C axis_y=0x- */
/begin CHARACTERISTIC C_fam_0262_1D7000 "RE map_interp_C C_fam_0262 call=0x800961D6" VALUE 0x1D7000 RL_IDENTITY 0 NO_INPUT_QUANTITY 1.0 /end CHARACTERISTIC
/* src=families fam=C_fam_0263 ax=0x1A2750 ay=0x- */ /* STUB unknown size; axis_x=0x1A2750 axis_y=0x- */
/begin CHARACTERISTIC C_fam_0263_1D7020 "RE map_interp_C C_fam_0263 call=0x8009628A" VALUE 0x1D7020 RL_IDENTITY 0 NO_INPUT_QUANTITY 1.0 /end CHARACTERISTIC
/* src=families fam=C_fam_0042 ax=0x1AB8F8 ay=0x- */ /* STUB unknown size; axis_x=0x1AB8F8 axis_y=0x- */
/begin CHARACTERISTIC C_fam_0042_1D7090 "RE map_interp_C C_fam_0042 call=0x800B880A" VALUE 0x1D7090 RL_IDENTITY 0 NO_INPUT_QUANTITY 1.0 /end CHARACTERISTIC
/begin CHARACTERISTIC I_fam_0001_1D70A0 "RE map_interp_I I_fam_0001 call=0x8011C4BC" VALUE 0x1D70A0 RL_IDENTITY 0 NO_INPUT_QUANTITY 1.0 /end CHARACTERISTIC
/* src=families fam=C_fam_0173 ax=0x1B78E8 ay=0x- */
/begin CHARACTERISTIC C_fam_0173_1D70B8 "RE map_interp_C C_fam_0173 call=0x8011C4FE" VALUE 0x1D70B8 RL_IDENTITY 0 NO_INPUT_QUANTITY 1.0 /end CHARACTERISTIC
/* src=families fam=F_fam_0049 ax=0x1A44D8 ay=0x1A88C4 */
/begin CHARACTERISTIC F_fam_0049_1D7118 "RE map_interp_F F_fam_0049 call=0x800876A2" MAP 0x1D7118 RL_IDENTITY 0 NO_INPUT_QUANTITY 1.0 FORMAT "%%5.0"
 /begin AXIS_DESCR COM_AXIS NO_INPUT_QUANTITY NO_COMPU_METHOD 2 AXIS_PTS_REF AX_1A44D8 /end AXIS_DESCR
 /begin AXIS_DESCR COM_AXIS NO_INPUT_QUANTITY NO_COMPU_METHOD 2 AXIS_PTS_REF AX_1A88C4 /end AXIS_DESCR
/end CHARACTERISTIC
/* src=families fam=C_fam_0166 ax=0x1B182C ay=0x- */ /* STUB unknown size; axis_x=0x1B182C axis_y=0x- */
/begin CHARACTERISTIC C_fam_0166_1D73D8 "RE map_interp_C C_fam_0166 call=0x800EEC2A" VALUE 0x1D73D8 RL_IDENTITY 0 NO_INPUT_QUANTITY 1.0 /end CHARACTERISTIC
/* src=families fam=C_fam_0165 ax=0x1B181C ay=0x- */ /* STUB unknown size; axis_x=0x1B181C axis_y=0x- */
/begin CHARACTERISTIC C_fam_0165_1D73E4 "RE map_interp_C C_fam_0165 call=0x800EEC84" VALUE 0x1D73E4 RL_IDENTITY 0 NO_INPUT_QUANTITY 1.0 /end CHARACTERISTIC
/* src=families fam=C_fam_0324 ax=0x- ay=0x- */
/begin CHARACTERISTIC C_fam_0324_1D73F0 "RE map_interp_C C_fam_0324 call=0x800F3240" VALUE 0x1D73F0 RL_IDENTITY 0 NO_INPUT_QUANTITY 1.0 /end CHARACTERISTIC
/* src=horsA2L fam=- ax=0x1D6420 ay=0x1D741C */ /* STUB unknown size; axis_x=0x1D6420 axis_y=0x1D741C */
/begin CHARACTERISTIC map_horsA2L_1D741C_1D741C "low: pas dans l A2L/atlas 9979 (299 maps WinOLS) - nommer a la main si besoin; i" VALUE 0x1D741C RL_IDENTITY 0 NO_INPUT_QUANTITY 1.0 /end CHARACTERISTIC
/begin CHARACTERISTIC fam_0008_1D7434 "RE interp_2d fam_0008 call=0x8010665C" VALUE 0x1D7434 RL_IDENTITY 0 NO_INPUT_QUANTITY 1.0 /end CHARACTERISTIC
/* src=families fam=C_fam_0234 ax=0x- ay=0x- */
/begin CHARACTERISTIC C_fam_0234_1D7480 "RE map_interp_C C_fam_0234 call=0x80121978" VALUE 0x1D7480 RL_IDENTITY 0 NO_INPUT_QUANTITY 1.0 /end CHARACTERISTIC
/* src=families fam=D_fam_0224 ax=0x- ay=0x- */
/begin CHARACTERISTIC D_fam_0224_1D749C "RE map_interp_D D_fam_0224 call=0x80100824" VALUE 0x1D749C RL_IDENTITY 0 NO_INPUT_QUANTITY 1.0 /end CHARACTERISTIC
/* src=families fam=E_fam_0077 ax=0x- ay=0x- */
/begin CHARACTERISTIC E_fam_0077_1D74C4 "RE map_interp_E E_fam_0077 call=0x80121BEE" VALUE 0x1D74C4 RL_IDENTITY 0 NO_INPUT_QUANTITY 1.0 /end CHARACTERISTIC
/* src=families fam=E_fam_0069 ax=0x- ay=0x- */
/begin CHARACTERISTIC E_fam_0069_1D74D4 "RE map_interp_E E_fam_0069 call=0x80105FE4" VALUE 0x1D74D4 RL_IDENTITY 0 NO_INPUT_QUANTITY 1.0 /end CHARACTERISTIC
/* src=families fam=fam_0179 ax=0x- ay=0x1CE440 */ /* STUB unknown size; axis_x=0x- axis_y=0x1CE440 */
/begin CHARACTERISTIC map_horsA2L_1D74EC "RE interp_2d fam_0179 call=0x80105E1E" VALUE 0x1D74EC RL_IDENTITY 0 NO_INPUT_QUANTITY 1.0 /end CHARACTERISTIC
/* src=families fam=D_fam_0162 ax=0x- ay=0x- */
/begin CHARACTERISTIC D_fam_0162_1D75B8 "RE map_interp_D D_fam_0162 call=0x80093B8C" VALUE 0x1D75B8 RL_IDENTITY 0 NO_INPUT_QUANTITY 1.0 /end CHARACTERISTIC
/* src=families fam=D_fam_0187 ax=0x- ay=0x- */
/begin CHARACTERISTIC D_fam_0187_1D762C "RE map_interp_D D_fam_0187 call=0x800BB782" VALUE 0x1D762C RL_IDENTITY 0 NO_INPUT_QUANTITY 1.0 /end CHARACTERISTIC
/* src=families fam=N_fam_0009 ax=0x1AC814 ay=0x1AC814 */
/begin CHARACTERISTIC N_fam_0009_1D7640 "RE map_interp_N N_fam_0009 call=0x800D27DE" MAP 0x1D7640 RL_IDENTITY 0 NO_INPUT_QUANTITY 1.0 FORMAT "%%5.0"
 /begin AXIS_DESCR COM_AXIS NO_INPUT_QUANTITY NO_COMPU_METHOD 2 AXIS_PTS_REF AX_1AC814 /end AXIS_DESCR
 /begin AXIS_DESCR COM_AXIS NO_INPUT_QUANTITY NO_COMPU_METHOD 2 AXIS_PTS_REF AX_1AC814 /end AXIS_DESCR
/end CHARACTERISTIC
/* src=families fam=G_fam_0097 ax=0x- ay=0x- */
/begin CHARACTERISTIC G_fam_0097_1D764C "RE map_interp_G G_fam_0097 call=0x80093AA0" VALUE 0x1D764C RL_IDENTITY 0 NO_INPUT_QUANTITY 1.0 /end CHARACTERISTIC
/* src=families fam=G_fam_0099 ax=0x- ay=0x- */
/begin CHARACTERISTIC G_fam_0099_1D7688 "RE map_interp_G G_fam_0099 call=0x80093C9C" VALUE 0x1D7688 RL_IDENTITY 0 NO_INPUT_QUANTITY 1.0 /end CHARACTERISTIC
/* src=families fam=H_fam_0090 ax=0x- ay=0x- */
/begin CHARACTERISTIC H_fam_0090_1D771C "RE map_interp_H H_fam_0090 call=0x8009923E" VALUE 0x1D771C RL_IDENTITY 0 NO_INPUT_QUANTITY 1.0 /end CHARACTERISTIC
/* src=families fam=I_fam_0016 ax=0x- ay=0x- */
/begin CHARACTERISTIC I_fam_0016_1D77D4 "RE map_interp_I I_fam_0016 call=0x800973AA" VALUE 0x1D77D4 RL_IDENTITY 0 NO_INPUT_QUANTITY 1.0 /end CHARACTERISTIC
/* src=families fam=C_fam_0221 ax=0x1A5674 ay=0x- */ /* STUB unknown size; axis_x=0x1A5674 axis_y=0x- */
/begin CHARACTERISTIC C_fam_0221_1D786C "RE map_interp_C C_fam_0221 call=0x800D6A00" VALUE 0x1D786C RL_IDENTITY 0 NO_INPUT_QUANTITY 1.0 /end CHARACTERISTIC
/* src=families fam=C_fam_0040 ax=0x1AC8F0 ay=0x- */ /* STUB unknown size; axis_x=0x1AC8F0 axis_y=0x- */
/begin CHARACTERISTIC C_fam_0040_1D787C "RE map_interp_C C_fam_0040 call=0x800D61D4" VALUE 0x1D787C RL_IDENTITY 0 NO_INPUT_QUANTITY 1.0 /end CHARACTERISTIC
/* src=families fam=C_fam_0063 ax=0x1A2504 ay=0x1B76F0 */
/begin CHARACTERISTIC C_fam_0063_1D78A4 "RE map_interp_C C_fam_0063 call=0x800EB290" MAP 0x1D78A4 RL_IDENTITY 0 NO_INPUT_QUANTITY 1.0 FORMAT "%%5.0"
 /begin AXIS_DESCR COM_AXIS NO_INPUT_QUANTITY NO_COMPU_METHOD 2 AXIS_PTS_REF AX_1A2504 /end AXIS_DESCR
 /begin AXIS_DESCR COM_AXIS NO_INPUT_QUANTITY NO_COMPU_METHOD 2 AXIS_PTS_REF AX_1B76F0 /end AXIS_DESCR
/end CHARACTERISTIC
/* src=families fam=B_fam_0039 ax=0x- ay=0x- */
/begin CHARACTERISTIC B_fam_0039_1D78BC "RE interp_2d_B B_fam_0039 call=0x800876F2; RE map_interp_D D_fam_0140 call=0x800" VALUE 0x1D78BC RL_IDENTITY 0 NO_INPUT_QUANTITY 1.0 /end CHARACTERISTIC
/* src=families fam=E_fam_0103 ax=0x- ay=0x- */
/begin CHARACTERISTIC E_fam_0103_1D79D0 "RE map_interp_E E_fam_0103 call=0x800B3DC8" VALUE 0x1D79D0 RL_IDENTITY 0 NO_INPUT_QUANTITY 1.0 /end CHARACTERISTIC
/* src=families fam=E_fam_0097 ax=0x- ay=0x- */
/begin CHARACTERISTIC E_fam_0097_1D79DC "RE map_interp_E E_fam_0097 call=0x8009AC58" VALUE 0x1D79DC RL_IDENTITY 0 NO_INPUT_QUANTITY 1.0 /end CHARACTERISTIC
/* src=families fam=C_fam_0092 ax=0x1A9730 ay=0x1A6524 */
/begin CHARACTERISTIC C_fam_0092_1D79E8 "RE map_interp_C C_fam_0092 call=0x800DDE24" MAP 0x1D79E8 RL_IDENTITY 0 NO_INPUT_QUANTITY 1.0 FORMAT "%%5.0"
 /begin AXIS_DESCR COM_AXIS NO_INPUT_QUANTITY NO_COMPU_METHOD 2 AXIS_PTS_REF AX_1A9730 /end AXIS_DESCR
 /begin AXIS_DESCR COM_AXIS NO_INPUT_QUANTITY NO_COMPU_METHOD 2 AXIS_PTS_REF AX_1A6524 /end AXIS_DESCR
/end CHARACTERISTIC
/* src=families fam=C_fam_0150 ax=0x1A73FC ay=0x- */ /* STUB unknown size; axis_x=0x1A73FC axis_y=0x- */
/begin CHARACTERISTIC C_fam_0150_1D79F8 "RE map_interp_C C_fam_0150 call=0x800F33DA" VALUE 0x1D79F8 RL_IDENTITY 0 NO_INPUT_QUANTITY 1.0 /end CHARACTERISTIC
/* src=families fam=M_fam_0016 ax=0x- ay=0x- */
/begin CHARACTERISTIC M_fam_0016_1D7A28 "RE map_interp_M M_fam_0016 call=0x801182BC" VALUE 0x1D7A28 RL_IDENTITY 0 NO_INPUT_QUANTITY 1.0 /end CHARACTERISTIC
/begin CHARACTERISTIC map_horsA2L_1D7AE4 "RE interp_2d fam_0002 call=0x800EC198" MAP 0x1D7AE4 RL_IDENTITY 0 NO_INPUT_QUANTITY 1.0 FORMAT "%%5.0"
 /begin AXIS_DESCR COM_AXIS NO_INPUT_QUANTITY NO_COMPU_METHOD 2 AXIS_PTS_REF AX_1A8864 /end AXIS_DESCR
 /begin AXIS_DESCR COM_AXIS NO_INPUT_QUANTITY NO_COMPU_METHOD 2 AXIS_PTS_REF AX_1AC87C /end AXIS_DESCR
/end CHARACTERISTIC
/* src=families fam=F_fam_0071 ax=0x1A0610 ay=0x- */
/begin CHARACTERISTIC F_fam_0071_1D7D64 "RE map_interp_F F_fam_0071 call=0x800E2E32" VALUE 0x1D7D64 RL_IDENTITY 0 NO_INPUT_QUANTITY 1.0 /end CHARACTERISTIC
/* src=atlas9979 fam=- ax=0x1D65CE ay=0x1D5880 */
/begin CHARACTERISTIC nm2iq_base_mg3A "atlas9979 nm2iq_base_mg3A / Torque to fuel quantity injected conversion (IdName " MAP 0x1D7E38 RL_IDENTITY 0 NO_INPUT_QUANTITY 1.0 FORMAT "%%5.0"
 /begin AXIS_DESCR COM_AXIS NO_INPUT_QUANTITY NO_COMPU_METHOD 16 AXIS_PTS_REF AX_1D65CE /end AXIS_DESCR
 /begin AXIS_DESCR COM_AXIS NO_INPUT_QUANTITY NO_COMPU_METHOD 20 AXIS_PTS_REF AX_1D5880 /end AXIS_DESCR
/end CHARACTERISTIC
/* src=families fam=D_fam_0010 ax=0x1B68FC ay=0x- */
/begin CHARACTERISTIC D_fam_0010_1D7ED0 "RE map_interp_D D_fam_0010 call=0x800B1000" VALUE 0x1D7ED0 RL_IDENTITY 0 NO_INPUT_QUANTITY 1.0 /end CHARACTERISTIC
/* src=families fam=D_fam_0045 ax=0x1AB88C ay=0x1B68FC */
/begin CHARACTERISTIC D_fam_0045_1D7EF8 "RE map_interp_D D_fam_0045 call=0x800B0FB8" MAP 0x1D7EF8 RL_IDENTITY 0 NO_INPUT_QUANTITY 1.0 FORMAT "%%5.0"
 /begin AXIS_DESCR COM_AXIS NO_INPUT_QUANTITY NO_COMPU_METHOD 2 AXIS_PTS_REF AX_1AB88C /end AXIS_DESCR
 /begin AXIS_DESCR COM_AXIS NO_INPUT_QUANTITY NO_COMPU_METHOD 2 AXIS_PTS_REF AX_1B68FC /end AXIS_DESCR
/end CHARACTERISTIC
/* src=atlas9979 fam=- ax=0x1D65F0 ay=0x1D5880 */
/begin CHARACTERISTIC nm2iq_base_mg3A_1D80B8 "atlas9979 nm2iq_base_mg3A@1D80B8 / Torque to fuel quantity injected conversion (" MAP 0x1D80B8 RL_IDENTITY 0 NO_INPUT_QUANTITY 1.0 FORMAT "%%5.0"
 /begin AXIS_DESCR COM_AXIS NO_INPUT_QUANTITY NO_COMPU_METHOD 16 AXIS_PTS_REF AX_1D65F0 /end AXIS_DESCR
 /begin AXIS_DESCR COM_AXIS NO_INPUT_QUANTITY NO_COMPU_METHOD 20 AXIS_PTS_REF AX_1D5880 /end AXIS_DESCR
/end CHARACTERISTIC
/* src=atlas9979 fam=- ax=0x1D6612 ay=0x1D5880 */
/begin CHARACTERISTIC nm2iq_base_mg3A_1D8338 "atlas9979 nm2iq_base_mg3A@1D8338 / Torque to fuel quantity injected conversion (" MAP 0x1D8338 RL_IDENTITY 0 NO_INPUT_QUANTITY 1.0 FORMAT "%%5.0"
 /begin AXIS_DESCR COM_AXIS NO_INPUT_QUANTITY NO_COMPU_METHOD 16 AXIS_PTS_REF AX_1D6612 /end AXIS_DESCR
 /begin AXIS_DESCR COM_AXIS NO_INPUT_QUANTITY NO_COMPU_METHOD 20 AXIS_PTS_REF AX_1D5880 /end AXIS_DESCR
/end CHARACTERISTIC
/* src=atlas9979 fam=- ax=0x1D6634 ay=0x1D5880 */
/begin CHARACTERISTIC nm2iq_base_mg3A_1D85B8 "atlas9979 nm2iq_base_mg3A@1D85B8 / Torque to fuel quantity injected conversion (" MAP 0x1D85B8 RL_IDENTITY 0 NO_INPUT_QUANTITY 1.0 FORMAT "%%5.0"
 /begin AXIS_DESCR COM_AXIS NO_INPUT_QUANTITY NO_COMPU_METHOD 16 AXIS_PTS_REF AX_1D6634 /end AXIS_DESCR
 /begin AXIS_DESCR COM_AXIS NO_INPUT_QUANTITY NO_COMPU_METHOD 20 AXIS_PTS_REF AX_1D5880 /end AXIS_DESCR
/end CHARACTERISTIC
/* src=atlas9979 fam=- ax=0x1D6656 ay=0x1D5880 */
/begin CHARACTERISTIC nm2iq_base_mg3A_1D8838 "atlas9979 nm2iq_base_mg3A@1D8838 / Torque to fuel quantity injected conversion (" MAP 0x1D8838 RL_IDENTITY 0 NO_INPUT_QUANTITY 1.0 FORMAT "%%5.0"
 /begin AXIS_DESCR COM_AXIS NO_INPUT_QUANTITY NO_COMPU_METHOD 16 AXIS_PTS_REF AX_1D6656 /end AXIS_DESCR
 /begin AXIS_DESCR COM_AXIS NO_INPUT_QUANTITY NO_COMPU_METHOD 20 AXIS_PTS_REF AX_1D5880 /end AXIS_DESCR
/end CHARACTERISTIC
/* src=atlas9979 fam=- ax=0x1D6678 ay=0x1D5880 */
/begin CHARACTERISTIC nm2iq_base_mg3A_1D8AB8 "atlas9979 nm2iq_base_mg3A@1D8AB8 / Torque to fuel quantity injected conversion (" MAP 0x1D8AB8 RL_IDENTITY 0 NO_INPUT_QUANTITY 1.0 FORMAT "%%5.0"
 /begin AXIS_DESCR COM_AXIS NO_INPUT_QUANTITY NO_COMPU_METHOD 16 AXIS_PTS_REF AX_1D6678 /end AXIS_DESCR
 /begin AXIS_DESCR COM_AXIS NO_INPUT_QUANTITY NO_COMPU_METHOD 20 AXIS_PTS_REF AX_1D5880 /end AXIS_DESCR
/end CHARACTERISTIC
/* src=atlas9979 fam=- ax=0x1D669A ay=0x1D5880 */
/begin CHARACTERISTIC nm2iq_base_mg3A_1D8D38 "atlas9979 nm2iq_base_mg3A@1D8D38 / Torque to fuel quantity injected conversion (" MAP 0x1D8D38 RL_IDENTITY 0 NO_INPUT_QUANTITY 1.0 FORMAT "%%5.0"
 /begin AXIS_DESCR COM_AXIS NO_INPUT_QUANTITY NO_COMPU_METHOD 16 AXIS_PTS_REF AX_1D669A /end AXIS_DESCR
 /begin AXIS_DESCR COM_AXIS NO_INPUT_QUANTITY NO_COMPU_METHOD 20 AXIS_PTS_REF AX_1D5880 /end AXIS_DESCR
/end CHARACTERISTIC
/* src=atlas9979 fam=- ax=0x1D669A ay=0x1D5880 */
/begin CHARACTERISTIC nm2iq_base_mg3A_1D8FB8 "atlas9979 nm2iq_base_mg3A@1D8FB8 / Torque to fuel quantity injected conversion (" MAP 0x1D8FB8 RL_IDENTITY 0 NO_INPUT_QUANTITY 1.0 FORMAT "%%5.0"
 /begin AXIS_DESCR COM_AXIS NO_INPUT_QUANTITY NO_COMPU_METHOD 16 AXIS_PTS_REF AX_1D669A /end AXIS_DESCR
 /begin AXIS_DESCR COM_AXIS NO_INPUT_QUANTITY NO_COMPU_METHOD 20 AXIS_PTS_REF AX_1D5880 /end AXIS_DESCR
/end CHARACTERISTIC
/* src=atlas9979 fam=- ax=0x1D66BC ay=0x1D5880 */
/begin CHARACTERISTIC nm2iq_base_mg3A_1D9238 "atlas9979 nm2iq_base_mg3A@1D9238 / Torque to fuel quantity injected conversion (" MAP 0x1D9238 RL_IDENTITY 0 NO_INPUT_QUANTITY 1.0 FORMAT "%%5.0"
 /begin AXIS_DESCR COM_AXIS NO_INPUT_QUANTITY NO_COMPU_METHOD 16 AXIS_PTS_REF AX_1D66BC /end AXIS_DESCR
 /begin AXIS_DESCR COM_AXIS NO_INPUT_QUANTITY NO_COMPU_METHOD 20 AXIS_PTS_REF AX_1D5880 /end AXIS_DESCR
/end CHARACTERISTIC
/* src=atlas9979 fam=- ax=0x1D66DE ay=0x1D5880 */
/begin CHARACTERISTIC nm2iq_base_mg3A_1D94B8 "atlas9979 nm2iq_base_mg3A@1D94B8 / Torque to fuel quantity injected conversion (" MAP 0x1D94B8 RL_IDENTITY 0 NO_INPUT_QUANTITY 1.0 FORMAT "%%5.0"
 /begin AXIS_DESCR COM_AXIS NO_INPUT_QUANTITY NO_COMPU_METHOD 16 AXIS_PTS_REF AX_1D66DE /end AXIS_DESCR
 /begin AXIS_DESCR COM_AXIS NO_INPUT_QUANTITY NO_COMPU_METHOD 20 AXIS_PTS_REF AX_1D5880 /end AXIS_DESCR
/end CHARACTERISTIC
/* src=atlas9979 fam=- ax=0x1D6700 ay=0x1D5880 */
/begin CHARACTERISTIC nm2iq_base_mg3A_1D9738 "atlas9979 nm2iq_base_mg3A@1D9738 / Torque to fuel quantity injected conversion (" MAP 0x1D9738 RL_IDENTITY 0 NO_INPUT_QUANTITY 1.0 FORMAT "%%5.0"
 /begin AXIS_DESCR COM_AXIS NO_INPUT_QUANTITY NO_COMPU_METHOD 16 AXIS_PTS_REF AX_1D6700 /end AXIS_DESCR
 /begin AXIS_DESCR COM_AXIS NO_INPUT_QUANTITY NO_COMPU_METHOD 20 AXIS_PTS_REF AX_1D5880 /end AXIS_DESCR
/end CHARACTERISTIC
/* src=atlas9979 fam=- ax=0x1D6722 ay=0x1D5880 */
/begin CHARACTERISTIC nm2iq_base_mg3A_1D99B8 "atlas9979 nm2iq_base_mg3A@1D99B8 / Torque to fuel quantity injected conversion (" MAP 0x1D99B8 RL_IDENTITY 0 NO_INPUT_QUANTITY 1.0 FORMAT "%%5.0"
 /begin AXIS_DESCR COM_AXIS NO_INPUT_QUANTITY NO_COMPU_METHOD 16 AXIS_PTS_REF AX_1D6722 /end AXIS_DESCR
 /begin AXIS_DESCR COM_AXIS NO_INPUT_QUANTITY NO_COMPU_METHOD 20 AXIS_PTS_REF AX_1D5880 /end AXIS_DESCR
/end CHARACTERISTIC
/* src=atlas9979 fam=- ax=0x1D6744 ay=0x1D5880 */
/begin CHARACTERISTIC nm2iq_base_mg3A_1D9C38 "atlas9979 nm2iq_base_mg3A@1D9C38 / Torque to fuel quantity injected conversion (" MAP 0x1D9C38 RL_IDENTITY 0 NO_INPUT_QUANTITY 1.0 FORMAT "%%5.0"
 /begin AXIS_DESCR COM_AXIS NO_INPUT_QUANTITY NO_COMPU_METHOD 16 AXIS_PTS_REF AX_1D6744 /end AXIS_DESCR
 /begin AXIS_DESCR COM_AXIS NO_INPUT_QUANTITY NO_COMPU_METHOD 20 AXIS_PTS_REF AX_1D5880 /end AXIS_DESCR
/end CHARACTERISTIC
/* src=atlas9979 fam=- ax=0x1D6766 ay=0x1D5880 */
/begin CHARACTERISTIC nm2iq_base_mg3A_1D9EB8 "atlas9979 nm2iq_base_mg3A@1D9EB8 / Torque to fuel quantity injected conversion (" MAP 0x1D9EB8 RL_IDENTITY 0 NO_INPUT_QUANTITY 1.0 FORMAT "%%5.0"
 /begin AXIS_DESCR COM_AXIS NO_INPUT_QUANTITY NO_COMPU_METHOD 16 AXIS_PTS_REF AX_1D6766 /end AXIS_DESCR
 /begin AXIS_DESCR COM_AXIS NO_INPUT_QUANTITY NO_COMPU_METHOD 20 AXIS_PTS_REF AX_1D5880 /end AXIS_DESCR
/end CHARACTERISTIC
/* src=atlas9979 fam=- ax=0x1D6788 ay=0x1D5880 */
/begin CHARACTERISTIC nm2iq_base_mg3A_1DA138 "atlas9979 nm2iq_base_mg3A@1DA138 / Torque to fuel quantity injected conversion (" MAP 0x1DA138 RL_IDENTITY 0 NO_INPUT_QUANTITY 1.0 FORMAT "%%5.0"
 /begin AXIS_DESCR COM_AXIS NO_INPUT_QUANTITY NO_COMPU_METHOD 16 AXIS_PTS_REF AX_1D6788 /end AXIS_DESCR
 /begin AXIS_DESCR COM_AXIS NO_INPUT_QUANTITY NO_COMPU_METHOD 20 AXIS_PTS_REF AX_1D5880 /end AXIS_DESCR
/end CHARACTERISTIC
/* src=atlas9979 fam=- ax=0x1D67AA ay=0x1D5880 */
/begin CHARACTERISTIC nm2iq_base_mg3A_1DA3B8 "atlas9979 nm2iq_base_mg3A@1DA3B8 / Torque to fuel quantity injected conversion (" MAP 0x1DA3B8 RL_IDENTITY 0 NO_INPUT_QUANTITY 1.0 FORMAT "%%5.0"
 /begin AXIS_DESCR COM_AXIS NO_INPUT_QUANTITY NO_COMPU_METHOD 16 AXIS_PTS_REF AX_1D67AA /end AXIS_DESCR
 /begin AXIS_DESCR COM_AXIS NO_INPUT_QUANTITY NO_COMPU_METHOD 20 AXIS_PTS_REF AX_1D5880 /end AXIS_DESCR
/end CHARACTERISTIC
/* src=atlas9979 fam=- ax=0x1D67CC ay=0x1D5880 */
/begin CHARACTERISTIC nm2iq_base_mg3A_1DA638 "atlas9979 nm2iq_base_mg3A@1DA638 / Torque to fuel quantity injected conversion (" MAP 0x1DA638 RL_IDENTITY 0 NO_INPUT_QUANTITY 1.0 FORMAT "%%5.0"
 /begin AXIS_DESCR COM_AXIS NO_INPUT_QUANTITY NO_COMPU_METHOD 16 AXIS_PTS_REF AX_1D67CC /end AXIS_DESCR
 /begin AXIS_DESCR COM_AXIS NO_INPUT_QUANTITY NO_COMPU_METHOD 20 AXIS_PTS_REF AX_1D5880 /end AXIS_DESCR
/end CHARACTERISTIC
/* src=atlas9979 fam=- ax=0x1D67EE ay=0x1D5880 */
/begin CHARACTERISTIC nm2iq_base_mg3A_1DA8B8 "atlas9979 nm2iq_base_mg3A@1DA8B8 / Torque to fuel quantity injected conversion (" MAP 0x1DA8B8 RL_IDENTITY 0 NO_INPUT_QUANTITY 1.0 FORMAT "%%5.0"
 /begin AXIS_DESCR COM_AXIS NO_INPUT_QUANTITY NO_COMPU_METHOD 16 AXIS_PTS_REF AX_1D67EE /end AXIS_DESCR
 /begin AXIS_DESCR COM_AXIS NO_INPUT_QUANTITY NO_COMPU_METHOD 20 AXIS_PTS_REF AX_1D5880 /end AXIS_DESCR
/end CHARACTERISTIC
/* src=atlas9979 fam=- ax=0x1D6810 ay=0x1D5880 */
/begin CHARACTERISTIC nm2iq_base_mg3A_1DAB38 "atlas9979 nm2iq_base_mg3A@1DAB38 / Torque to fuel quantity injected conversion (" MAP 0x1DAB38 RL_IDENTITY 0 NO_INPUT_QUANTITY 1.0 FORMAT "%%5.0"
 /begin AXIS_DESCR COM_AXIS NO_INPUT_QUANTITY NO_COMPU_METHOD 16 AXIS_PTS_REF AX_1D6810 /end AXIS_DESCR
 /begin AXIS_DESCR COM_AXIS NO_INPUT_QUANTITY NO_COMPU_METHOD 20 AXIS_PTS_REF AX_1D5880 /end AXIS_DESCR
/end CHARACTERISTIC
/* src=atlas9979 fam=- ax=0x1D6832 ay=0x1D5880 */
/begin CHARACTERISTIC nm2iq_base_mg3A_1DADB8 "atlas9979 nm2iq_base_mg3A@1DADB8 / Torque to fuel quantity injected conversion (" MAP 0x1DADB8 RL_IDENTITY 0 NO_INPUT_QUANTITY 1.0 FORMAT "%%5.0"
 /begin AXIS_DESCR COM_AXIS NO_INPUT_QUANTITY NO_COMPU_METHOD 16 AXIS_PTS_REF AX_1D6832 /end AXIS_DESCR
 /begin AXIS_DESCR COM_AXIS NO_INPUT_QUANTITY NO_COMPU_METHOD 20 AXIS_PTS_REF AX_1D5880 /end AXIS_DESCR
/end CHARACTERISTIC
/* src=atlas9979 fam=- ax=0x1D6854 ay=0x1D5880 */
/begin CHARACTERISTIC nm2iq_base_mg3A_1DB038 "atlas9979 nm2iq_base_mg3A@1DB038 / Torque to fuel quantity injected conversion (" MAP 0x1DB038 RL_IDENTITY 0 NO_INPUT_QUANTITY 1.0 FORMAT "%%5.0"
 /begin AXIS_DESCR COM_AXIS NO_INPUT_QUANTITY NO_COMPU_METHOD 16 AXIS_PTS_REF AX_1D6854 /end AXIS_DESCR
 /begin AXIS_DESCR COM_AXIS NO_INPUT_QUANTITY NO_COMPU_METHOD 20 AXIS_PTS_REF AX_1D5880 /end AXIS_DESCR
/end CHARACTERISTIC
/* src=atlas9979 fam=- ax=0x1D6876 ay=0x1D5880 */
/begin CHARACTERISTIC nm2iq_base_mg3A_1DB2B8 "atlas9979 nm2iq_base_mg3A@1DB2B8 / Torque to fuel quantity injected conversion (" MAP 0x1DB2B8 RL_IDENTITY 0 NO_INPUT_QUANTITY 1.0 FORMAT "%%5.0"
 /begin AXIS_DESCR COM_AXIS NO_INPUT_QUANTITY NO_COMPU_METHOD 16 AXIS_PTS_REF AX_1D6876 /end AXIS_DESCR
 /begin AXIS_DESCR COM_AXIS NO_INPUT_QUANTITY NO_COMPU_METHOD 20 AXIS_PTS_REF AX_1D5880 /end AXIS_DESCR
/end CHARACTERISTIC
/* src=atlas9979 fam=- ax=0x1D6898 ay=0x1D5880 */
/begin CHARACTERISTIC nm2iq_base_mg3A_1DB538 "atlas9979 nm2iq_base_mg3A@1DB538 / Torque to fuel quantity injected conversion (" MAP 0x1DB538 RL_IDENTITY 0 NO_INPUT_QUANTITY 1.0 FORMAT "%%5.0"
 /begin AXIS_DESCR COM_AXIS NO_INPUT_QUANTITY NO_COMPU_METHOD 16 AXIS_PTS_REF AX_1D6898 /end AXIS_DESCR
 /begin AXIS_DESCR COM_AXIS NO_INPUT_QUANTITY NO_COMPU_METHOD 20 AXIS_PTS_REF AX_1D5880 /end AXIS_DESCR
/end CHARACTERISTIC
/* src=atlas9979 fam=- ax=0x1D68BA ay=0x1D5880 */
/begin CHARACTERISTIC nm2iq_base_mg3A_1DB7B8 "atlas9979 nm2iq_base_mg3A@1DB7B8 / Torque to fuel quantity injected conversion (" MAP 0x1DB7B8 RL_IDENTITY 0 NO_INPUT_QUANTITY 1.0 FORMAT "%%5.0"
 /begin AXIS_DESCR COM_AXIS NO_INPUT_QUANTITY NO_COMPU_METHOD 16 AXIS_PTS_REF AX_1D68BA /end AXIS_DESCR
 /begin AXIS_DESCR COM_AXIS NO_INPUT_QUANTITY NO_COMPU_METHOD 20 AXIS_PTS_REF AX_1D5880 /end AXIS_DESCR
/end CHARACTERISTIC
/* src=atlas9979 fam=- ax=0x1D68DC ay=0x1D5880 */
/begin CHARACTERISTIC nm2iq_base_mg3A_1DBA38 "atlas9979 nm2iq_base_mg3A@1DBA38 / Torque to fuel quantity injected conversion (" MAP 0x1DBA38 RL_IDENTITY 0 NO_INPUT_QUANTITY 1.0 FORMAT "%%5.0"
 /begin AXIS_DESCR COM_AXIS NO_INPUT_QUANTITY NO_COMPU_METHOD 16 AXIS_PTS_REF AX_1D68DC /end AXIS_DESCR
 /begin AXIS_DESCR COM_AXIS NO_INPUT_QUANTITY NO_COMPU_METHOD 20 AXIS_PTS_REF AX_1D5880 /end AXIS_DESCR
/end CHARACTERISTIC
/* src=atlas9979 fam=- ax=0x1D68FE ay=0x1D5880 */
/begin CHARACTERISTIC nm2iq_base_mg3A_1DBCB8 "atlas9979 nm2iq_base_mg3A@1DBCB8 / Torque to fuel quantity injected conversion (" MAP 0x1DBCB8 RL_IDENTITY 0 NO_INPUT_QUANTITY 1.0 FORMAT "%%5.0"
 /begin AXIS_DESCR COM_AXIS NO_INPUT_QUANTITY NO_COMPU_METHOD 16 AXIS_PTS_REF AX_1D68FE /end AXIS_DESCR
 /begin AXIS_DESCR COM_AXIS NO_INPUT_QUANTITY NO_COMPU_METHOD 20 AXIS_PTS_REF AX_1D5880 /end AXIS_DESCR
/end CHARACTERISTIC
/* src=atlas9979 fam=- ax=0x1D6920 ay=0x1D5880 */
/begin CHARACTERISTIC nm2iq_base_mg3A_1DBF38 "atlas9979 nm2iq_base_mg3A@1DBF38 / Torque to fuel quantity injected conversion (" MAP 0x1DBF38 RL_IDENTITY 0 NO_INPUT_QUANTITY 1.0 FORMAT "%%5.0"
 /begin AXIS_DESCR COM_AXIS NO_INPUT_QUANTITY NO_COMPU_METHOD 16 AXIS_PTS_REF AX_1D6920 /end AXIS_DESCR
 /begin AXIS_DESCR COM_AXIS NO_INPUT_QUANTITY NO_COMPU_METHOD 20 AXIS_PTS_REF AX_1D5880 /end AXIS_DESCR
/end CHARACTERISTIC
/* src=atlas9979 fam=- ax=0x1D6942 ay=0x1D59A6 */
/begin CHARACTERISTIC nm2iq_base_mg3A_1DC938 "atlas9979 nm2iq_base_mg3A@1DC938 / Torque to fuel quantity injected conversion (" MAP 0x1DC938 RL_IDENTITY 0 NO_INPUT_QUANTITY 1.0 FORMAT "%%5.0"
 /begin AXIS_DESCR COM_AXIS NO_INPUT_QUANTITY NO_COMPU_METHOD 16 AXIS_PTS_REF AX_1D6942 /end AXIS_DESCR
 /begin AXIS_DESCR COM_AXIS NO_INPUT_QUANTITY NO_COMPU_METHOD 20 AXIS_PTS_REF AX_1D59A6 /end AXIS_DESCR
/end CHARACTERISTIC
/* src=atlas9979 fam=- ax=0x1D6964 ay=0x1D59A6 */
/begin CHARACTERISTIC nm2iq_base_mg3A_1DCBB8 "atlas9979 nm2iq_base_mg3A@1DCBB8 / Torque to fuel quantity injected conversion (" MAP 0x1DCBB8 RL_IDENTITY 0 NO_INPUT_QUANTITY 1.0 FORMAT "%%5.0"
 /begin AXIS_DESCR COM_AXIS NO_INPUT_QUANTITY NO_COMPU_METHOD 16 AXIS_PTS_REF AX_1D6964 /end AXIS_DESCR
 /begin AXIS_DESCR COM_AXIS NO_INPUT_QUANTITY NO_COMPU_METHOD 20 AXIS_PTS_REF AX_1D59A6 /end AXIS_DESCR
/end CHARACTERISTIC
/* src=atlas9979 fam=- ax=0x1D6986 ay=0x1D59A6 */
/begin CHARACTERISTIC nm2iq_base_mg3A_1DCE38 "atlas9979 nm2iq_base_mg3A@1DCE38 / Torque to fuel quantity injected conversion (" MAP 0x1DCE38 RL_IDENTITY 0 NO_INPUT_QUANTITY 1.0 FORMAT "%%5.0"
 /begin AXIS_DESCR COM_AXIS NO_INPUT_QUANTITY NO_COMPU_METHOD 16 AXIS_PTS_REF AX_1D6986 /end AXIS_DESCR
 /begin AXIS_DESCR COM_AXIS NO_INPUT_QUANTITY NO_COMPU_METHOD 20 AXIS_PTS_REF AX_1D59A6 /end AXIS_DESCR
/end CHARACTERISTIC
/* src=atlas9979 fam=- ax=0x1D69A8 ay=0x1D59A6 */
/begin CHARACTERISTIC nm2iq_base_mg3A_1DD0B8 "atlas9979 nm2iq_base_mg3A@1DD0B8 / Torque to fuel quantity injected conversion (" MAP 0x1DD0B8 RL_IDENTITY 0 NO_INPUT_QUANTITY 1.0 FORMAT "%%5.0"
 /begin AXIS_DESCR COM_AXIS NO_INPUT_QUANTITY NO_COMPU_METHOD 16 AXIS_PTS_REF AX_1D69A8 /end AXIS_DESCR
 /begin AXIS_DESCR COM_AXIS NO_INPUT_QUANTITY NO_COMPU_METHOD 20 AXIS_PTS_REF AX_1D59A6 /end AXIS_DESCR
/end CHARACTERISTIC
/* src=atlas9979 fam=- ax=0x1D69CA ay=0x1D59A6 */
/begin CHARACTERISTIC nm2iq_base_mg3A_1DD338 "atlas9979 nm2iq_base_mg3A@1DD338 / Torque to fuel quantity injected conversion (" MAP 0x1DD338 RL_IDENTITY 0 NO_INPUT_QUANTITY 1.0 FORMAT "%%5.0"
 /begin AXIS_DESCR COM_AXIS NO_INPUT_QUANTITY NO_COMPU_METHOD 16 AXIS_PTS_REF AX_1D69CA /end AXIS_DESCR
 /begin AXIS_DESCR COM_AXIS NO_INPUT_QUANTITY NO_COMPU_METHOD 20 AXIS_PTS_REF AX_1D59A6 /end AXIS_DESCR
/end CHARACTERISTIC
/* src=atlas9979 fam=- ax=0x1D69EC ay=0x1D59A6 */
/begin CHARACTERISTIC nm2iq_base_mg3A_1DD5B8 "atlas9979 nm2iq_base_mg3A@1DD5B8 / Torque to fuel quantity injected conversion (" MAP 0x1DD5B8 RL_IDENTITY 0 NO_INPUT_QUANTITY 1.0 FORMAT "%%5.0"
 /begin AXIS_DESCR COM_AXIS NO_INPUT_QUANTITY NO_COMPU_METHOD 16 AXIS_PTS_REF AX_1D69EC /end AXIS_DESCR
 /begin AXIS_DESCR COM_AXIS NO_INPUT_QUANTITY NO_COMPU_METHOD 20 AXIS_PTS_REF AX_1D59A6 /end AXIS_DESCR
/end CHARACTERISTIC
/* src=families fam=F_fam_0124 ax=0x- ay=0x- */
/begin CHARACTERISTIC F_fam_0124_1E0238 "RE map_interp_F F_fam_0124 call=0x80093CC6" VALUE 0x1E0238 RL_IDENTITY 0 NO_INPUT_QUANTITY 1.0 /end CHARACTERISTIC
/* src=families fam=F_fam_0126 ax=0x- ay=0x- */
/begin CHARACTERISTIC F_fam_0126_1E0738 "RE map_interp_F F_fam_0126 call=0x80093DD2" VALUE 0x1E0738 RL_IDENTITY 0 NO_INPUT_QUANTITY 1.0 /end CHARACTERISTIC
/* src=families fam=F_fam_0034 ax=0x- ay=0x- */
/begin CHARACTERISTIC F_fam_0034_1E07F8 "RE map_interp_F F_fam_0034 call=0x800974C2" VALUE 0x1E07F8 RL_IDENTITY 0 NO_INPUT_QUANTITY 1.0 /end CHARACTERISTIC
/* src=families fam=F_fam_0122 ax=0x- ay=0x- */
/begin CHARACTERISTIC F_fam_0122_1E0DB8 "RE map_interp_F F_fam_0122 call=0x80093BD0" VALUE 0x1E0DB8 RL_IDENTITY 0 NO_INPUT_QUANTITY 1.0 /end CHARACTERISTIC
/* src=families fam=N_fam_0027 ax=0x- ay=0x- */
/begin CHARACTERISTIC N_fam_0027_1E88C8 "RE map_interp_N N_fam_0027 call=0x800B5D86" VALUE 0x1E88C8 RL_IDENTITY 0 NO_INPUT_QUANTITY 1.0 /end CHARACTERISTIC
/* src=families fam=N_fam_0030 ax=0x- ay=0x- */
/begin CHARACTERISTIC N_fam_0030_1E88DC "RE map_interp_N N_fam_0030 call=0x800D4E28" VALUE 0x1E88DC RL_IDENTITY 0 NO_INPUT_QUANTITY 1.0 /end CHARACTERISTIC
/* src=families fam=C_fam_0297 ax=0x- ay=0x- */
/begin CHARACTERISTIC C_fam_0297_1E88E8 "RE map_interp_C C_fam_0297 call=0x800B5A46" VALUE 0x1E88E8 RL_IDENTITY 0 NO_INPUT_QUANTITY 1.0 /end CHARACTERISTIC
/* src=families fam=H_fam_0125 ax=0x- ay=0x- */
/begin CHARACTERISTIC H_fam_0125_1E8916 "RE map_interp_H H_fam_0125 call=0x800B6862" VALUE 0x1E8916 RL_IDENTITY 0 NO_INPUT_QUANTITY 1.0 /end CHARACTERISTIC
/* src=families fam=B_fam_0064 ax=0x- ay=0x- */
/begin CHARACTERISTIC B_fam_0064_1E8C44 "RE interp_2d_B B_fam_0064 call=0x80104A4A" VALUE 0x1E8C44 RL_IDENTITY 0 NO_INPUT_QUANTITY 1.0 /end CHARACTERISTIC
/* src=families fam=D_fam_0146 ax=0x- ay=0x- */
/begin CHARACTERISTIC D_fam_0146_1E8D84 "RE map_interp_D D_fam_0146 call=0x800909F0; RE map_interp_I I_fam_0075 call=0x80" VALUE 0x1E8D84 RL_IDENTITY 0 NO_INPUT_QUANTITY 1.0 /end CHARACTERISTIC
/* src=families fam=fam_0003 ax=0x1AE848 ay=0x1AA974 */
/begin CHARACTERISTIC map_horsA2L_1E8DB0 "RE interp_2d fam_0003 call=0x80090740" MAP 0x1E8DB0 RL_IDENTITY 0 NO_INPUT_QUANTITY 1.0 FORMAT "%%5.0"
 /begin AXIS_DESCR COM_AXIS NO_INPUT_QUANTITY NO_COMPU_METHOD 2 AXIS_PTS_REF AX_1AE848 /end AXIS_DESCR
 /begin AXIS_DESCR COM_AXIS NO_INPUT_QUANTITY NO_COMPU_METHOD 2 AXIS_PTS_REF AX_1AA974 /end AXIS_DESCR
/end CHARACTERISTIC
/* src=families fam=fam_0171 ax=0x- ay=0x- */
/begin CHARACTERISTIC map_horsA2L_1F5DA4 "RE interp_2d fam_0171 call=0x800F515A" VALUE 0x1E8DD8 RL_IDENTITY 0 NO_INPUT_QUANTITY 1.0 /end CHARACTERISTIC
/begin CHARACTERISTIC rail_base_int_trq2B "atlas9979 rail_base_int_trq2B / Rail pressure request (IdName Caddy 9979 - verif" MAP 0x1E9368 RL_IDENTITY 0 NO_INPUT_QUANTITY 1.0 FORMAT "%%5.0"
 /begin AXIS_DESCR COM_AXIS NO_INPUT_QUANTITY NO_COMPU_METHOD 16 AXIS_PTS_REF AX_1E8FDE /end AXIS_DESCR
 /begin AXIS_DESCR COM_AXIS NO_INPUT_QUANTITY NO_COMPU_METHOD 16 AXIS_PTS_REF AX_1E8E42 /end AXIS_DESCR
/end CHARACTERISTIC
/begin CHARACTERISTIC rail_base_int_trq2B_1E9568 "atlas9979 rail_base_int_trq2B@1E9568 / Rail pressure request (IdName Caddy 9979 " MAP 0x1E9568 RL_IDENTITY 0 NO_INPUT_QUANTITY 1.0 FORMAT "%%5.0"
 /begin AXIS_DESCR COM_AXIS NO_INPUT_QUANTITY NO_COMPU_METHOD 16 AXIS_PTS_REF AX_1E8FDE /end AXIS_DESCR
 /begin AXIS_DESCR COM_AXIS NO_INPUT_QUANTITY NO_COMPU_METHOD 16 AXIS_PTS_REF AX_1E8E42 /end AXIS_DESCR
/end CHARACTERISTIC
/begin CHARACTERISTIC rail_base_int_trq2B_1E9768 "atlas9979 rail_base_int_trq2B@1E9768 / Rail pressure request (IdName Caddy 9979 " MAP 0x1E9768 RL_IDENTITY 0 NO_INPUT_QUANTITY 1.0 FORMAT "%%5.0"
 /begin AXIS_DESCR COM_AXIS NO_INPUT_QUANTITY NO_COMPU_METHOD 16 AXIS_PTS_REF AX_1E8FDE /end AXIS_DESCR
 /begin AXIS_DESCR COM_AXIS NO_INPUT_QUANTITY NO_COMPU_METHOD 16 AXIS_PTS_REF AX_1E8E42 /end AXIS_DESCR
/end CHARACTERISTIC
/* src=families fam=D_fam_0191 ax=0x- ay=0x- */
/begin CHARACTERISTIC D_fam_0191_1E98C0 "RE map_interp_D D_fam_0191 call=0x800C1964" VALUE 0x1E98C0 RL_IDENTITY 0 NO_INPUT_QUANTITY 1.0 /end CHARACTERISTIC
/begin CHARACTERISTIC rail_base_int_trq2B_1E9968 "atlas9979 rail_base_int_trq2B@1E9968 / Rail pressure request (IdName Caddy 9979 " MAP 0x1E9968 RL_IDENTITY 0 NO_INPUT_QUANTITY 1.0 FORMAT "%%5.0"
 /begin AXIS_DESCR COM_AXIS NO_INPUT_QUANTITY NO_COMPU_METHOD 16 AXIS_PTS_REF AX_1E8FDE /end AXIS_DESCR
 /begin AXIS_DESCR COM_AXIS NO_INPUT_QUANTITY NO_COMPU_METHOD 16 AXIS_PTS_REF AX_1E8E42 /end AXIS_DESCR
/end CHARACTERISTIC
/begin CHARACTERISTIC rail_base_int_trq2B_1E9B68 "atlas9979 rail_base_int_trq2B@1E9B68 / Rail pressure request (IdName Caddy 9979 " MAP 0x1E9B68 RL_IDENTITY 0 NO_INPUT_QUANTITY 1.0 FORMAT "%%5.0"
 /begin AXIS_DESCR COM_AXIS NO_INPUT_QUANTITY NO_COMPU_METHOD 16 AXIS_PTS_REF AX_1E8FDE /end AXIS_DESCR
 /begin AXIS_DESCR COM_AXIS NO_INPUT_QUANTITY NO_COMPU_METHOD 16 AXIS_PTS_REF AX_1E8E42 /end AXIS_DESCR
/end CHARACTERISTIC
/* src=families fam=B_fam_0047 ax=0x- ay=0x- */
/begin CHARACTERISTIC B_fam_0047_1E9BC8 "RE interp_2d_B B_fam_0047 call=0x800B5A96" VALUE 0x1E9BC8 RL_IDENTITY 0 NO_INPUT_QUANTITY 1.0 /end CHARACTERISTIC
/begin CHARACTERISTIC rail_base_int_trq2B_1E9D68 "atlas9979 rail_base_int_trq2B@1E9D68 / Rail pressure request (IdName Caddy 9979 " MAP 0x1E9D68 RL_IDENTITY 0 NO_INPUT_QUANTITY 1.0 FORMAT "%%5.0"
 /begin AXIS_DESCR COM_AXIS NO_INPUT_QUANTITY NO_COMPU_METHOD 16 AXIS_PTS_REF AX_1E8FDE /end AXIS_DESCR
 /begin AXIS_DESCR COM_AXIS NO_INPUT_QUANTITY NO_COMPU_METHOD 16 AXIS_PTS_REF AX_1E8E42 /end AXIS_DESCR
/end CHARACTERISTIC
/* src=families fam=fam_0170 ax=0x- ay=0x- */
/begin CHARACTERISTIC fam_0170_1E9DE0 "RE interp_2d fam_0170 call=0x800F5114" VALUE 0x1E9DE0 RL_IDENTITY 0 NO_INPUT_QUANTITY 1.0 /end CHARACTERISTIC
/begin CHARACTERISTIC rail_base_int_trq2B_1E9F68 "atlas9979 rail_base_int_trq2B@1E9F68 / Rail pressure request (IdName Caddy 9979 " MAP 0x1E9F68 RL_IDENTITY 0 NO_INPUT_QUANTITY 1.0 FORMAT "%%5.0"
 /begin AXIS_DESCR COM_AXIS NO_INPUT_QUANTITY NO_COMPU_METHOD 16 AXIS_PTS_REF AX_1E8FDE /end AXIS_DESCR
 /begin AXIS_DESCR COM_AXIS NO_INPUT_QUANTITY NO_COMPU_METHOD 16 AXIS_PTS_REF AX_1E8E42 /end AXIS_DESCR
/end CHARACTERISTIC
/begin CHARACTERISTIC rail_request_horsA2L_banque_01 "atlas9979 rail_request_horsA2L_banque_01 / Suite rail (hors A2L) banque 1 (IdNam" VALUE 0x1EA168 RL_IDENTITY 0 NO_INPUT_QUANTITY 1.0 /end CHARACTERISTIC
/begin CHARACTERISTIC rail_request_horsA2L_banque_02 "atlas9979 rail_request_horsA2L_banque_02 / Suite rail (hors A2L) banque 2 (IdNam" VALUE 0x1EA368 RL_IDENTITY 0 NO_INPUT_QUANTITY 1.0 /end CHARACTERISTIC
/begin CHARACTERISTIC rail_request_horsA2L_banque_03 "atlas9979 rail_request_horsA2L_banque_03 / Suite rail (hors A2L) banque 3 (IdNam" VALUE 0x1EA568 RL_IDENTITY 0 NO_INPUT_QUANTITY 1.0 /end CHARACTERISTIC
/begin CHARACTERISTIC rail_request_horsA2L_banque_04 "atlas9979 rail_request_horsA2L_banque_04 / Suite rail (hors A2L) banque 4 (IdNam" VALUE 0x1EA768 RL_IDENTITY 0 NO_INPUT_QUANTITY 1.0 /end CHARACTERISTIC
/begin CHARACTERISTIC rail_request_horsA2L_banque_05 "atlas9979 rail_request_horsA2L_banque_05 / Suite rail (hors A2L) banque 5 (IdNam" VALUE 0x1EA968 RL_IDENTITY 0 NO_INPUT_QUANTITY 1.0 /end CHARACTERISTIC
/begin CHARACTERISTIC rail_request_horsA2L_banque_06 "atlas9979 rail_request_horsA2L_banque_06 / Suite rail (hors A2L) banque 6 (IdNam" VALUE 0x1EAB68 RL_IDENTITY 0 NO_INPUT_QUANTITY 1.0 /end CHARACTERISTIC
/* src=families fam=F_fam_0096 ax=0x- ay=0x- */
/begin CHARACTERISTIC F_fam_0096_1EACFC "RE map_interp_F F_fam_0096 call=0x80087D28" VALUE 0x1EACFC RL_IDENTITY 0 NO_INPUT_QUANTITY 1.0 /end CHARACTERISTIC
/begin CHARACTERISTIC rail_request_horsA2L_banque_07 "atlas9979 rail_request_horsA2L_banque_07 / Suite rail (hors A2L) banque 7 (IdNam" VALUE 0x1EAD68 RL_IDENTITY 0 NO_INPUT_QUANTITY 1.0 /end CHARACTERISTIC
/* src=families fam=C_fam_0301 ax=0x- ay=0x- */
/begin CHARACTERISTIC C_fam_0301_1EADB0 "RE map_interp_C C_fam_0301 call=0x800C4AAC" VALUE 0x1EADB0 RL_IDENTITY 0 NO_INPUT_QUANTITY 1.0 /end CHARACTERISTIC
/* src=families fam=C_fam_0302 ax=0x- ay=0x- */
/begin CHARACTERISTIC C_fam_0302_1EADBC "RE map_interp_C C_fam_0302 call=0x800C4ACA" VALUE 0x1EADBC RL_IDENTITY 0 NO_INPUT_QUANTITY 1.0 /end CHARACTERISTIC
/* src=families fam=fam_0169 ax=0x- ay=0x- */
/begin CHARACTERISTIC map_horsA2L_1F5DB4 "RE interp_2d fam_0169 call=0x800F50E2" VALUE 0x1EADE8 RL_IDENTITY 0 NO_INPUT_QUANTITY 1.0 /end CHARACTERISTIC
/begin CHARACTERISTIC rail_request_horsA2L_banque_08 "atlas9979 rail_request_horsA2L_banque_08 / Suite rail (hors A2L) banque 8 (IdNam" VALUE 0x1EAF68 RL_IDENTITY 0 NO_INPUT_QUANTITY 1.0 /end CHARACTERISTIC
/begin CHARACTERISTIC rail_request_horsA2L_banque_09 "atlas9979 rail_request_horsA2L_banque_09 / Suite rail (hors A2L) banque 9 (IdNam" VALUE 0x1EB168 RL_IDENTITY 0 NO_INPUT_QUANTITY 1.0 /end CHARACTERISTIC
/begin CHARACTERISTIC rail_request_horsA2L_banque_10 "atlas9979 rail_request_horsA2L_banque_10 / Suite rail (hors A2L) banque 10 (IdNa" VALUE 0x1EB368 RL_IDENTITY 0 NO_INPUT_QUANTITY 1.0 /end CHARACTERISTIC
/begin CHARACTERISTIC rail_request_horsA2L_banque_11 "atlas9979 rail_request_horsA2L_banque_11 / Suite rail (hors A2L) banque 11 (IdNa" VALUE 0x1EB568 RL_IDENTITY 0 NO_INPUT_QUANTITY 1.0 /end CHARACTERISTIC
/begin CHARACTERISTIC rail_request_horsA2L_banque_12 "atlas9979 rail_request_horsA2L_banque_12 / Suite rail (hors A2L) banque 12 (IdNa" VALUE 0x1EB768 RL_IDENTITY 0 NO_INPUT_QUANTITY 1.0 /end CHARACTERISTIC
/* src=families fam=F_fam_0031 ax=0x- ay=0x- */
/begin CHARACTERISTIC F_fam_0031_1EB840 "RE map_interp_F F_fam_0031 call=0x800972C2" VALUE 0x1EB840 RL_IDENTITY 0 NO_INPUT_QUANTITY 1.0 /end CHARACTERISTIC
/* src=families fam=F_fam_0032 ax=0x- ay=0x- */
/begin CHARACTERISTIC F_fam_0032_1EB878 "RE map_interp_F F_fam_0032 call=0x8009735E" VALUE 0x1EB878 RL_IDENTITY 0 NO_INPUT_QUANTITY 1.0 /end CHARACTERISTIC
/* src=families fam=C_fam_0298 ax=0x- ay=0x- */
/begin CHARACTERISTIC C_fam_0298_1EB924 "RE map_interp_C C_fam_0298 call=0x800B5DB4" VALUE 0x1EB924 RL_IDENTITY 0 NO_INPUT_QUANTITY 1.0 /end CHARACTERISTIC
/* src=families fam=C_fam_0249 ax=0x- ay=0x- */
/begin CHARACTERISTIC C_fam_0249_1EB934 "RE map_interp_C C_fam_0249 call=0x800B5E60" VALUE 0x1EB934 RL_IDENTITY 0 NO_INPUT_QUANTITY 1.0 /end CHARACTERISTIC
/begin CHARACTERISTIC rail_request_horsA2L_banque_13 "atlas9979 rail_request_horsA2L_banque_13 / Suite rail (hors A2L) banque 13 (IdNa" VALUE 0x1EB968 RL_IDENTITY 0 NO_INPUT_QUANTITY 1.0 /end CHARACTERISTIC
/begin CHARACTERISTIC rail_request_horsA2L_banque_14 "atlas9979 rail_request_horsA2L_banque_14 / Suite rail (hors A2L) banque 14 (IdNa" VALUE 0x1EBB68 RL_IDENTITY 0 NO_INPUT_QUANTITY 1.0 /end CHARACTERISTIC
/* src=families fam=E_fam_0073 ax=0x- ay=0x- */
/begin CHARACTERISTIC E_fam_0073_1EBC4C "RE map_interp_E E_fam_0073 call=0x80104034" VALUE 0x1EBC4C RL_IDENTITY 0 NO_INPUT_QUANTITY 1.0 /end CHARACTERISTIC
/* src=families fam=N_fam_0024 ax=0x- ay=0x- */
/begin CHARACTERISTIC N_fam_0024_1EBC6C "RE map_interp_N N_fam_0024 call=0x80104930" VALUE 0x1EBC6C RL_IDENTITY 0 NO_INPUT_QUANTITY 1.0 /end CHARACTERISTIC
/* src=families fam=N_fam_0019 ax=0x- ay=0x- */
/begin CHARACTERISTIC N_fam_0019_1EBC78 "RE map_interp_N N_fam_0019 call=0x80103D8C" VALUE 0x1EBC78 RL_IDENTITY 0 NO_INPUT_QUANTITY 1.0 /end CHARACTERISTIC
/* src=families fam=C_fam_0039 ax=0x- ay=0x- */
/begin CHARACTERISTIC C_fam_0039_1EBD88 "RE map_interp_C C_fam_0039 call=0x800C491A" VALUE 0x1EBD88 RL_IDENTITY 0 NO_INPUT_QUANTITY 1.0 /end CHARACTERISTIC
/* src=families fam=C_fam_0039 ax=0x- ay=0x- */
/begin CHARACTERISTIC C_fam_0039_1EBD94 "RE map_interp_C C_fam_0039 call=0x800C494A" VALUE 0x1EBD94 RL_IDENTITY 0 NO_INPUT_QUANTITY 1.0 /end CHARACTERISTIC
/* src=families fam=C_fam_0186 ax=0x- ay=0x- */
/begin CHARACTERISTIC C_fam_0186_1EBDA0 "RE map_interp_C C_fam_0186 call=0x80090ECE" VALUE 0x1EBDA0 RL_IDENTITY 0 NO_INPUT_QUANTITY 1.0 /end CHARACTERISTIC
/* src=families fam=fam_0137 ax=0x- ay=0x- */
/begin CHARACTERISTIC map_horsA2L_1F1D90 "RE interp_2d fam_0137 call=0x8009061A" VALUE 0x1EBDB0 RL_IDENTITY 0 NO_INPUT_QUANTITY 1.0 /end CHARACTERISTIC
/begin CHARACTERISTIC rail_lim_horsA2L_A "atlas9979 rail_lim_horsA2L_A / Limiteur rail (hors A2L) A (IdName Caddy 9979 - v" VALUE 0x1EBDD8 RL_IDENTITY 0 NO_INPUT_QUANTITY 1.0 /end CHARACTERISTIC
/* src=families fam=C_fam_0026 ax=0x1AE848 ay=0x1AA974 */
/begin CHARACTERISTIC C_fam_0026_1EBDF0 "RE map_interp_C C_fam_0026 call=0x80090758" MAP 0x1EBDF0 RL_IDENTITY 0 NO_INPUT_QUANTITY 1.0 FORMAT "%%5.0"
 /begin AXIS_DESCR COM_AXIS NO_INPUT_QUANTITY NO_COMPU_METHOD 2 AXIS_PTS_REF AX_1AE848 /end AXIS_DESCR
 /begin AXIS_DESCR COM_AXIS NO_INPUT_QUANTITY NO_COMPU_METHOD 2 AXIS_PTS_REF AX_1AA974 /end AXIS_DESCR
/end CHARACTERISTIC
/begin CHARACTERISTIC rail_lim_horsA2L_B "atlas9979 rail_lim_horsA2L_B / Limiteur rail (hors A2L) B (IdName Caddy 9979 - v" VALUE 0x1EBE58 RL_IDENTITY 0 NO_INPUT_QUANTITY 1.0 /end CHARACTERISTIC
/* src=families fam=I_fam_0094 ax=0x- ay=0x- */
/begin CHARACTERISTIC I_fam_0094_1EC904 "RE map_interp_I I_fam_0094 call=0x800C1938" VALUE 0x1EC904 RL_IDENTITY 0 NO_INPUT_QUANTITY 1.0 /end CHARACTERISTIC
/* src=families fam=N_fam_0031 ax=0x- ay=0x- */
/begin CHARACTERISTIC N_fam_0031_1ECC48 "RE map_interp_N N_fam_0031 call=0x80103CEC" VALUE 0x1ECC48 RL_IDENTITY 0 NO_INPUT_QUANTITY 1.0 /end CHARACTERISTIC
/* src=families fam=D_fam_0132 ax=0x- ay=0x- */
/begin CHARACTERISTIC D_fam_0132_1ECC58 "RE map_interp_D D_fam_0132 call=0x8008A164; RE map_interp_I I_fam_0069 call=0x80" VALUE 0x1ECC58 RL_IDENTITY 0 NO_INPUT_QUANTITY 1.0 /end CHARACTERISTIC
/* src=families fam=D_fam_0141 ax=0x- ay=0x- */
/begin CHARACTERISTIC D_fam_0141_1ECC64 "RE map_interp_D D_fam_0141 call=0x80087CC4" VALUE 0x1ECC64 RL_IDENTITY 0 NO_INPUT_QUANTITY 1.0 /end CHARACTERISTIC
/* src=families fam=F_fam_0100 ax=0x- ay=0x- */
/begin CHARACTERISTIC F_fam_0100_1ECC78 "RE map_interp_F F_fam_0100 call=0x80089156; RE map_interp_G G_fam_0084 call=0x80" VALUE 0x1ECC78 RL_IDENTITY 0 NO_INPUT_QUANTITY 1.0 /end CHARACTERISTIC
/* src=families fam=C_fam_0200 ax=0x- ay=0x- */
/begin CHARACTERISTIC C_fam_0200_1ECD54 "RE map_interp_C C_fam_0200 call=0x800C6154" VALUE 0x1ECD54 RL_IDENTITY 0 NO_INPUT_QUANTITY 1.0 /end CHARACTERISTIC
/* src=families fam=C_fam_0260 ax=0x- ay=0x- */
/begin CHARACTERISTIC C_fam_0260_1ECD60 "RE map_interp_C C_fam_0260 call=0x800C60D8" VALUE 0x1ECD60 RL_IDENTITY 0 NO_INPUT_QUANTITY 1.0 /end CHARACTERISTIC
/* src=families fam=fam_0138 ax=0x- ay=0x- */
/begin CHARACTERISTIC map_horsA2L_1F1DA0 "RE interp_2d fam_0138 call=0x8009063E" VALUE 0x1ECDB8 RL_IDENTITY 0 NO_INPUT_QUANTITY 1.0 /end CHARACTERISTIC
/* src=families fam=C_fam_0291 ax=0x- ay=0x- */
/begin CHARACTERISTIC C_fam_0291_1ECDC0 "RE map_interp_C C_fam_0291 call=0x80090CB2" VALUE 0x1ECDC0 RL_IDENTITY 0 NO_INPUT_QUANTITY 1.0 /end CHARACTERISTIC
/* src=families fam=C_fam_0273 ax=0x- ay=0x- */
/begin CHARACTERISTIC C_fam_0273_1ECDD0 "RE map_interp_C C_fam_0273 call=0x80090BCE" VALUE 0x1ECDD0 RL_IDENTITY 0 NO_INPUT_QUANTITY 1.0 /end CHARACTERISTIC
/* src=families fam=fam_0123 ax=0x- ay=0x- */
/begin CHARACTERISTIC map_horsA2L_1F7D98 "RE interp_2d fam_0123 call=0x80090862" VALUE 0x1ECDE0 RL_IDENTITY 0 NO_INPUT_QUANTITY 1.0 /end CHARACTERISTIC
/* src=families fam=F_fam_0033 ax=0x- ay=0x- */
/begin CHARACTERISTIC F_fam_0033_1ED860 "RE map_interp_F F_fam_0033 call=0x800973F8" VALUE 0x1ED860 RL_IDENTITY 0 NO_INPUT_QUANTITY 1.0 /end CHARACTERISTIC
/* src=families fam=F_fam_0153 ax=0x- ay=0x- */
/begin CHARACTERISTIC F_fam_0153_1ED928 "RE map_interp_F F_fam_0153 call=0x800C19CC" VALUE 0x1ED928 RL_IDENTITY 0 NO_INPUT_QUANTITY 1.0 /end CHARACTERISTIC
/* src=families fam=B_fam_0057 ax=0x- ay=0x- */
/begin CHARACTERISTIC B_fam_0057_1EDBC8 "RE interp_2d_B B_fam_0057 call=0x800D4DE6" VALUE 0x1EDBC8 RL_IDENTITY 0 NO_INPUT_QUANTITY 1.0 /end CHARACTERISTIC
/* src=families fam=B_fam_0063 ax=0x- ay=0x- */
/begin CHARACTERISTIC B_fam_0063_1EDC04 "RE interp_2d_B B_fam_0063 call=0x80103E54" VALUE 0x1EDC04 RL_IDENTITY 0 NO_INPUT_QUANTITY 1.0 /end CHARACTERISTIC
/* src=families fam=D_fam_0142 ax=0x- ay=0x- */
/begin CHARACTERISTIC D_fam_0142_1EDC60 "RE map_interp_D D_fam_0142 call=0x80089124" VALUE 0x1EDC60 RL_IDENTITY 0 NO_INPUT_QUANTITY 1.0 /end CHARACTERISTIC
/* src=horsA2L fam=- ax=0x1EDC4C ay=0x1EDC74 */ /* STUB unknown size; axis_x=0x1EDC4C axis_y=0x1EDC74 */
/begin CHARACTERISTIC map_horsA2L_1EDC74 "low: 8000/A000 fill - pas une grille Nm lisible (ex. 1C4994); identique 64o vs 9" VALUE 0x1EDC74 RL_IDENTITY 0 NO_INPUT_QUANTITY 1.0 /end CHARACTERISTIC
/* src=families fam=F_fam_0069 ax=0x- ay=0x1AC814 */ /* STUB unknown size; axis_x=0x- axis_y=0x1AC814 */
/begin CHARACTERISTIC F_fam_0069_1EE898 "RE map_interp_F F_fam_0069 call=0x800D27FC" VALUE 0x1EE898 RL_IDENTITY 0 NO_INPUT_QUANTITY 1.0 /end CHARACTERISTIC
/* src=families fam=K_fam_0069 ax=0x- ay=0x- */
/begin CHARACTERISTIC K_fam_0069_1EE8C8 "RE map_interp_K K_fam_0069 call=0x800C1924" VALUE 0x1EE8C8 RL_IDENTITY 0 NO_INPUT_QUANTITY 1.0 /end CHARACTERISTIC
/* src=families fam=I_fam_0074 ax=0x- ay=0x- */
/begin CHARACTERISTIC I_fam_0074_1EEC48 "RE map_interp_I I_fam_0074 call=0x80089AEC; RE map_interp_K K_fam_0036 call=0x80" VALUE 0x1EEC48 RL_IDENTITY 0 NO_INPUT_QUANTITY 1.0 /end CHARACTERISTIC
/* src=families fam=D_fam_0139 ax=0x- ay=0x- */
/begin CHARACTERISTIC D_fam_0139_1EEC6C "RE map_interp_D D_fam_0139 call=0x80086F3C" VALUE 0x1EEC6C RL_IDENTITY 0 NO_INPUT_QUANTITY 1.0 /end CHARACTERISTIC
/* src=families fam=F_fam_0095 ax=0x- ay=0x- */
/begin CHARACTERISTIC F_fam_0095_1EEC78 "RE map_interp_F F_fam_0095 call=0x80087CFC; RE map_interp_G G_fam_0083 call=0x80" VALUE 0x1EEC78 RL_IDENTITY 0 NO_INPUT_QUANTITY 1.0 /end CHARACTERISTIC
/* src=families fam=fam_0136 ax=0x- ay=0x- */
/begin CHARACTERISTIC map_horsA2L_1EDC74_1EECEC "RE interp_2d fam_0136 call=0x80088DBE" VALUE 0x1EECEC RL_IDENTITY 0 NO_INPUT_QUANTITY 1.0 /end CHARACTERISTIC
/* src=families fam=C_fam_0274 ax=0x- ay=0x- */
/begin CHARACTERISTIC C_fam_0274_1EED80 "RE map_interp_C C_fam_0274 call=0x80090E40" VALUE 0x1EED80 RL_IDENTITY 0 NO_INPUT_QUANTITY 1.0 /end CHARACTERISTIC
/* src=families fam=F_fam_0037 ax=0x- ay=0x- */
/begin CHARACTERISTIC F_fam_0037_1EED90 "RE map_interp_F F_fam_0037 call=0x800F535C" VALUE 0x1EED90 RL_IDENTITY 0 NO_INPUT_QUANTITY 1.0 /end CHARACTERISTIC
/* src=families fam=C_fam_0209 ax=0x- ay=0x- */
/begin CHARACTERISTIC C_fam_0209_1EEDC0 "RE map_interp_C C_fam_0209 call=0x80090BA6" VALUE 0x1EEDC0 RL_IDENTITY 0 NO_INPUT_QUANTITY 1.0 /end CHARACTERISTIC
/* src=horsA2L fam=- ax=0x1EEDD0 ay=0x1EEDDC */ /* STUB unknown size; axis_x=0x1EEDD0 axis_y=0x1EEDDC */
/begin CHARACTERISTIC map_horsA2L_1EEDDC "low: 8000/A000 fill - pas une grille Nm lisible (ex. 1C4994); identique 64o vs 9" VALUE 0x1EEDDC RL_IDENTITY 0 NO_INPUT_QUANTITY 1.0 /end CHARACTERISTIC
/* src=families fam=F_fam_0147 ax=0x- ay=0x- */
/begin CHARACTERISTIC F_fam_0147_1EF848 "RE map_interp_F F_fam_0147 call=0x800BB70C" VALUE 0x1EF848 RL_IDENTITY 0 NO_INPUT_QUANTITY 1.0 /end CHARACTERISTIC
/* src=families fam=F_fam_0148 ax=0x- ay=0x- */
/begin CHARACTERISTIC F_fam_0148_1EF870 "RE map_interp_F F_fam_0148 call=0x800BB75C" VALUE 0x1EF870 RL_IDENTITY 0 NO_INPUT_QUANTITY 1.0 /end CHARACTERISTIC
/* src=families fam=G_fam_0122 ax=0x- ay=0x- */
/begin CHARACTERISTIC G_fam_0122_1EF8DC "RE map_interp_G G_fam_0122 call=0x800C198A" VALUE 0x1EF8DC RL_IDENTITY 0 NO_INPUT_QUANTITY 1.0 /end CHARACTERISTIC
/* src=families fam=F_fam_0030 ax=0x- ay=0x- */
/begin CHARACTERISTIC F_fam_0030_1EFC50 "RE map_interp_F F_fam_0030 call=0x800892C6; RE map_interp_G G_fam_0081 call=0x80" VALUE 0x1EFC50 RL_IDENTITY 0 NO_INPUT_QUANTITY 1.0 /end CHARACTERISTIC
/* src=families fam=D_fam_0143 ax=0x- ay=0x- */
/begin CHARACTERISTIC D_fam_0143_1EFC60 "RE map_interp_D D_fam_0143 call=0x8008929E; RE map_interp_I I_fam_0073 call=0x80" VALUE 0x1EFC60 RL_IDENTITY 0 NO_INPUT_QUANTITY 1.0 /end CHARACTERISTIC
/* src=families fam=F_fam_0035 ax=0x- ay=0x- */
/begin CHARACTERISTIC F_fam_0035_1F0804 "RE map_interp_F F_fam_0035 call=0x80097560" VALUE 0x1F0804 RL_IDENTITY 0 NO_INPUT_QUANTITY 1.0 /end CHARACTERISTIC
/* src=horsA2L fam=- ax=0x1EFBF0 ay=0x1F0C24 */ /* STUB unknown size; axis_x=0x1EFBF0 axis_y=0x1F0C24 */
/begin CHARACTERISTIC map_horsA2L_1F0C24 "low: 8000/A000 fill - pas une grille Nm lisible (ex. 1C4994); identique 64o vs 9" VALUE 0x1F0C24 RL_IDENTITY 0 NO_INPUT_QUANTITY 1.0 /end CHARACTERISTIC
/* src=families fam=F_fam_0085 ax=0x- ay=0x- */
/begin CHARACTERISTIC F_fam_0085_1F0DE0 "RE map_interp_F F_fam_0085 call=0x800F52B2" VALUE 0x1F0DE0 RL_IDENTITY 0 NO_INPUT_QUANTITY 1.0 /end CHARACTERISTIC
/* src=families fam=fam_0182 ax=0x- ay=0x- */
/begin CHARACTERISTIC map_horsA2L_1EEDDC_1F0E04 "RE interp_2d fam_0182 call=0x80115454" VALUE 0x1F0E04 RL_IDENTITY 0 NO_INPUT_QUANTITY 1.0 /end CHARACTERISTIC
/* src=families fam=C_fam_0243 ax=0x- ay=0x- */
/begin CHARACTERISTIC C_fam_0243_1F0E34 "RE map_interp_C C_fam_0243 call=0x8010548E" VALUE 0x1F0E34 RL_IDENTITY 0 NO_INPUT_QUANTITY 1.0 /end CHARACTERISTIC
/* src=families fam=F_fam_0036 ax=0x- ay=0x- */
/begin CHARACTERISTIC F_fam_0036_1F182C "RE map_interp_F F_fam_0036 call=0x80097600" VALUE 0x1F182C RL_IDENTITY 0 NO_INPUT_QUANTITY 1.0 /end CHARACTERISTIC
/* src=families fam=F_fam_0149 ax=0x- ay=0x- */
/begin CHARACTERISTIC F_fam_0149_1F1880 "RE map_interp_F F_fam_0149 call=0x800BB7AC" VALUE 0x1F1880 RL_IDENTITY 0 NO_INPUT_QUANTITY 1.0 /end CHARACTERISTIC
/* src=families fam=fam_0118 ax=0x- ay=0x- */
/begin CHARACTERISTIC map_horsA2L_1F0C24_1F1C18 "RE interp_2d fam_0118 call=0x800F0BCE" VALUE 0x1F1C18 RL_IDENTITY 0 NO_INPUT_QUANTITY 1.0 /end CHARACTERISTIC
/* src=horsA2L fam=- ax=0x1F0DB0 ay=0x1F1D90 */ /* STUB unknown size; axis_x=0x1F0DB0 axis_y=0x1F1D90 */
/begin CHARACTERISTIC map_horsA2L_1F1D90_1F1D90 "low: 8000/A000 fill - pas une grille Nm lisible (ex. 1C4994); identique 64o vs 9" VALUE 0x1F1D90 RL_IDENTITY 0 NO_INPUT_QUANTITY 1.0 /end CHARACTERISTIC
/* src=horsA2L fam=- ax=0x1F1D80 ay=0x1F1DA0 */ /* STUB unknown size; axis_x=0x1F1D80 axis_y=0x1F1DA0 */
/begin CHARACTERISTIC map_horsA2L_1F1DA0_1F1DA0 "low: 8000/A000 fill - pas une grille Nm lisible (ex. 1C4994); identique 64o vs 9" VALUE 0x1F1DA0 RL_IDENTITY 0 NO_INPUT_QUANTITY 1.0 /end CHARACTERISTIC
/* src=families fam=C_fam_0230 ax=0x- ay=0x- */
/begin CHARACTERISTIC C_fam_0230_1F1E00 "RE map_interp_C C_fam_0230 call=0x801059F6" VALUE 0x1F1E00 RL_IDENTITY 0 NO_INPUT_QUANTITY 1.0 /end CHARACTERISTIC
/* src=families fam=C_fam_0340 ax=0x- ay=0x- */
/begin CHARACTERISTIC C_fam_0340_1F1E20 "RE map_interp_C C_fam_0340 call=0x8010B39E" VALUE 0x1F1E20 RL_IDENTITY 0 NO_INPUT_QUANTITY 1.0 /end CHARACTERISTIC
/* src=families fam=C_fam_0296 ax=0x- ay=0x- */
/begin CHARACTERISTIC C_fam_0296_1F2890 "RE map_interp_C C_fam_0296 call=0x800B1658" VALUE 0x1F2890 RL_IDENTITY 0 NO_INPUT_QUANTITY 1.0 /end CHARACTERISTIC
/* src=families fam=fam_0139 ax=0x- ay=0x- */
/begin CHARACTERISTIC map_horsA2L_1D3648_1F28A0 "RE interp_2d fam_0139 call=0x8009A0AE" VALUE 0x1F28A0 RL_IDENTITY 0 NO_INPUT_QUANTITY 1.0 /end CHARACTERISTIC
/* src=families fam=C_fam_0026 ax=0x1AE848 ay=0x1AA974 */
/begin CHARACTERISTIC C_fam_0026_1F2D9C "RE map_interp_C C_fam_0026 call=0x8009077A" MAP 0x1F2D9C RL_IDENTITY 0 NO_INPUT_QUANTITY 1.0 FORMAT "%%5.0"
 /begin AXIS_DESCR COM_AXIS NO_INPUT_QUANTITY NO_COMPU_METHOD 2 AXIS_PTS_REF AX_1AE848 /end AXIS_DESCR
 /begin AXIS_DESCR COM_AXIS NO_INPUT_QUANTITY NO_COMPU_METHOD 2 AXIS_PTS_REF AX_1AA974 /end AXIS_DESCR
/end CHARACTERISTIC
/* src=families fam=F_fam_0037 ax=0x- ay=0x- */
/begin CHARACTERISTIC F_fam_0037_1F2DF0 "RE map_interp_F F_fam_0037 call=0x800F5378" VALUE 0x1F2DF0 RL_IDENTITY 0 NO_INPUT_QUANTITY 1.0 /end CHARACTERISTIC
/* src=families fam=E_fam_0120 ax=0x- ay=0x- */
/begin CHARACTERISTIC E_fam_0120_1F2E00 "RE map_interp_E E_fam_0120 call=0x80115BC2" VALUE 0x1F2E00 RL_IDENTITY 0 NO_INPUT_QUANTITY 1.0 /end CHARACTERISTIC
/* src=families fam=K_fam_0067 ax=0x- ay=0x- */
/begin CHARACTERISTIC K_fam_0067_1F391C "RE map_interp_K K_fam_0067 call=0x800B6804" VALUE 0x1F391C RL_IDENTITY 0 NO_INPUT_QUANTITY 1.0 /end CHARACTERISTIC
/* src=families fam=E_fam_0056 ax=0x- ay=0x- */
/begin CHARACTERISTIC E_fam_0056_1F3C54 "RE map_interp_E E_fam_0056 call=0x80103B9C" VALUE 0x1F3C54 RL_IDENTITY 0 NO_INPUT_QUANTITY 1.0 /end CHARACTERISTIC
/* src=families fam=E_fam_0055 ax=0x- ay=0x- */
/begin CHARACTERISTIC E_fam_0055_1F3C74 "RE map_interp_E E_fam_0055 call=0x8013128A" VALUE 0x1F3C74 RL_IDENTITY 0 NO_INPUT_QUANTITY 1.0 /end CHARACTERISTIC
/* src=families fam=fam_0140 ax=0x- ay=0x- */
/begin CHARACTERISTIC map_horsA2L_1D365C_1F48A0 "RE interp_2d fam_0140 call=0x8009A0E0" VALUE 0x1F48A0 RL_IDENTITY 0 NO_INPUT_QUANTITY 1.0 /end CHARACTERISTIC
/* src=families fam=C_fam_0322 ax=0x- ay=0x- */
/begin CHARACTERISTIC C_fam_0322_1F4C08 "RE map_interp_C C_fam_0322 call=0x800F07B4" VALUE 0x1F4C08 RL_IDENTITY 0 NO_INPUT_QUANTITY 1.0 /end CHARACTERISTIC
/* src=families fam=fam_0166 ax=0x- ay=0x- */
/begin CHARACTERISTIC map_horsA2L_1F4C14 "RE interp_2d fam_0166 call=0x800F0B16" VALUE 0x1F4C14 RL_IDENTITY 0 NO_INPUT_QUANTITY 1.0 /end CHARACTERISTIC
/* src=families fam=C_fam_0332 ax=0x- ay=0x- */
/begin CHARACTERISTIC C_fam_0332_1F4C54 "RE map_interp_C C_fam_0332 call=0x80104E76" VALUE 0x1F4C54 RL_IDENTITY 0 NO_INPUT_QUANTITY 1.0 /end CHARACTERISTIC
/* src=families fam=C_fam_0331 ax=0x- ay=0x- */
/begin CHARACTERISTIC C_fam_0331_1F4C60 "RE map_interp_C C_fam_0331 call=0x80103C64" VALUE 0x1F4C60 RL_IDENTITY 0 NO_INPUT_QUANTITY 1.0 /end CHARACTERISTIC
/* src=families fam=B_fam_0040 ax=0x- ay=0x- */
/begin CHARACTERISTIC B_fam_0040_1F4C7C "RE interp_2d_B B_fam_0040 call=0x8010498E" VALUE 0x1F4C7C RL_IDENTITY 0 NO_INPUT_QUANTITY 1.0 /end CHARACTERISTIC
/* src=families fam=F_fam_0094 ax=0x- ay=0x- */
/begin CHARACTERISTIC F_fam_0094_1F4D04 "RE map_interp_F F_fam_0094 call=0x80086F60" VALUE 0x1F4D04 RL_IDENTITY 0 NO_INPUT_QUANTITY 1.0 /end CHARACTERISTIC
/* src=families fam=N_fam_0022 ax=0x- ay=0x- */
/begin CHARACTERISTIC N_fam_0022_1F4D94 "RE map_interp_N N_fam_0022 call=0x800C4996" VALUE 0x1F4D94 RL_IDENTITY 0 NO_INPUT_QUANTITY 1.0 /end CHARACTERISTIC
/* src=families fam=H_fam_0120 ax=0x- ay=0x- */
/begin CHARACTERISTIC H_fam_0120_1F5918 "RE map_interp_H H_fam_0120 call=0x800B6814" VALUE 0x1F5918 RL_IDENTITY 0 NO_INPUT_QUANTITY 1.0 /end CHARACTERISTIC
/* src=families fam=H_fam_0121 ax=0x- ay=0x- */
/begin CHARACTERISTIC H_fam_0121_1F593E "RE map_interp_H H_fam_0121 call=0x800B6822" VALUE 0x1F593E RL_IDENTITY 0 NO_INPUT_QUANTITY 1.0 /end CHARACTERISTIC
/* src=families fam=B_fam_0058 ax=0x- ay=0x- */
/begin CHARACTERISTIC B_fam_0058_1F5BE8 "RE interp_2d_B B_fam_0058 call=0x800D4E0C" VALUE 0x1F5BE8 RL_IDENTITY 0 NO_INPUT_QUANTITY 1.0 /end CHARACTERISTIC
/* src=families fam=fam_0167 ax=0x- ay=0x- */
/begin CHARACTERISTIC map_horsA2L_1F5C1C "RE interp_2d fam_0167 call=0x800F0B32" VALUE 0x1F5C1C RL_IDENTITY 0 NO_INPUT_QUANTITY 1.0 /end CHARACTERISTIC
/* src=families fam=E_fam_0107 ax=0x- ay=0x- */
/begin CHARACTERISTIC E_fam_0107_1F5CB0 "RE map_interp_E E_fam_0107 call=0x800C604A" VALUE 0x1F5CB0 RL_IDENTITY 0 NO_INPUT_QUANTITY 1.0 /end CHARACTERISTIC
/* src=families fam=O_fam_0014 ax=0x- ay=0x- */
/begin CHARACTERISTIC O_fam_0014_1F5CBC "RE map_interp_O O_fam_0014 call=0x80086D52" VALUE 0x1F5CBC RL_IDENTITY 0 NO_INPUT_QUANTITY 1.0 /end CHARACTERISTIC
/* src=families fam=O_fam_0015 ax=0x- ay=0x- */
/begin CHARACTERISTIC O_fam_0015_1F5D44 "RE map_interp_O O_fam_0015 call=0x80089190" VALUE 0x1F5D44 RL_IDENTITY 0 NO_INPUT_QUANTITY 1.0 /end CHARACTERISTIC
/* src=families fam=E_fam_0093 ax=0x- ay=0x- */
/begin CHARACTERISTIC E_fam_0093_1F5D78 "RE map_interp_E E_fam_0093 call=0x8008916E" VALUE 0x1F5D78 RL_IDENTITY 0 NO_INPUT_QUANTITY 1.0 /end CHARACTERISTIC
/* src=horsA2L fam=- ax=0x1F2DBC ay=0x1F5D94 */ /* STUB unknown size; axis_x=0x1F2DBC axis_y=0x1F5D94 */
/begin CHARACTERISTIC map_horsA2L_1F5D94 "low: 8000/A000 fill - pas une grille Nm lisible (ex. 1C4994); identique 64o vs 9" VALUE 0x1F5D94 RL_IDENTITY 0 NO_INPUT_QUANTITY 1.0 /end CHARACTERISTIC
/* src=horsA2L fam=- ax=0x1F4DB4 ay=0x1F5DA4 */ /* STUB unknown size; axis_x=0x1F4DB4 axis_y=0x1F5DA4 */
/begin CHARACTERISTIC map_horsA2L_1F5DA4_1F5DA4 "low: 8000/A000 fill - pas une grille Nm lisible (ex. 1C4994); identique 64o vs 9" VALUE 0x1F5DA4 RL_IDENTITY 0 NO_INPUT_QUANTITY 1.0 /end CHARACTERISTIC
/* src=horsA2L fam=- ax=0x1F5D84 ay=0x1F5DB4 */ /* STUB unknown size; axis_x=0x1F5D84 axis_y=0x1F5DB4 */
/begin CHARACTERISTIC map_horsA2L_1F5DB4_1F5DB4 "low: 8000/A000 fill - pas une grille Nm lisible (ex. 1C4994); identique 64o vs 9" VALUE 0x1F5DB4 RL_IDENTITY 0 NO_INPUT_QUANTITY 1.0 /end CHARACTERISTIC
/* src=families fam=fam_0104 ax=0x- ay=0x- */
/begin CHARACTERISTIC map_horsA2L_1F5D94_1F5DC0 "RE interp_2d fam_0104 call=0x800F5068" VALUE 0x1F5DC0 RL_IDENTITY 0 NO_INPUT_QUANTITY 1.0 /end CHARACTERISTIC
/* src=families fam=F_fam_0162 ax=0x- ay=0x- */
/begin CHARACTERISTIC F_fam_0162_1F68A0 "RE map_interp_F F_fam_0162 call=0x800D286C" VALUE 0x1F68A0 RL_IDENTITY 0 NO_INPUT_QUANTITY 1.0 /end CHARACTERISTIC
/* src=families fam=C_fam_0237 ax=0x- ay=0x- */
/begin CHARACTERISTIC C_fam_0237_1F68D0 "RE map_interp_C C_fam_0237 call=0x8009A202" VALUE 0x1F68D0 RL_IDENTITY 0 NO_INPUT_QUANTITY 1.0 /end CHARACTERISTIC
/* src=families fam=H_fam_0122 ax=0x- ay=0x- */
/begin CHARACTERISTIC H_fam_0122_1F6924 "RE map_interp_H H_fam_0122 call=0x800B6834" VALUE 0x1F6924 RL_IDENTITY 0 NO_INPUT_QUANTITY 1.0 /end CHARACTERISTIC
/* src=families fam=B_fam_0059 ax=0x- ay=0x- */
/begin CHARACTERISTIC B_fam_0059_1F6BD8 "RE interp_2d_B B_fam_0059 call=0x800D4E4C" VALUE 0x1F6BD8 RL_IDENTITY 0 NO_INPUT_QUANTITY 1.0 /end CHARACTERISTIC
/* src=families fam=E_fam_0092 ax=0x- ay=0x- */
/begin CHARACTERISTIC E_fam_0092_1F6CB0 "RE map_interp_E E_fam_0092 call=0x80086D6A" VALUE 0x1F6CB0 RL_IDENTITY 0 NO_INPUT_QUANTITY 1.0 /end CHARACTERISTIC
/* src=families fam=K_fam_0033 ax=0x- ay=0x- */
/begin CHARACTERISTIC K_fam_0033_1F6CBC "RE map_interp_K K_fam_0033 call=0x80087D0E" VALUE 0x1F6CBC RL_IDENTITY 0 NO_INPUT_QUANTITY 1.0 /end CHARACTERISTIC
/* src=families fam=F_fam_0099 ax=0x- ay=0x- */
/begin CHARACTERISTIC F_fam_0099_1F6D44 "RE map_interp_F F_fam_0099 call=0x800890C2" VALUE 0x1F6D44 RL_IDENTITY 0 NO_INPUT_QUANTITY 1.0 /end CHARACTERISTIC
/* src=families fam=H_fam_0123 ax=0x- ay=0x- */
/begin CHARACTERISTIC H_fam_0123_1F790A "RE map_interp_H H_fam_0123 call=0x800B6842" VALUE 0x1F790A RL_IDENTITY 0 NO_INPUT_QUANTITY 1.0 /end CHARACTERISTIC
/* src=families fam=H_fam_0124 ax=0x- ay=0x- */
/begin CHARACTERISTIC H_fam_0124_1F7930 "RE map_interp_H H_fam_0124 call=0x800B6854" VALUE 0x1F7930 RL_IDENTITY 0 NO_INPUT_QUANTITY 1.0 /end CHARACTERISTIC
/* src=families fam=fam_0141 ax=0x- ay=0x- */
/begin CHARACTERISTIC map_horsA2L_1F7BC8 "RE interp_2d fam_0141 call=0x800B5A26" VALUE 0x1F7BC8 RL_IDENTITY 0 NO_INPUT_QUANTITY 1.0 /end CHARACTERISTIC
/* src=families fam=C_fam_0275 ax=0x- ay=0x1AA974 */ /* STUB unknown size; axis_x=0x- axis_y=0x1AA974 */
/begin CHARACTERISTIC C_fam_0275_1F7D80 "RE map_interp_C C_fam_0275 call=0x800907F8" VALUE 0x1F7D80 RL_IDENTITY 0 NO_INPUT_QUANTITY 1.0 /end CHARACTERISTIC
/* src=families fam=C_fam_0276 ax=0x- ay=0x- */
/begin CHARACTERISTIC C_fam_0276_1F7D8C "RE map_interp_C C_fam_0276 call=0x80090838" VALUE 0x1F7D8C RL_IDENTITY 0 NO_INPUT_QUANTITY 1.0 /end CHARACTERISTIC
/* src=horsA2L fam=- ax=0x1F2D88 ay=0x1F7D98 */ /* STUB unknown size; axis_x=0x1F2D88 axis_y=0x1F7D98 */
/begin CHARACTERISTIC map_horsA2L_1F7D98_1F7D98 "low: 8000/A000 fill - pas une grille Nm lisible (ex. 1C4994); identique 64o vs 9" VALUE 0x1F7D98 RL_IDENTITY 0 NO_INPUT_QUANTITY 1.0 /end CHARACTERISTIC
/* src=families fam=D_fam_0133 ax=0x- ay=0x- */
/begin CHARACTERISTIC D_fam_0133_1F7DA8 "RE map_interp_D D_fam_0133 call=0x800F528C" VALUE 0x1F7DA8 RL_IDENTITY 0 NO_INPUT_QUANTITY 1.0 /end CHARACTERISTIC
/* src=families fam=fam_0172 ax=0x- ay=0x- */
/begin CHARACTERISTIC fam_0172_1F7DD0 "RE interp_2d fam_0172 call=0x800F519A" VALUE 0x1F7DD0 RL_IDENTITY 0 NO_INPUT_QUANTITY 1.0 /end CHARACTERISTIC
/* RAM MEASUREMENT - RE role names, not OEM. Units unknown. */
/begin MEASUREMENT rail_sp_target "cible avant PT1 (sortie interp_C 18D0F0)" UWORD RL_IDENTITY 0 0 0 65535 ECU_ADDRESS 0xD0013870 /end MEASUREMENT
/begin MEASUREMENT rail_sp_filtered "apres FUN_8004d15c; copie vers D000B6AE" UWORD RL_IDENTITY 0 0 0 65535 ECU_ADDRESS 0xD0013874 /end MEASUREMENT
/begin MEASUREMENT rail_sp_x_1E9DE0 "X du site rail 2d 800F5114" UWORD RL_IDENTITY 0 0 0 65535 ECU_ADDRESS 0xD000B6AE /end MEASUREMENT
/begin MEASUREMENT rail_sp_curve_x "X de 18D0F0 = D000048A / D00019DC" UWORD RL_IDENTITY 0 0 0 65535 ECU_ADDRESS 0xD0018666 /end MEASUREMENT
/begin MEASUREMENT rail_sp_ratio_den "denominateur du ratio 8666" UWORD RL_IDENTITY 0 0 0 65535 ECU_ADDRESS 0xD00019DC /end MEASUREMENT
/begin MEASUREMENT rail_sp_ratio_num "numerateur (ld.w) voisin ram_0414" ULONG RL_IDENTITY 0 0 0 4294967295 ECU_ADDRESS 0xD000048A /end MEASUREMENT
/begin MEASUREMENT e6e8_ratio "quotient FUN_80080f4c; PAS consigne bar" UWORD RL_IDENTITY 0 0 0 65535 ECU_ADDRESS 0xD000E6E8 /end MEASUREMENT
/begin MEASUREMENT rail_bank_index "ld.bu mode/index site rail B 800B5A96 - porte multi-map" UBYTE RL_IDENTITY 0 0 0 255 ECU_ADDRESS 0xD000A946 /end MEASUREMENT
/end MODULE
/end PROJECT
