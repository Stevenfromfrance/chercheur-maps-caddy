ASAP2_VERSION 1 60
/begin PROJECT PCR21_Golf9980_REVERSE "RE PCR2.1 9980 SM2G0P - NOT OEM"
/begin MODULE PCR21_SM2G0P_9980 "Golf 03L997558A SW9980; reverse draft"
/* AXIS_PTS 0x180C21 count=4 (from_map) - values not dumped */
/begin AXIS_PTS AX_180C21 "RE axis ptr not OEM" 0x180C21 RL_IDENTITY 0 NO_INPUT_QUANTITY 1.0 4 FORMAT "%%5.0" /end AXIS_PTS
/* AXIS_PTS 0x180CDB count=6 (from_map) - values not dumped */
/begin AXIS_PTS AX_180CDB "RE axis ptr not OEM" 0x180CDB RL_IDENTITY 0 NO_INPUT_QUANTITY 1.0 6 FORMAT "%%5.0" /end AXIS_PTS
/* AXIS_PTS 0x19875C count=? (unknown_use_2) - values not dumped */
/begin AXIS_PTS AX_19875C "RE axis ptr not OEM" 0x19875C RL_IDENTITY 0 NO_INPUT_QUANTITY 1.0 2 FORMAT "%%5.0" /end AXIS_PTS
/* AXIS_PTS 0x198778 count=? (unknown_use_2) - values not dumped */
/begin AXIS_PTS AX_198778 "RE axis ptr not OEM" 0x198778 RL_IDENTITY 0 NO_INPUT_QUANTITY 1.0 2 FORMAT "%%5.0" /end AXIS_PTS
/* AXIS_PTS 0x199448 count=? (unknown_use_2) - values not dumped */
/begin AXIS_PTS AX_199448 "RE axis ptr not OEM" 0x199448 RL_IDENTITY 0 NO_INPUT_QUANTITY 1.0 2 FORMAT "%%5.0" /end AXIS_PTS
/* AXIS_PTS 0x199650 count=? (unknown_use_2) - values not dumped */
/begin AXIS_PTS AX_199650 "RE axis ptr not OEM" 0x199650 RL_IDENTITY 0 NO_INPUT_QUANTITY 1.0 2 FORMAT "%%5.0" /end AXIS_PTS
/* AXIS_PTS 0x19974C count=? (unknown_use_2) - values not dumped */
/begin AXIS_PTS AX_19974C "RE axis ptr not OEM" 0x19974C RL_IDENTITY 0 NO_INPUT_QUANTITY 1.0 2 FORMAT "%%5.0" /end AXIS_PTS
/* AXIS_PTS 0x19A508 count=? (unknown_use_2) - values not dumped */
/begin AXIS_PTS AX_19A508 "RE axis ptr not OEM" 0x19A508 RL_IDENTITY 0 NO_INPUT_QUANTITY 1.0 2 FORMAT "%%5.0" /end AXIS_PTS
/* AXIS_PTS 0x19A744 count=? (unknown_use_2) - values not dumped */
/begin AXIS_PTS AX_19A744 "RE axis ptr not OEM" 0x19A744 RL_IDENTITY 0 NO_INPUT_QUANTITY 1.0 2 FORMAT "%%5.0" /end AXIS_PTS
/* AXIS_PTS 0x19B74C count=? (unknown_use_2) - values not dumped */
/begin AXIS_PTS AX_19B74C "RE axis ptr not OEM" 0x19B74C RL_IDENTITY 0 NO_INPUT_QUANTITY 1.0 2 FORMAT "%%5.0" /end AXIS_PTS
/* AXIS_PTS 0x19C450 count=? (unknown_use_2) - values not dumped */
/begin AXIS_PTS AX_19C450 "RE axis ptr not OEM" 0x19C450 RL_IDENTITY 0 NO_INPUT_QUANTITY 1.0 2 FORMAT "%%5.0" /end AXIS_PTS
/* AXIS_PTS 0x19C5DC count=? (unknown_use_2) - values not dumped */
/begin AXIS_PTS AX_19C5DC "RE axis ptr not OEM" 0x19C5DC RL_IDENTITY 0 NO_INPUT_QUANTITY 1.0 2 FORMAT "%%5.0" /end AXIS_PTS
/* AXIS_PTS 0x19C778 count=? (unknown_use_2) - values not dumped */
/begin AXIS_PTS AX_19C778 "RE axis ptr not OEM" 0x19C778 RL_IDENTITY 0 NO_INPUT_QUANTITY 1.0 2 FORMAT "%%5.0" /end AXIS_PTS
/* AXIS_PTS 0x19D5F0 count=? (unknown_use_2) - values not dumped */
/begin AXIS_PTS AX_19D5F0 "RE axis ptr not OEM" 0x19D5F0 RL_IDENTITY 0 NO_INPUT_QUANTITY 1.0 2 FORMAT "%%5.0" /end AXIS_PTS
/* AXIS_PTS 0x19D6D4 count=? (unknown_use_2) - values not dumped */
/begin AXIS_PTS AX_19D6D4 "RE axis ptr not OEM" 0x19D6D4 RL_IDENTITY 0 NO_INPUT_QUANTITY 1.0 2 FORMAT "%%5.0" /end AXIS_PTS
/* AXIS_PTS 0x19D748 count=? (unknown_use_2) - values not dumped */
/begin AXIS_PTS AX_19D748 "RE axis ptr not OEM" 0x19D748 RL_IDENTITY 0 NO_INPUT_QUANTITY 1.0 2 FORMAT "%%5.0" /end AXIS_PTS
/* AXIS_PTS 0x19E558 count=? (unknown_use_2) - values not dumped */
/begin AXIS_PTS AX_19E558 "RE axis ptr not OEM" 0x19E558 RL_IDENTITY 0 NO_INPUT_QUANTITY 1.0 2 FORMAT "%%5.0" /end AXIS_PTS
/* AXIS_PTS 0x19E56C count=? (unknown_use_2) - values not dumped */
/begin AXIS_PTS AX_19E56C "RE axis ptr not OEM" 0x19E56C RL_IDENTITY 0 NO_INPUT_QUANTITY 1.0 2 FORMAT "%%5.0" /end AXIS_PTS
/* AXIS_PTS 0x19F564 count=? (unknown_use_2) - values not dumped */
/begin AXIS_PTS AX_19F564 "RE axis ptr not OEM" 0x19F564 RL_IDENTITY 0 NO_INPUT_QUANTITY 1.0 2 FORMAT "%%5.0" /end AXIS_PTS
/* AXIS_PTS 0x1A0648 count=? (unknown_use_2) - values not dumped */
/begin AXIS_PTS AX_1A0648 "RE axis ptr not OEM" 0x1A0648 RL_IDENTITY 0 NO_INPUT_QUANTITY 1.0 2 FORMAT "%%5.0" /end AXIS_PTS
/* AXIS_PTS 0x1A0660 count=? (unknown_use_2) - values not dumped */
/begin AXIS_PTS AX_1A0660 "RE axis ptr not OEM" 0x1A0660 RL_IDENTITY 0 NO_INPUT_QUANTITY 1.0 2 FORMAT "%%5.0" /end AXIS_PTS
/* AXIS_PTS 0x1A066C count=? (unknown_use_2) - values not dumped */
/begin AXIS_PTS AX_1A066C "RE axis ptr not OEM" 0x1A066C RL_IDENTITY 0 NO_INPUT_QUANTITY 1.0 2 FORMAT "%%5.0" /end AXIS_PTS
/* AXIS_PTS 0x1A068C count=? (unknown_use_2) - values not dumped */
/begin AXIS_PTS AX_1A068C "RE axis ptr not OEM" 0x1A068C RL_IDENTITY 0 NO_INPUT_QUANTITY 1.0 2 FORMAT "%%5.0" /end AXIS_PTS
/* AXIS_PTS 0x1A0698 count=? (unknown_use_2) - values not dumped */
/begin AXIS_PTS AX_1A0698 "RE axis ptr not OEM" 0x1A0698 RL_IDENTITY 0 NO_INPUT_QUANTITY 1.0 2 FORMAT "%%5.0" /end AXIS_PTS
/* AXIS_PTS 0x1A06D4 count=? (unknown_use_2) - values not dumped */
/begin AXIS_PTS AX_1A06D4 "RE axis ptr not OEM" 0x1A06D4 RL_IDENTITY 0 NO_INPUT_QUANTITY 1.0 2 FORMAT "%%5.0" /end AXIS_PTS
/* AXIS_PTS 0x1A06E0 count=? (unknown_use_2) - values not dumped */
/begin AXIS_PTS AX_1A06E0 "RE axis ptr not OEM" 0x1A06E0 RL_IDENTITY 0 NO_INPUT_QUANTITY 1.0 2 FORMAT "%%5.0" /end AXIS_PTS
/* AXIS_PTS 0x1A0728 count=? (unknown_use_2) - values not dumped */
/begin AXIS_PTS AX_1A0728 "RE axis ptr not OEM" 0x1A0728 RL_IDENTITY 0 NO_INPUT_QUANTITY 1.0 2 FORMAT "%%5.0" /end AXIS_PTS
/* AXIS_PTS 0x1A14C4 count=? (unknown_use_2) - values not dumped */
/begin AXIS_PTS AX_1A14C4 "RE axis ptr not OEM" 0x1A14C4 RL_IDENTITY 0 NO_INPUT_QUANTITY 1.0 2 FORMAT "%%5.0" /end AXIS_PTS
/* AXIS_PTS 0x1A14D8 count=? (unknown_use_2) - values not dumped */
/begin AXIS_PTS AX_1A14D8 "RE axis ptr not OEM" 0x1A14D8 RL_IDENTITY 0 NO_INPUT_QUANTITY 1.0 2 FORMAT "%%5.0" /end AXIS_PTS
/* AXIS_PTS 0x1A14E4 count=? (unknown_use_2) - values not dumped */
/begin AXIS_PTS AX_1A14E4 "RE axis ptr not OEM" 0x1A14E4 RL_IDENTITY 0 NO_INPUT_QUANTITY 1.0 2 FORMAT "%%5.0" /end AXIS_PTS
/* AXIS_PTS 0x1A151C count=? (unknown_use_2) - values not dumped */
/begin AXIS_PTS AX_1A151C "RE axis ptr not OEM" 0x1A151C RL_IDENTITY 0 NO_INPUT_QUANTITY 1.0 2 FORMAT "%%5.0" /end AXIS_PTS
/* AXIS_PTS 0x1A1528 count=? (unknown_use_2) - values not dumped */
/begin AXIS_PTS AX_1A1528 "RE axis ptr not OEM" 0x1A1528 RL_IDENTITY 0 NO_INPUT_QUANTITY 1.0 2 FORMAT "%%5.0" /end AXIS_PTS
/* AXIS_PTS 0x1A1588 count=12 (header_u16) - values not dumped */
/begin AXIS_PTS AX_1A1588 "RE axis ptr not OEM" 0x1A1588 RL_IDENTITY 0 NO_INPUT_QUANTITY 1.0 12 FORMAT "%%5.0" /end AXIS_PTS
/* AXIS_PTS 0x1A15AC count=? (unknown_use_2) - values not dumped */
/begin AXIS_PTS AX_1A15AC "RE axis ptr not OEM" 0x1A15AC RL_IDENTITY 0 NO_INPUT_QUANTITY 1.0 2 FORMAT "%%5.0" /end AXIS_PTS
/* AXIS_PTS 0x1A163C count=5 (header_u16) - values not dumped */
/begin AXIS_PTS AX_1A163C "RE axis ptr not OEM" 0x1A163C RL_IDENTITY 0 NO_INPUT_QUANTITY 1.0 5 FORMAT "%%5.0" /end AXIS_PTS
/* AXIS_PTS 0x1A165C count=? (unknown_use_2) - values not dumped */
/begin AXIS_PTS AX_1A165C "RE axis ptr not OEM" 0x1A165C RL_IDENTITY 0 NO_INPUT_QUANTITY 1.0 2 FORMAT "%%5.0" /end AXIS_PTS
/* AXIS_PTS 0x1A1678 count=? (unknown_use_2) - values not dumped */
/begin AXIS_PTS AX_1A1678 "RE axis ptr not OEM" 0x1A1678 RL_IDENTITY 0 NO_INPUT_QUANTITY 1.0 2 FORMAT "%%5.0" /end AXIS_PTS
/* AXIS_PTS 0x1A168C count=26 (header_u16) - values not dumped */
/begin AXIS_PTS AX_1A168C "RE axis ptr not OEM" 0x1A168C RL_IDENTITY 0 NO_INPUT_QUANTITY 1.0 26 FORMAT "%%5.0" /end AXIS_PTS
/* AXIS_PTS 0x1A1710 count=? (unknown_use_2) - values not dumped */
/begin AXIS_PTS AX_1A1710 "RE axis ptr not OEM" 0x1A1710 RL_IDENTITY 0 NO_INPUT_QUANTITY 1.0 2 FORMAT "%%5.0" /end AXIS_PTS
/* AXIS_PTS 0x1A24C8 count=? (unknown_use_2) - values not dumped */
/begin AXIS_PTS AX_1A24C8 "RE axis ptr not OEM" 0x1A24C8 RL_IDENTITY 0 NO_INPUT_QUANTITY 1.0 2 FORMAT "%%5.0" /end AXIS_PTS
/* AXIS_PTS 0x1A2534 count=? (unknown_use_2) - values not dumped */
/begin AXIS_PTS AX_1A2534 "RE axis ptr not OEM" 0x1A2534 RL_IDENTITY 0 NO_INPUT_QUANTITY 1.0 2 FORMAT "%%5.0" /end AXIS_PTS
/* AXIS_PTS 0x1A26D0 count=? (unknown_use_2) - values not dumped */
/begin AXIS_PTS AX_1A26D0 "RE axis ptr not OEM" 0x1A26D0 RL_IDENTITY 0 NO_INPUT_QUANTITY 1.0 2 FORMAT "%%5.0" /end AXIS_PTS
/* AXIS_PTS 0x1A26F4 count=? (unknown_use_2) - values not dumped */
/begin AXIS_PTS AX_1A26F4 "RE axis ptr not OEM" 0x1A26F4 RL_IDENTITY 0 NO_INPUT_QUANTITY 1.0 2 FORMAT "%%5.0" /end AXIS_PTS
/* AXIS_PTS 0x1A2710 count=? (unknown_use_2) - values not dumped */
/begin AXIS_PTS AX_1A2710 "RE axis ptr not OEM" 0x1A2710 RL_IDENTITY 0 NO_INPUT_QUANTITY 1.0 2 FORMAT "%%5.0" /end AXIS_PTS
/* AXIS_PTS 0x1A2720 count=? (unknown_use_2) - values not dumped */
/begin AXIS_PTS AX_1A2720 "RE axis ptr not OEM" 0x1A2720 RL_IDENTITY 0 NO_INPUT_QUANTITY 1.0 2 FORMAT "%%5.0" /end AXIS_PTS
/* AXIS_PTS 0x1A2734 count=? (unknown_use_2) - values not dumped */
/begin AXIS_PTS AX_1A2734 "RE axis ptr not OEM" 0x1A2734 RL_IDENTITY 0 NO_INPUT_QUANTITY 1.0 2 FORMAT "%%5.0" /end AXIS_PTS
/* AXIS_PTS 0x1A3470 count=? (unknown_use_2) - values not dumped */
/begin AXIS_PTS AX_1A3470 "RE axis ptr not OEM" 0x1A3470 RL_IDENTITY 0 NO_INPUT_QUANTITY 1.0 2 FORMAT "%%5.0" /end AXIS_PTS
/* AXIS_PTS 0x1A3528 count=46 (header_u16) - values not dumped */
/begin AXIS_PTS AX_1A3528 "RE axis ptr not OEM" 0x1A3528 RL_IDENTITY 0 NO_INPUT_QUANTITY 1.0 46 FORMAT "%%5.0" /end AXIS_PTS
/* AXIS_PTS 0x1A3644 count=? (unknown_use_2) - values not dumped */
/begin AXIS_PTS AX_1A3644 "RE axis ptr not OEM" 0x1A3644 RL_IDENTITY 0 NO_INPUT_QUANTITY 1.0 2 FORMAT "%%5.0" /end AXIS_PTS
/* AXIS_PTS 0x1A3650 count=? (unknown_use_2) - values not dumped */
/begin AXIS_PTS AX_1A3650 "RE axis ptr not OEM" 0x1A3650 RL_IDENTITY 0 NO_INPUT_QUANTITY 1.0 2 FORMAT "%%5.0" /end AXIS_PTS
/* AXIS_PTS 0x1A365C count=28 (header_u16) - values not dumped */
/begin AXIS_PTS AX_1A365C "RE axis ptr not OEM" 0x1A365C RL_IDENTITY 0 NO_INPUT_QUANTITY 1.0 28 FORMAT "%%5.0" /end AXIS_PTS
/* AXIS_PTS 0x1A36C0 count=? (unknown_use_2) - values not dumped */
/begin AXIS_PTS AX_1A36C0 "RE axis ptr not OEM" 0x1A36C0 RL_IDENTITY 0 NO_INPUT_QUANTITY 1.0 2 FORMAT "%%5.0" /end AXIS_PTS
/* AXIS_PTS 0x1A37D4 count=? (unknown_use_2) - values not dumped */
/begin AXIS_PTS AX_1A37D4 "RE axis ptr not OEM" 0x1A37D4 RL_IDENTITY 0 NO_INPUT_QUANTITY 1.0 2 FORMAT "%%5.0" /end AXIS_PTS
/* AXIS_PTS 0x1A4664 count=? (unknown_use_2) - values not dumped */
/begin AXIS_PTS AX_1A4664 "RE axis ptr not OEM" 0x1A4664 RL_IDENTITY 0 NO_INPUT_QUANTITY 1.0 2 FORMAT "%%5.0" /end AXIS_PTS
/* AXIS_PTS 0x1A4670 count=6 (header_u16) - values not dumped */
/begin AXIS_PTS AX_1A4670 "RE axis ptr not OEM" 0x1A4670 RL_IDENTITY 0 NO_INPUT_QUANTITY 1.0 6 FORMAT "%%5.0" /end AXIS_PTS
/* AXIS_PTS 0x1A4700 count=? (unknown_use_2) - values not dumped */
/begin AXIS_PTS AX_1A4700 "RE axis ptr not OEM" 0x1A4700 RL_IDENTITY 0 NO_INPUT_QUANTITY 1.0 2 FORMAT "%%5.0" /end AXIS_PTS
/* AXIS_PTS 0x1A5360 count=16 (header_u16) - values not dumped */
/begin AXIS_PTS AX_1A5360 "RE axis ptr not OEM" 0x1A5360 RL_IDENTITY 0 NO_INPUT_QUANTITY 1.0 16 FORMAT "%%5.0" /end AXIS_PTS
/* AXIS_PTS 0x1A5500 count=? (unknown_use_2) - values not dumped */
/begin AXIS_PTS AX_1A5500 "RE axis ptr not OEM" 0x1A5500 RL_IDENTITY 0 NO_INPUT_QUANTITY 1.0 2 FORMAT "%%5.0" /end AXIS_PTS
/* AXIS_PTS 0x1A564C count=? (unknown_use_2) - values not dumped */
/begin AXIS_PTS AX_1A564C "RE axis ptr not OEM" 0x1A564C RL_IDENTITY 0 NO_INPUT_QUANTITY 1.0 2 FORMAT "%%5.0" /end AXIS_PTS
/* AXIS_PTS 0x1A565C count=? (unknown_use_2) - values not dumped */
/begin AXIS_PTS AX_1A565C "RE axis ptr not OEM" 0x1A565C RL_IDENTITY 0 NO_INPUT_QUANTITY 1.0 2 FORMAT "%%5.0" /end AXIS_PTS
/* AXIS_PTS 0x1A57F0 count=? (unknown_use_2) - values not dumped */
/begin AXIS_PTS AX_1A57F0 "RE axis ptr not OEM" 0x1A57F0 RL_IDENTITY 0 NO_INPUT_QUANTITY 1.0 2 FORMAT "%%5.0" /end AXIS_PTS
/* AXIS_PTS 0x1A5B6C count=20 (header_u16) - values not dumped */
/begin AXIS_PTS AX_1A5B6C "RE axis ptr not OEM" 0x1A5B6C RL_IDENTITY 0 NO_INPUT_QUANTITY 1.0 20 FORMAT "%%5.0" /end AXIS_PTS
/* AXIS_PTS 0x1A5C6A count=16 (header_u16) - values not dumped */
/begin AXIS_PTS AX_1A5C6A "RE axis ptr not OEM" 0x1A5C6A RL_IDENTITY 0 NO_INPUT_QUANTITY 1.0 16 FORMAT "%%5.0" /end AXIS_PTS
/* AXIS_PTS 0x1A60CE count=8 (header_u16) - values not dumped */
/begin AXIS_PTS AX_1A60CE "RE axis ptr not OEM" 0x1A60CE RL_IDENTITY 0 NO_INPUT_QUANTITY 1.0 8 FORMAT "%%5.0" /end AXIS_PTS
/* AXIS_PTS 0x1A612A count=8 (header_u16) - values not dumped */
/begin AXIS_PTS AX_1A612A "RE axis ptr not OEM" 0x1A612A RL_IDENTITY 0 NO_INPUT_QUANTITY 1.0 8 FORMAT "%%5.0" /end AXIS_PTS
/* AXIS_PTS 0x1A64D4 count=5 (header_u16) - values not dumped */
/begin AXIS_PTS AX_1A64D4 "RE axis ptr not OEM" 0x1A64D4 RL_IDENTITY 0 NO_INPUT_QUANTITY 1.0 5 FORMAT "%%5.0" /end AXIS_PTS
/* AXIS_PTS 0x1A64E4 count=? (unknown_use_2) - values not dumped */
/begin AXIS_PTS AX_1A64E4 "RE axis ptr not OEM" 0x1A64E4 RL_IDENTITY 0 NO_INPUT_QUANTITY 1.0 2 FORMAT "%%5.0" /end AXIS_PTS
/* AXIS_PTS 0x1A64F4 count=? (unknown_use_2) - values not dumped */
/begin AXIS_PTS AX_1A64F4 "RE axis ptr not OEM" 0x1A64F4 RL_IDENTITY 0 NO_INPUT_QUANTITY 1.0 2 FORMAT "%%5.0" /end AXIS_PTS
/* AXIS_PTS 0x1A65FC count=? (unknown_use_2) - values not dumped */
/begin AXIS_PTS AX_1A65FC "RE axis ptr not OEM" 0x1A65FC RL_IDENTITY 0 NO_INPUT_QUANTITY 1.0 2 FORMAT "%%5.0" /end AXIS_PTS
/* AXIS_PTS 0x1A6600 count=? (unknown_use_2) - values not dumped */
/begin AXIS_PTS AX_1A6600 "RE axis ptr not OEM" 0x1A6600 RL_IDENTITY 0 NO_INPUT_QUANTITY 1.0 2 FORMAT "%%5.0" /end AXIS_PTS
/* AXIS_PTS 0x1A6660 count=? (unknown_use_2) - values not dumped */
/begin AXIS_PTS AX_1A6660 "RE axis ptr not OEM" 0x1A6660 RL_IDENTITY 0 NO_INPUT_QUANTITY 1.0 2 FORMAT "%%5.0" /end AXIS_PTS
/* AXIS_PTS 0x1A666C count=? (unknown_use_2) - values not dumped */
/begin AXIS_PTS AX_1A666C "RE axis ptr not OEM" 0x1A666C RL_IDENTITY 0 NO_INPUT_QUANTITY 1.0 2 FORMAT "%%5.0" /end AXIS_PTS
/* AXIS_PTS 0x1A66E0 count=51 (header_u16) - values not dumped */
/begin AXIS_PTS AX_1A66E0 "RE axis ptr not OEM" 0x1A66E0 RL_IDENTITY 0 NO_INPUT_QUANTITY 1.0 51 FORMAT "%%5.0" /end AXIS_PTS
/* AXIS_PTS 0x1A6710 count=10 (header_u16) - values not dumped */
/begin AXIS_PTS AX_1A6710 "RE axis ptr not OEM" 0x1A6710 RL_IDENTITY 0 NO_INPUT_QUANTITY 1.0 10 FORMAT "%%5.0" /end AXIS_PTS
/* AXIS_PTS 0x1A6724 count=? (unknown_use_2) - values not dumped */
/begin AXIS_PTS AX_1A6724 "RE axis ptr not OEM" 0x1A6724 RL_IDENTITY 0 NO_INPUT_QUANTITY 1.0 2 FORMAT "%%5.0" /end AXIS_PTS
/* AXIS_PTS 0x1A73D0 count=? (unknown_use_2) - values not dumped */
/begin AXIS_PTS AX_1A73D0 "RE axis ptr not OEM" 0x1A73D0 RL_IDENTITY 0 NO_INPUT_QUANTITY 1.0 2 FORMAT "%%5.0" /end AXIS_PTS
/* AXIS_PTS 0x1A73DC count=? (unknown_use_2) - values not dumped */
/begin AXIS_PTS AX_1A73DC "RE axis ptr not OEM" 0x1A73DC RL_IDENTITY 0 NO_INPUT_QUANTITY 1.0 2 FORMAT "%%5.0" /end AXIS_PTS
/* AXIS_PTS 0x1A74E4 count=? (unknown_use_2) - values not dumped */
/begin AXIS_PTS AX_1A74E4 "RE axis ptr not OEM" 0x1A74E4 RL_IDENTITY 0 NO_INPUT_QUANTITY 1.0 2 FORMAT "%%5.0" /end AXIS_PTS
/* AXIS_PTS 0x1A74F4 count=? (unknown_use_2) - values not dumped */
/begin AXIS_PTS AX_1A74F4 "RE axis ptr not OEM" 0x1A74F4 RL_IDENTITY 0 NO_INPUT_QUANTITY 1.0 2 FORMAT "%%5.0" /end AXIS_PTS
/* AXIS_PTS 0x1A7648 count=? (unknown_use_2) - values not dumped */
/begin AXIS_PTS AX_1A7648 "RE axis ptr not OEM" 0x1A7648 RL_IDENTITY 0 NO_INPUT_QUANTITY 1.0 2 FORMAT "%%5.0" /end AXIS_PTS
/* AXIS_PTS 0x1A7710 count=? (unknown_use_2) - values not dumped */
/begin AXIS_PTS AX_1A7710 "RE axis ptr not OEM" 0x1A7710 RL_IDENTITY 0 NO_INPUT_QUANTITY 1.0 2 FORMAT "%%5.0" /end AXIS_PTS
/* AXIS_PTS 0x1A77D0 count=? (unknown_use_2) - values not dumped */
/begin AXIS_PTS AX_1A77D0 "RE axis ptr not OEM" 0x1A77D0 RL_IDENTITY 0 NO_INPUT_QUANTITY 1.0 2 FORMAT "%%5.0" /end AXIS_PTS
/* AXIS_PTS 0x1A7B26 count=16 (header_u16) - values not dumped */
/begin AXIS_PTS AX_1A7B26 "RE axis ptr not OEM" 0x1A7B26 RL_IDENTITY 0 NO_INPUT_QUANTITY 1.0 16 FORMAT "%%5.0" /end AXIS_PTS
/* AXIS_PTS 0x1A7BD2 count=12 (header_u16) - values not dumped */
/begin AXIS_PTS AX_1A7BD2 "RE axis ptr not OEM" 0x1A7BD2 RL_IDENTITY 0 NO_INPUT_QUANTITY 1.0 12 FORMAT "%%5.0" /end AXIS_PTS
/* AXIS_PTS 0x1A81FE count=8 (header_u16) - values not dumped */
/begin AXIS_PTS AX_1A81FE "RE axis ptr not OEM" 0x1A81FE RL_IDENTITY 0 NO_INPUT_QUANTITY 1.0 8 FORMAT "%%5.0" /end AXIS_PTS
/* AXIS_PTS 0x1A8302 count=8 (header_u16) - values not dumped */
/begin AXIS_PTS AX_1A8302 "RE axis ptr not OEM" 0x1A8302 RL_IDENTITY 0 NO_INPUT_QUANTITY 1.0 8 FORMAT "%%5.0" /end AXIS_PTS
/* AXIS_PTS 0x1A8692 count=24 (header_u16) - values not dumped */
/begin AXIS_PTS AX_1A8692 "RE axis ptr not OEM" 0x1A8692 RL_IDENTITY 0 NO_INPUT_QUANTITY 1.0 24 FORMAT "%%5.0" /end AXIS_PTS
/* AXIS_PTS 0x1A8752 count=16 (header_u16) - values not dumped */
/begin AXIS_PTS AX_1A8752 "RE axis ptr not OEM" 0x1A8752 RL_IDENTITY 0 NO_INPUT_QUANTITY 1.0 16 FORMAT "%%5.0" /end AXIS_PTS
/* AXIS_PTS 0x1A8864 count=? (unknown_use_2) - values not dumped */
/begin AXIS_PTS AX_1A8864 "RE axis ptr not OEM" 0x1A8864 RL_IDENTITY 0 NO_INPUT_QUANTITY 1.0 2 FORMAT "%%5.0" /end AXIS_PTS
/* AXIS_PTS 0x1A88EC count=? (unknown_use_2) - values not dumped */
/begin AXIS_PTS AX_1A88EC "RE axis ptr not OEM" 0x1A88EC RL_IDENTITY 0 NO_INPUT_QUANTITY 1.0 2 FORMAT "%%5.0" /end AXIS_PTS
/* AXIS_PTS 0x1A88FC count=? (unknown_use_2) - values not dumped */
/begin AXIS_PTS AX_1A88FC "RE axis ptr not OEM" 0x1A88FC RL_IDENTITY 0 NO_INPUT_QUANTITY 1.0 2 FORMAT "%%5.0" /end AXIS_PTS
/* AXIS_PTS 0x1A8910 count=? (unknown_use_2) - values not dumped */
/begin AXIS_PTS AX_1A8910 "RE axis ptr not OEM" 0x1A8910 RL_IDENTITY 0 NO_INPUT_QUANTITY 1.0 2 FORMAT "%%5.0" /end AXIS_PTS
/* AXIS_PTS 0x1A8928 count=? (unknown_use_2) - values not dumped */
/begin AXIS_PTS AX_1A8928 "RE axis ptr not OEM" 0x1A8928 RL_IDENTITY 0 NO_INPUT_QUANTITY 1.0 2 FORMAT "%%5.0" /end AXIS_PTS
/* AXIS_PTS 0x1A8934 count=? (unknown_use_2) - values not dumped */
/begin AXIS_PTS AX_1A8934 "RE axis ptr not OEM" 0x1A8934 RL_IDENTITY 0 NO_INPUT_QUANTITY 1.0 2 FORMAT "%%5.0" /end AXIS_PTS
/* AXIS_PTS 0x1A89E4 count=? (unknown_use_2) - values not dumped */
/begin AXIS_PTS AX_1A89E4 "RE axis ptr not OEM" 0x1A89E4 RL_IDENTITY 0 NO_INPUT_QUANTITY 1.0 2 FORMAT "%%5.0" /end AXIS_PTS
/* AXIS_PTS 0x1A8AE8 count=? (unknown_use_2) - values not dumped */
/begin AXIS_PTS AX_1A8AE8 "RE axis ptr not OEM" 0x1A8AE8 RL_IDENTITY 0 NO_INPUT_QUANTITY 1.0 2 FORMAT "%%5.0" /end AXIS_PTS
/* AXIS_PTS 0x1A8BCC count=? (unknown_use_2) - values not dumped */
/begin AXIS_PTS AX_1A8BCC "RE axis ptr not OEM" 0x1A8BCC RL_IDENTITY 0 NO_INPUT_QUANTITY 1.0 2 FORMAT "%%5.0" /end AXIS_PTS
/* AXIS_PTS 0x1A8D76 count=16 (header_u16) - values not dumped */
/begin AXIS_PTS AX_1A8D76 "RE axis ptr not OEM" 0x1A8D76 RL_IDENTITY 0 NO_INPUT_QUANTITY 1.0 16 FORMAT "%%5.0" /end AXIS_PTS
/* AXIS_PTS 0x1A8E06 count=18 (header_u16) - values not dumped */
/begin AXIS_PTS AX_1A8E06 "RE axis ptr not OEM" 0x1A8E06 RL_IDENTITY 0 NO_INPUT_QUANTITY 1.0 18 FORMAT "%%5.0" /end AXIS_PTS
/* AXIS_PTS 0x1A8E2E count=6 (header_u16) - values not dumped */
/begin AXIS_PTS AX_1A8E2E "RE axis ptr not OEM" 0x1A8E2E RL_IDENTITY 0 NO_INPUT_QUANTITY 1.0 6 FORMAT "%%5.0" /end AXIS_PTS
/* AXIS_PTS 0x1A8EA6 count=16 (header_u16) - values not dumped */
/begin AXIS_PTS AX_1A8EA6 "RE axis ptr not OEM" 0x1A8EA6 RL_IDENTITY 0 NO_INPUT_QUANTITY 1.0 16 FORMAT "%%5.0" /end AXIS_PTS
/* AXIS_PTS 0x1A8FBE count=18 (header_u16) - values not dumped */
/begin AXIS_PTS AX_1A8FBE "RE axis ptr not OEM" 0x1A8FBE RL_IDENTITY 0 NO_INPUT_QUANTITY 1.0 18 FORMAT "%%5.0" /end AXIS_PTS
/* AXIS_PTS 0x1A9086 count=19 (header_u16) - values not dumped */
/begin AXIS_PTS AX_1A9086 "RE axis ptr not OEM" 0x1A9086 RL_IDENTITY 0 NO_INPUT_QUANTITY 1.0 19 FORMAT "%%5.0" /end AXIS_PTS
/* AXIS_PTS 0x1A90C2 count=8 (header_u16) - values not dumped */
/begin AXIS_PTS AX_1A90C2 "RE axis ptr not OEM" 0x1A90C2 RL_IDENTITY 0 NO_INPUT_QUANTITY 1.0 8 FORMAT "%%5.0" /end AXIS_PTS
/* AXIS_PTS 0x1A993C count=5 (header_u16) - values not dumped */
/begin AXIS_PTS AX_1A993C "RE axis ptr not OEM" 0x1A993C RL_IDENTITY 0 NO_INPUT_QUANTITY 1.0 5 FORMAT "%%5.0" /end AXIS_PTS
/* AXIS_PTS 0x1A9AC8 count=? (unknown_use_2) - values not dumped */
/begin AXIS_PTS AX_1A9AC8 "RE axis ptr not OEM" 0x1A9AC8 RL_IDENTITY 0 NO_INPUT_QUANTITY 1.0 2 FORMAT "%%5.0" /end AXIS_PTS
/* AXIS_PTS 0x1A9AE8 count=? (unknown_use_2) - values not dumped */
/begin AXIS_PTS AX_1A9AE8 "RE axis ptr not OEM" 0x1A9AE8 RL_IDENTITY 0 NO_INPUT_QUANTITY 1.0 2 FORMAT "%%5.0" /end AXIS_PTS
/* AXIS_PTS 0x1A9C38 count=? (unknown_use_2) - values not dumped */
/begin AXIS_PTS AX_1A9C38 "RE axis ptr not OEM" 0x1A9C38 RL_IDENTITY 0 NO_INPUT_QUANTITY 1.0 2 FORMAT "%%5.0" /end AXIS_PTS
/* AXIS_PTS 0x1AA840 count=? (unknown_use_2) - values not dumped */
/begin AXIS_PTS AX_1AA840 "RE axis ptr not OEM" 0x1AA840 RL_IDENTITY 0 NO_INPUT_QUANTITY 1.0 2 FORMAT "%%5.0" /end AXIS_PTS
/* AXIS_PTS 0x1AA850 count=? (unknown_use_2) - values not dumped */
/begin AXIS_PTS AX_1AA850 "RE axis ptr not OEM" 0x1AA850 RL_IDENTITY 0 NO_INPUT_QUANTITY 1.0 2 FORMAT "%%5.0" /end AXIS_PTS
/* AXIS_PTS 0x1AA898 count=? (unknown_use_2) - values not dumped */
/begin AXIS_PTS AX_1AA898 "RE axis ptr not OEM" 0x1AA898 RL_IDENTITY 0 NO_INPUT_QUANTITY 1.0 2 FORMAT "%%5.0" /end AXIS_PTS
/* AXIS_PTS 0x1AA8C8 count=? (unknown_use_2) - values not dumped */
/begin AXIS_PTS AX_1AA8C8 "RE axis ptr not OEM" 0x1AA8C8 RL_IDENTITY 0 NO_INPUT_QUANTITY 1.0 2 FORMAT "%%5.0" /end AXIS_PTS
/* AXIS_PTS 0x1AA8E4 count=8 (from_map) - values not dumped */
/begin AXIS_PTS AX_1AA8E4 "RE axis ptr not OEM" 0x1AA8E4 RL_IDENTITY 0 NO_INPUT_QUANTITY 1.0 8 FORMAT "%%5.0" /end AXIS_PTS
/* AXIS_PTS 0x1AA908 count=? (unknown_use_2) - values not dumped */
/begin AXIS_PTS AX_1AA908 "RE axis ptr not OEM" 0x1AA908 RL_IDENTITY 0 NO_INPUT_QUANTITY 1.0 2 FORMAT "%%5.0" /end AXIS_PTS
/* AXIS_PTS 0x1AA95C count=? (unknown_use_2) - values not dumped */
/begin AXIS_PTS AX_1AA95C "RE axis ptr not OEM" 0x1AA95C RL_IDENTITY 0 NO_INPUT_QUANTITY 1.0 2 FORMAT "%%5.0" /end AXIS_PTS
/* AXIS_PTS 0x1AA9FC count=? (unknown_use_2) - values not dumped */
/begin AXIS_PTS AX_1AA9FC "RE axis ptr not OEM" 0x1AA9FC RL_IDENTITY 0 NO_INPUT_QUANTITY 1.0 2 FORMAT "%%5.0" /end AXIS_PTS
/* AXIS_PTS 0x1AAAE8 count=? (unknown_use_2) - values not dumped */
/begin AXIS_PTS AX_1AAAE8 "RE axis ptr not OEM" 0x1AAAE8 RL_IDENTITY 0 NO_INPUT_QUANTITY 1.0 2 FORMAT "%%5.0" /end AXIS_PTS
/* AXIS_PTS 0x1AB808 count=? (unknown_use_2) - values not dumped */
/begin AXIS_PTS AX_1AB808 "RE axis ptr not OEM" 0x1AB808 RL_IDENTITY 0 NO_INPUT_QUANTITY 1.0 2 FORMAT "%%5.0" /end AXIS_PTS
/* AXIS_PTS 0x1AB81C count=? (unknown_use_2) - values not dumped */
/begin AXIS_PTS AX_1AB81C "RE axis ptr not OEM" 0x1AB81C RL_IDENTITY 0 NO_INPUT_QUANTITY 1.0 2 FORMAT "%%5.0" /end AXIS_PTS
/* AXIS_PTS 0x1AB830 count=? (unknown_use_2) - values not dumped */
/begin AXIS_PTS AX_1AB830 "RE axis ptr not OEM" 0x1AB830 RL_IDENTITY 0 NO_INPUT_QUANTITY 1.0 2 FORMAT "%%5.0" /end AXIS_PTS
/* AXIS_PTS 0x1AB87C count=? (unknown_use_2) - values not dumped */
/begin AXIS_PTS AX_1AB87C "RE axis ptr not OEM" 0x1AB87C RL_IDENTITY 0 NO_INPUT_QUANTITY 1.0 2 FORMAT "%%5.0" /end AXIS_PTS
/* AXIS_PTS 0x1AB924 count=? (unknown_use_2) - values not dumped */
/begin AXIS_PTS AX_1AB924 "RE axis ptr not OEM" 0x1AB924 RL_IDENTITY 0 NO_INPUT_QUANTITY 1.0 2 FORMAT "%%5.0" /end AXIS_PTS
/* AXIS_PTS 0x1AC814 count=? (unknown_use_2) - values not dumped */
/begin AXIS_PTS AX_1AC814 "RE axis ptr not OEM" 0x1AC814 RL_IDENTITY 0 NO_INPUT_QUANTITY 1.0 2 FORMAT "%%5.0" /end AXIS_PTS
/* AXIS_PTS 0x1AC85C count=? (unknown_use_2) - values not dumped */
/begin AXIS_PTS AX_1AC85C "RE axis ptr not OEM" 0x1AC85C RL_IDENTITY 0 NO_INPUT_QUANTITY 1.0 2 FORMAT "%%5.0" /end AXIS_PTS
/* AXIS_PTS 0x1AC87C count=? (unknown_use_2) - values not dumped */
/begin AXIS_PTS AX_1AC87C "RE axis ptr not OEM" 0x1AC87C RL_IDENTITY 0 NO_INPUT_QUANTITY 1.0 2 FORMAT "%%5.0" /end AXIS_PTS
/* AXIS_PTS 0x1AC908 count=? (unknown_use_2) - values not dumped */
/begin AXIS_PTS AX_1AC908 "RE axis ptr not OEM" 0x1AC908 RL_IDENTITY 0 NO_INPUT_QUANTITY 1.0 2 FORMAT "%%5.0" /end AXIS_PTS
/* AXIS_PTS 0x1AC92C count=? (unknown_use_2) - values not dumped */
/begin AXIS_PTS AX_1AC92C "RE axis ptr not OEM" 0x1AC92C RL_IDENTITY 0 NO_INPUT_QUANTITY 1.0 2 FORMAT "%%5.0" /end AXIS_PTS
/* AXIS_PTS 0x1AC940 count=? (unknown_use_2) - values not dumped */
/begin AXIS_PTS AX_1AC940 "RE axis ptr not OEM" 0x1AC940 RL_IDENTITY 0 NO_INPUT_QUANTITY 1.0 2 FORMAT "%%5.0" /end AXIS_PTS
/* AXIS_PTS 0x1AC970 count=? (unknown_use_2) - values not dumped */
/begin AXIS_PTS AX_1AC970 "RE axis ptr not OEM" 0x1AC970 RL_IDENTITY 0 NO_INPUT_QUANTITY 1.0 2 FORMAT "%%5.0" /end AXIS_PTS
/* AXIS_PTS 0x1AD850 count=? (unknown_use_2) - values not dumped */
/begin AXIS_PTS AX_1AD850 "RE axis ptr not OEM" 0x1AD850 RL_IDENTITY 0 NO_INPUT_QUANTITY 1.0 2 FORMAT "%%5.0" /end AXIS_PTS
/* AXIS_PTS 0x1AD874 count=16 (from_map) - values not dumped */
/begin AXIS_PTS AX_1AD874 "RE axis ptr not OEM" 0x1AD874 RL_IDENTITY 0 NO_INPUT_QUANTITY 1.0 16 FORMAT "%%5.0" /end AXIS_PTS
/* AXIS_PTS 0x1AD8D0 count=? (unknown_use_2) - values not dumped */
/begin AXIS_PTS AX_1AD8D0 "RE axis ptr not OEM" 0x1AD8D0 RL_IDENTITY 0 NO_INPUT_QUANTITY 1.0 2 FORMAT "%%5.0" /end AXIS_PTS
/* AXIS_PTS 0x1AD8DC count=? (unknown_use_2) - values not dumped */
/begin AXIS_PTS AX_1AD8DC "RE axis ptr not OEM" 0x1AD8DC RL_IDENTITY 0 NO_INPUT_QUANTITY 1.0 2 FORMAT "%%5.0" /end AXIS_PTS
/* AXIS_PTS 0x1AD908 count=? (unknown_use_2) - values not dumped */
/begin AXIS_PTS AX_1AD908 "RE axis ptr not OEM" 0x1AD908 RL_IDENTITY 0 NO_INPUT_QUANTITY 1.0 2 FORMAT "%%5.0" /end AXIS_PTS
/* AXIS_PTS 0x1AD930 count=20 (from_map) - values not dumped */
/begin AXIS_PTS AX_1AD930 "RE axis ptr not OEM" 0x1AD930 RL_IDENTITY 0 NO_INPUT_QUANTITY 1.0 20 FORMAT "%%5.0" /end AXIS_PTS
/* AXIS_PTS 0x1AD940 count=? (unknown_use_2) - values not dumped */
/begin AXIS_PTS AX_1AD940 "RE axis ptr not OEM" 0x1AD940 RL_IDENTITY 0 NO_INPUT_QUANTITY 1.0 2 FORMAT "%%5.0" /end AXIS_PTS
/* AXIS_PTS 0x1AE888 count=? (unknown_use_2) - values not dumped */
/begin AXIS_PTS AX_1AE888 "RE axis ptr not OEM" 0x1AE888 RL_IDENTITY 0 NO_INPUT_QUANTITY 1.0 2 FORMAT "%%5.0" /end AXIS_PTS
/* AXIS_PTS 0x1AE8AC count=12 (from_map) - values not dumped */
/begin AXIS_PTS AX_1AE8AC "RE axis ptr not OEM" 0x1AE8AC RL_IDENTITY 0 NO_INPUT_QUANTITY 1.0 12 FORMAT "%%5.0" /end AXIS_PTS
/* AXIS_PTS 0x1AE8FC count=? (unknown_use_2) - values not dumped */
/begin AXIS_PTS AX_1AE8FC "RE axis ptr not OEM" 0x1AE8FC RL_IDENTITY 0 NO_INPUT_QUANTITY 1.0 2 FORMAT "%%5.0" /end AXIS_PTS
/* AXIS_PTS 0x1AE940 count=? (unknown_use_2) - values not dumped */
/begin AXIS_PTS AX_1AE940 "RE axis ptr not OEM" 0x1AE940 RL_IDENTITY 0 NO_INPUT_QUANTITY 1.0 2 FORMAT "%%5.0" /end AXIS_PTS
/* AXIS_PTS 0x1AE94C count=? (unknown_use_2) - values not dumped */
/begin AXIS_PTS AX_1AE94C "RE axis ptr not OEM" 0x1AE94C RL_IDENTITY 0 NO_INPUT_QUANTITY 1.0 2 FORMAT "%%5.0" /end AXIS_PTS
/* AXIS_PTS 0x1B1874 count=? (unknown_use_2) - values not dumped */
/begin AXIS_PTS AX_1B1874 "RE axis ptr not OEM" 0x1B1874 RL_IDENTITY 0 NO_INPUT_QUANTITY 1.0 2 FORMAT "%%5.0" /end AXIS_PTS
/* AXIS_PTS 0x1B1960 count=? (unknown_use_2) - values not dumped */
/begin AXIS_PTS AX_1B1960 "RE axis ptr not OEM" 0x1B1960 RL_IDENTITY 0 NO_INPUT_QUANTITY 1.0 2 FORMAT "%%5.0" /end AXIS_PTS
/* AXIS_PTS 0x1B1B04 count=? (unknown_use_2) - values not dumped */
/begin AXIS_PTS AX_1B1B04 "RE axis ptr not OEM" 0x1B1B04 RL_IDENTITY 0 NO_INPUT_QUANTITY 1.0 2 FORMAT "%%5.0" /end AXIS_PTS
/* AXIS_PTS 0x1B2868 count=? (unknown_use_2) - values not dumped */
/begin AXIS_PTS AX_1B2868 "RE axis ptr not OEM" 0x1B2868 RL_IDENTITY 0 NO_INPUT_QUANTITY 1.0 2 FORMAT "%%5.0" /end AXIS_PTS
/* AXIS_PTS 0x1B2874 count=? (unknown_use_2) - values not dumped */
/begin AXIS_PTS AX_1B2874 "RE axis ptr not OEM" 0x1B2874 RL_IDENTITY 0 NO_INPUT_QUANTITY 1.0 2 FORMAT "%%5.0" /end AXIS_PTS
/* AXIS_PTS 0x1B292C count=? (unknown_use_2) - values not dumped */
/begin AXIS_PTS AX_1B292C "RE axis ptr not OEM" 0x1B292C RL_IDENTITY 0 NO_INPUT_QUANTITY 1.0 2 FORMAT "%%5.0" /end AXIS_PTS
/* AXIS_PTS 0x1B38C0 count=? (unknown_use_2) - values not dumped */
/begin AXIS_PTS AX_1B38C0 "RE axis ptr not OEM" 0x1B38C0 RL_IDENTITY 0 NO_INPUT_QUANTITY 1.0 2 FORMAT "%%5.0" /end AXIS_PTS
/* AXIS_PTS 0x1B38F8 count=? (unknown_use_2) - values not dumped */
/begin AXIS_PTS AX_1B38F8 "RE axis ptr not OEM" 0x1B38F8 RL_IDENTITY 0 NO_INPUT_QUANTITY 1.0 2 FORMAT "%%5.0" /end AXIS_PTS
/* AXIS_PTS 0x1B3900 count=16 (from_map) - values not dumped */
/begin AXIS_PTS AX_1B3900 "RE axis ptr not OEM" 0x1B3900 RL_IDENTITY 0 NO_INPUT_QUANTITY 1.0 16 FORMAT "%%5.0" /end AXIS_PTS
/* AXIS_PTS 0x1B4894 count=? (unknown_use_2) - values not dumped */
/begin AXIS_PTS AX_1B4894 "RE axis ptr not OEM" 0x1B4894 RL_IDENTITY 0 NO_INPUT_QUANTITY 1.0 2 FORMAT "%%5.0" /end AXIS_PTS
/* AXIS_PTS 0x1B48F0 count=? (unknown_use_2) - values not dumped */
/begin AXIS_PTS AX_1B48F0 "RE axis ptr not OEM" 0x1B48F0 RL_IDENTITY 0 NO_INPUT_QUANTITY 1.0 2 FORMAT "%%5.0" /end AXIS_PTS
/* AXIS_PTS 0x1B491C count=? (unknown_use_2) - values not dumped */
/begin AXIS_PTS AX_1B491C "RE axis ptr not OEM" 0x1B491C RL_IDENTITY 0 NO_INPUT_QUANTITY 1.0 2 FORMAT "%%5.0" /end AXIS_PTS
/* AXIS_PTS 0x1B584C count=? (unknown_use_2) - values not dumped */
/begin AXIS_PTS AX_1B584C "RE axis ptr not OEM" 0x1B584C RL_IDENTITY 0 NO_INPUT_QUANTITY 1.0 2 FORMAT "%%5.0" /end AXIS_PTS
/* AXIS_PTS 0x1B58D4 count=? (unknown_use_2) - values not dumped */
/begin AXIS_PTS AX_1B58D4 "RE axis ptr not OEM" 0x1B58D4 RL_IDENTITY 0 NO_INPUT_QUANTITY 1.0 2 FORMAT "%%5.0" /end AXIS_PTS
/* AXIS_PTS 0x1B594C count=? (unknown_use_2) - values not dumped */
/begin AXIS_PTS AX_1B594C "RE axis ptr not OEM" 0x1B594C RL_IDENTITY 0 NO_INPUT_QUANTITY 1.0 2 FORMAT "%%5.0" /end AXIS_PTS
/* AXIS_PTS 0x1B5978 count=16 (from_map) - values not dumped */
/begin AXIS_PTS AX_1B5978 "RE axis ptr not OEM" 0x1B5978 RL_IDENTITY 0 NO_INPUT_QUANTITY 1.0 16 FORMAT "%%5.0" /end AXIS_PTS
/* AXIS_PTS 0x1B675C count=? (unknown_use_2) - values not dumped */
/begin AXIS_PTS AX_1B675C "RE axis ptr not OEM" 0x1B675C RL_IDENTITY 0 NO_INPUT_QUANTITY 1.0 2 FORMAT "%%5.0" /end AXIS_PTS
/* AXIS_PTS 0x1B6938 count=? (unknown_use_2) - values not dumped */
/begin AXIS_PTS AX_1B6938 "RE axis ptr not OEM" 0x1B6938 RL_IDENTITY 0 NO_INPUT_QUANTITY 1.0 2 FORMAT "%%5.0" /end AXIS_PTS
/* AXIS_PTS 0x1B7858 count=? (unknown_use_2) - values not dumped */
/begin AXIS_PTS AX_1B7858 "RE axis ptr not OEM" 0x1B7858 RL_IDENTITY 0 NO_INPUT_QUANTITY 1.0 2 FORMAT "%%5.0" /end AXIS_PTS
/* AXIS_PTS 0x1B7914 count=? (unknown_use_2) - values not dumped */
/begin AXIS_PTS AX_1B7914 "RE axis ptr not OEM" 0x1B7914 RL_IDENTITY 0 NO_INPUT_QUANTITY 1.0 2 FORMAT "%%5.0" /end AXIS_PTS
/* AXIS_PTS 0x1B7938 count=? (unknown_use_2) - values not dumped */
/begin AXIS_PTS AX_1B7938 "RE axis ptr not OEM" 0x1B7938 RL_IDENTITY 0 NO_INPUT_QUANTITY 1.0 2 FORMAT "%%5.0" /end AXIS_PTS
/* AXIS_PTS 0x1B7C18 count=? (unknown_use_2) - values not dumped */
/begin AXIS_PTS AX_1B7C18 "RE axis ptr not OEM" 0x1B7C18 RL_IDENTITY 0 NO_INPUT_QUANTITY 1.0 2 FORMAT "%%5.0" /end AXIS_PTS
/* AXIS_PTS 0x1B8958 count=? (unknown_use_2) - values not dumped */
/begin AXIS_PTS AX_1B8958 "RE axis ptr not OEM" 0x1B8958 RL_IDENTITY 0 NO_INPUT_QUANTITY 1.0 2 FORMAT "%%5.0" /end AXIS_PTS
/* AXIS_PTS 0x1B89C8 count=? (unknown_use_2) - values not dumped */
/begin AXIS_PTS AX_1B89C8 "RE axis ptr not OEM" 0x1B89C8 RL_IDENTITY 0 NO_INPUT_QUANTITY 1.0 2 FORMAT "%%5.0" /end AXIS_PTS
/* AXIS_PTS 0x1B8A60 count=? (unknown_use_2) - values not dumped */
/begin AXIS_PTS AX_1B8A60 "RE axis ptr not OEM" 0x1B8A60 RL_IDENTITY 0 NO_INPUT_QUANTITY 1.0 2 FORMAT "%%5.0" /end AXIS_PTS
/* AXIS_PTS 0x1B9998 count=? (unknown_use_2) - values not dumped */
/begin AXIS_PTS AX_1B9998 "RE axis ptr not OEM" 0x1B9998 RL_IDENTITY 0 NO_INPUT_QUANTITY 1.0 2 FORMAT "%%5.0" /end AXIS_PTS
/* AXIS_PTS 0x1BA714 count=? (unknown_use_2) - values not dumped */
/begin AXIS_PTS AX_1BA714 "RE axis ptr not OEM" 0x1BA714 RL_IDENTITY 0 NO_INPUT_QUANTITY 1.0 2 FORMAT "%%5.0" /end AXIS_PTS
/* AXIS_PTS 0x1BB960 count=? (unknown_use_2) - values not dumped */
/begin AXIS_PTS AX_1BB960 "RE axis ptr not OEM" 0x1BB960 RL_IDENTITY 0 NO_INPUT_QUANTITY 1.0 2 FORMAT "%%5.0" /end AXIS_PTS
/* AXIS_PTS 0x1BB9F8 count=? (unknown_use_2) - values not dumped */
/begin AXIS_PTS AX_1BB9F8 "RE axis ptr not OEM" 0x1BB9F8 RL_IDENTITY 0 NO_INPUT_QUANTITY 1.0 2 FORMAT "%%5.0" /end AXIS_PTS
/* AXIS_PTS 0x1BBAD8 count=? (unknown_use_2) - values not dumped */
/begin AXIS_PTS AX_1BBAD8 "RE axis ptr not OEM" 0x1BBAD8 RL_IDENTITY 0 NO_INPUT_QUANTITY 1.0 2 FORMAT "%%5.0" /end AXIS_PTS
/* AXIS_PTS 0x1BC7B0 count=? (unknown_use_2) - values not dumped */
/begin AXIS_PTS AX_1BC7B0 "RE axis ptr not OEM" 0x1BC7B0 RL_IDENTITY 0 NO_INPUT_QUANTITY 1.0 2 FORMAT "%%5.0" /end AXIS_PTS
/* AXIS_PTS 0x1BC9F8 count=? (unknown_use_2) - values not dumped */
/begin AXIS_PTS AX_1BC9F8 "RE axis ptr not OEM" 0x1BC9F8 RL_IDENTITY 0 NO_INPUT_QUANTITY 1.0 2 FORMAT "%%5.0" /end AXIS_PTS
/* AXIS_PTS 0x1BD9E4 count=? (unknown_use_2) - values not dumped */
/begin AXIS_PTS AX_1BD9E4 "RE axis ptr not OEM" 0x1BD9E4 RL_IDENTITY 0 NO_INPUT_QUANTITY 1.0 2 FORMAT "%%5.0" /end AXIS_PTS
/* AXIS_PTS 0x1BF6B4 count=? (unknown_use_2) - values not dumped */
/begin AXIS_PTS AX_1BF6B4 "RE axis ptr not OEM" 0x1BF6B4 RL_IDENTITY 0 NO_INPUT_QUANTITY 1.0 2 FORMAT "%%5.0" /end AXIS_PTS
/* src=families fam=C_fam_0341 ax=0x- ay=0x- */
/begin CHARACTERISTIC C_fam_0341_19FDC0 "RE map_interp_C C_fam_0341 call=0x80112CCA" VALUE 0x19FDC0 RL_IDENTITY 0 NO_INPUT_QUANTITY 1.0 /end CHARACTERISTIC
/* src=families fam=O_fam_0017 ax=0x- ay=0x- */
/begin CHARACTERISTIC O_fam_0017_19FDCC "RE map_interp_O O_fam_0017 call=0x80112C3A" VALUE 0x19FDCC RL_IDENTITY 0 NO_INPUT_QUANTITY 1.0 /end CHARACTERISTIC
/begin CHARACTERISTIC DTC_P2080 "atlas9979 DTC_P2080 / DTC OFF P2080 (EGT) (IdName Caddy 9979 - verifier sur 9980" VALUE 0x19FE09 RL_IDENTITY 0 NO_INPUT_QUANTITY 1.0 /end CHARACTERISTIC
/begin CHARACTERISTIC DTC_P242B "atlas9979 DTC_P242B / DTC OFF P242B (EGT) (IdName Caddy 9979 - verifier sur 9980" VALUE 0x19FE35 RL_IDENTITY 0 NO_INPUT_QUANTITY 1.0 /end CHARACTERISTIC
/begin CHARACTERISTIC DTC_P2002 "atlas9979 DTC_P2002 / DTC OFF P2002 (DPF) (IdName Caddy 9979 - verifier sur 9980" VALUE 0x1A0071 RL_IDENTITY 0 NO_INPUT_QUANTITY 1.0 /end CHARACTERISTIC
/begin CHARACTERISTIC DTC_P2453 "atlas9979 DTC_P2453 / DTC OFF P2453 (DPF) (IdName Caddy 9979 - verifier sur 9980" VALUE 0x1A009D RL_IDENTITY 0 NO_INPUT_QUANTITY 1.0 /end CHARACTERISTIC
/begin CHARACTERISTIC DTC_P0471 "atlas9979 DTC_P0471 / DTC OFF P0471 (DPF) (IdName Caddy 9979 - verifier sur 9980" VALUE 0x1A01D1 RL_IDENTITY 0 NO_INPUT_QUANTITY 1.0 /end CHARACTERISTIC
/begin CHARACTERISTIC DTC_P2456 "atlas9979 DTC_P2456 / DTC OFF P2456 (DPF) (IdName Caddy 9979 - verifier sur 9980" VALUE 0x1A0229 RL_IDENTITY 0 NO_INPUT_QUANTITY 1.0 /end CHARACTERISTIC
/begin CHARACTERISTIC DTC_P2425 "atlas9979 DTC_P2425 / DTC OFF P2425 (EGR) (IdName Caddy 9979 - verifier sur 9980" VALUE 0x1A06A1 RL_IDENTITY 0 NO_INPUT_QUANTITY 1.0 /end CHARACTERISTIC
/begin CHARACTERISTIC DTC_P2426 "atlas9979 DTC_P2426 / DTC OFF P2426 (EGR) (IdName Caddy 9979 - verifier sur 9980" VALUE 0x1A06CD RL_IDENTITY 0 NO_INPUT_QUANTITY 1.0 /end CHARACTERISTIC
/begin CHARACTERISTIC DTC_P2427 "atlas9979 DTC_P2427 / DTC OFF P2427 (EGR) (IdName Caddy 9979 - verifier sur 9980" VALUE 0x1A06F9 RL_IDENTITY 0 NO_INPUT_QUANTITY 1.0 /end CHARACTERISTIC
/begin CHARACTERISTIC DTC_P0401 "atlas9979 DTC_P0401 / DTC OFF P0401 (EGR) (IdName Caddy 9979 - verifier sur 9980" VALUE 0x1A0725 RL_IDENTITY 0 NO_INPUT_QUANTITY 1.0 /end CHARACTERISTIC
/begin CHARACTERISTIC DTC_P0402 "atlas9979 DTC_P0402 / DTC OFF P0402 (EGR) (IdName Caddy 9979 - verifier sur 9980" VALUE 0x1A0751 RL_IDENTITY 0 NO_INPUT_QUANTITY 1.0 /end CHARACTERISTIC
/begin CHARACTERISTIC DTC_P0403 "atlas9979 DTC_P0403 / DTC OFF P0403 (EGR) (IdName Caddy 9979 - verifier sur 9980" VALUE 0x1A0885 RL_IDENTITY 0 NO_INPUT_QUANTITY 1.0 /end CHARACTERISTIC
/begin CHARACTERISTIC DTC_P0400 "atlas9979 DTC_P0400 / DTC OFF P0400 (EGR) (IdName Caddy 9979 - verifier sur 9980" VALUE 0x1A0935 RL_IDENTITY 0 NO_INPUT_QUANTITY 1.0 /end CHARACTERISTIC
/begin CHARACTERISTIC DTC_P1400 "atlas9979 DTC_P1400 / DTC OFF P1400 (EGR) (IdName Caddy 9979 - verifier sur 9980" VALUE 0x1A0961 RL_IDENTITY 0 NO_INPUT_QUANTITY 1.0 /end CHARACTERISTIC
/begin CHARACTERISTIC DTC_P2463 "atlas9979 DTC_P2463 / DTC OFF P2463 (DPF) (IdName Caddy 9979 - verifier sur 9980" VALUE 0x1A1409 RL_IDENTITY 0 NO_INPUT_QUANTITY 1.0 /end CHARACTERISTIC
/begin CHARACTERISTIC DTC_P2626 "atlas9979 DTC_P2626 / DTC OFF P2626 (DPF/O2) (IdName Caddy 9979 - verifier sur 9" VALUE 0x1A1931 RL_IDENTITY 0 NO_INPUT_QUANTITY 1.0 /end CHARACTERISTIC
/begin CHARACTERISTIC DTC_P3004 "atlas9979 DTC_P3004 / DTC OFF P3004 (DPF) (IdName Caddy 9979 - verifier sur 9980" VALUE 0x1A22A5 RL_IDENTITY 0 NO_INPUT_QUANTITY 1.0 /end CHARACTERISTIC
/begin CHARACTERISTIC DTC_P3005 "atlas9979 DTC_P3005 / DTC OFF P3005 (DPF) (IdName Caddy 9979 - verifier sur 9980" VALUE 0x1A2381 RL_IDENTITY 0 NO_INPUT_QUANTITY 1.0 /end CHARACTERISTIC
/begin CHARACTERISTIC DTC_P2458 "atlas9979 DTC_P2458 / DTC OFF P2458 (DPF) (IdName Caddy 9979 - verifier sur 9980" VALUE 0x1A2959 RL_IDENTITY 0 NO_INPUT_QUANTITY 1.0 /end CHARACTERISTIC
/begin CHARACTERISTIC DTC_P0544 "atlas9979 DTC_P0544 / DTC OFF P0544 (EGT) (IdName Caddy 9979 - verifier sur 9980" VALUE 0x1A2CC9 RL_IDENTITY 0 NO_INPUT_QUANTITY 1.0 /end CHARACTERISTIC
/begin CHARACTERISTIC DTC_P246E "atlas9979 DTC_P246E / DTC OFF P246E (EGT) (IdName Caddy 9979 - verifier sur 9980" VALUE 0x1A2DA5 RL_IDENTITY 0 NO_INPUT_QUANTITY 1.0 /end CHARACTERISTIC
/begin CHARACTERISTIC DTC_P0545 "atlas9979 DTC_P0545 / DTC OFF P0545 (EGT) (IdName Caddy 9979 - verifier sur 9980" VALUE 0x1A2DD1 RL_IDENTITY 0 NO_INPUT_QUANTITY 1.0 /end CHARACTERISTIC
/begin CHARACTERISTIC DTC_P2455 "atlas9979 DTC_P2455 / DTC OFF P2455 (DPF) (IdName Caddy 9979 - verifier sur 9980" VALUE 0x1A32A1 RL_IDENTITY 0 NO_INPUT_QUANTITY 1.0 /end CHARACTERISTIC
/begin CHARACTERISTIC DTC_P046C "atlas9979 DTC_P046C / DTC OFF P046C (EGR/DPF) (IdName Caddy 9979 - verifier sur " VALUE 0x1A32CD RL_IDENTITY 0 NO_INPUT_QUANTITY 1.0 /end CHARACTERISTIC
/begin CHARACTERISTIC DTC_P0408 "atlas9979 DTC_P0408 / DTC OFF P0408 (EGR) (IdName Caddy 9979 - verifier sur 9980" VALUE 0x1A3325 RL_IDENTITY 0 NO_INPUT_QUANTITY 1.0 /end CHARACTERISTIC
/begin CHARACTERISTIC turbo_base3B "atlas9979 turbo_base3B / Turbo boost pressure request (IdName Caddy 9979 - verif" MAP 0x1C04AC RL_IDENTITY 0 NO_INPUT_QUANTITY 1.0 FORMAT "%%5.0"
 /begin AXIS_DESCR COM_AXIS NO_INPUT_QUANTITY NO_COMPU_METHOD 16 AXIS_PTS_REF AX_1A7B26 /end AXIS_DESCR
 /begin AXIS_DESCR COM_AXIS NO_INPUT_QUANTITY NO_COMPU_METHOD 20 AXIS_PTS_REF AX_1A5B6C /end AXIS_DESCR
/end CHARACTERISTIC
/begin CHARACTERISTIC turbo_base3B_1C072C "atlas9979 turbo_base3B@1C072C / Turbo boost pressure request (IdName Caddy 9979 " MAP 0x1C072C RL_IDENTITY 0 NO_INPUT_QUANTITY 1.0 FORMAT "%%5.0"
 /begin AXIS_DESCR COM_AXIS NO_INPUT_QUANTITY NO_COMPU_METHOD 16 AXIS_PTS_REF AX_1A7B26 /end AXIS_DESCR
 /begin AXIS_DESCR COM_AXIS NO_INPUT_QUANTITY NO_COMPU_METHOD 20 AXIS_PTS_REF AX_1A5B6C /end AXIS_DESCR
/end CHARACTERISTIC
/* src=families fam=C_fam_0329 ax=0x- ay=0x- */
/begin CHARACTERISTIC C_fam_0329_1C088C "RE map_interp_C C_fam_0329 call=0x800F8F0A" VALUE 0x1C088C RL_IDENTITY 0 NO_INPUT_QUANTITY 1.0 /end CHARACTERISTIC
/* src=families fam=E_fam_0004 ax=0x1AA908 ay=0x1B8958 */
/begin CHARACTERISTIC E_fam_0004_1C08D8 "RE map_interp_E E_fam_0004 call=0x800E4684" MAP 0x1C08D8 RL_IDENTITY 0 NO_INPUT_QUANTITY 1.0 FORMAT "%%5.0"
 /begin AXIS_DESCR COM_AXIS NO_INPUT_QUANTITY NO_COMPU_METHOD 2 AXIS_PTS_REF AX_1AA908 /end AXIS_DESCR
 /begin AXIS_DESCR COM_AXIS NO_INPUT_QUANTITY NO_COMPU_METHOD 2 AXIS_PTS_REF AX_1B8958 /end AXIS_DESCR
/end CHARACTERISTIC
/* src=families fam=D_fam_0060 ax=0x1B7858 ay=0x1AE888 */
/begin CHARACTERISTIC D_fam_0060_1C0940 "RE map_interp_D D_fam_0060 call=0x80112490; RE map_interp_E E_fam_0022 call=0x80" MAP 0x1C0940 RL_IDENTITY 0 NO_INPUT_QUANTITY 1.0 FORMAT "%%5.0"
 /begin AXIS_DESCR COM_AXIS NO_INPUT_QUANTITY NO_COMPU_METHOD 2 AXIS_PTS_REF AX_1B7858 /end AXIS_DESCR
 /begin AXIS_DESCR COM_AXIS NO_INPUT_QUANTITY NO_COMPU_METHOD 2 AXIS_PTS_REF AX_1AE888 /end AXIS_DESCR
/end CHARACTERISTIC
/* src=families fam=E_fam_0020 ax=0x1A89E4 ay=0x1B7858 */
/begin CHARACTERISTIC E_fam_0020_1C094C "RE map_interp_E E_fam_0020 call=0x80112530" MAP 0x1C094C RL_IDENTITY 0 NO_INPUT_QUANTITY 1.0 FORMAT "%%5.0"
 /begin AXIS_DESCR COM_AXIS NO_INPUT_QUANTITY NO_COMPU_METHOD 2 AXIS_PTS_REF AX_1A89E4 /end AXIS_DESCR
 /begin AXIS_DESCR COM_AXIS NO_INPUT_QUANTITY NO_COMPU_METHOD 2 AXIS_PTS_REF AX_1B7858 /end AXIS_DESCR
/end CHARACTERISTIC
/* src=families fam=D_fam_0051 ax=0x1AE888 ay=0x1A64E4 */
/begin CHARACTERISTIC D_fam_0051_1C0958 "RE map_interp_D D_fam_0051 call=0x801123BE; RE map_interp_E E_fam_0012 call=0x80" MAP 0x1C0958 RL_IDENTITY 0 NO_INPUT_QUANTITY 1.0 FORMAT "%%5.0"
 /begin AXIS_DESCR COM_AXIS NO_INPUT_QUANTITY NO_COMPU_METHOD 2 AXIS_PTS_REF AX_1AE888 /end AXIS_DESCR
 /begin AXIS_DESCR COM_AXIS NO_INPUT_QUANTITY NO_COMPU_METHOD 2 AXIS_PTS_REF AX_1A64E4 /end AXIS_DESCR
/end CHARACTERISTIC
/* src=families fam=D_fam_0096 ax=0x1B0880 ay=0x- */ /* STUB unknown size; axis_x=0x1B0880 axis_y=0x- */
/begin CHARACTERISTIC D_fam_0096_1C0964 "RE map_interp_D D_fam_0096 call=0x800F58B8; RE map_interp_I I_fam_0117 call=0x80" VALUE 0x1C0964 RL_IDENTITY 0 NO_INPUT_QUANTITY 1.0 /end CHARACTERISTIC
/begin CHARACTERISTIC turbo_base3B_1C09AC "atlas9979 turbo_base3B@1C09AC / Turbo boost pressure request (IdName Caddy 9979 " MAP 0x1C09AC RL_IDENTITY 0 NO_INPUT_QUANTITY 1.0 FORMAT "%%5.0"
 /begin AXIS_DESCR COM_AXIS NO_INPUT_QUANTITY NO_COMPU_METHOD 16 AXIS_PTS_REF AX_1A7B26 /end AXIS_DESCR
 /begin AXIS_DESCR COM_AXIS NO_INPUT_QUANTITY NO_COMPU_METHOD 20 AXIS_PTS_REF AX_1A5B6C /end AXIS_DESCR
/end CHARACTERISTIC
/* src=families fam=D_fam_0081 ax=0x1A65FC ay=0x1A37D4 */
/begin CHARACTERISTIC D_fam_0081_1C09B0 "RE map_interp_D D_fam_0081 call=0x800F193C; RE map_interp_G G_fam_0035 call=0x80" MAP 0x1C09B0 RL_IDENTITY 0 NO_INPUT_QUANTITY 1.0 FORMAT "%%5.0"
 /begin AXIS_DESCR COM_AXIS NO_INPUT_QUANTITY NO_COMPU_METHOD 2 AXIS_PTS_REF AX_1A65FC /end AXIS_DESCR
 /begin AXIS_DESCR COM_AXIS NO_INPUT_QUANTITY NO_COMPU_METHOD 2 AXIS_PTS_REF AX_1A37D4 /end AXIS_DESCR
/end CHARACTERISTIC
/* src=families fam=L_fam_0008 ax=0x1A9AE8 ay=0x1A8AE8 */
/begin CHARACTERISTIC L_fam_0008_1C0A04 "RE map_interp_L L_fam_0008 call=0x8009B086; RE map_interp_O O_fam_0002 call=0x80" MAP 0x1C0A04 RL_IDENTITY 0 NO_INPUT_QUANTITY 1.0 FORMAT "%%5.0"
 /begin AXIS_DESCR COM_AXIS NO_INPUT_QUANTITY NO_COMPU_METHOD 2 AXIS_PTS_REF AX_1A9AE8 /end AXIS_DESCR
 /begin AXIS_DESCR COM_AXIS NO_INPUT_QUANTITY NO_COMPU_METHOD 2 AXIS_PTS_REF AX_1A8AE8 /end AXIS_DESCR
/end CHARACTERISTIC
/* src=families fam=C_fam_0256 ax=0x- ay=0x- */
/begin CHARACTERISTIC C_fam_0256_1C0A84 "RE map_interp_C C_fam_0256 call=0x80078AD6" VALUE 0x1C0A84 RL_IDENTITY 0 NO_INPUT_QUANTITY 1.0 /end CHARACTERISTIC
/* src=families fam=C_fam_0169 ax=0x1B4870 ay=0x- */ /* STUB unknown size; axis_x=0x1B4870 axis_y=0x- */
/begin CHARACTERISTIC C_fam_0169_1C0A98 "RE map_interp_C C_fam_0169 call=0x80085C3A" VALUE 0x1C0A98 RL_IDENTITY 0 NO_INPUT_QUANTITY 1.0 /end CHARACTERISTIC
/* src=families fam=O_fam_0003 ax=0x1B1874 ay=0x1B1874 */
/begin CHARACTERISTIC O_fam_0003_1C0AA4 "RE map_interp_O O_fam_0003 call=0x8009ACB8" MAP 0x1C0AA4 RL_IDENTITY 0 NO_INPUT_QUANTITY 1.0 FORMAT "%%5.0"
 /begin AXIS_DESCR COM_AXIS NO_INPUT_QUANTITY NO_COMPU_METHOD 2 AXIS_PTS_REF AX_1B1874 /end AXIS_DESCR
 /begin AXIS_DESCR COM_AXIS NO_INPUT_QUANTITY NO_COMPU_METHOD 2 AXIS_PTS_REF AX_1B1874 /end AXIS_DESCR
/end CHARACTERISTIC
/* src=families fam=C_fam_0038 ax=0x- ay=0x- */
/begin CHARACTERISTIC C_fam_0038_1C0AC4 "RE map_interp_C C_fam_0038 call=0x800A2EE2" VALUE 0x1C0AC4 RL_IDENTITY 0 NO_INPUT_QUANTITY 1.0 /end CHARACTERISTIC
/* src=families fam=C_fam_0197 ax=0x- ay=0x- */
/begin CHARACTERISTIC C_fam_0197_1C0AD0 "RE map_interp_C C_fam_0197 call=0x80078AB4" VALUE 0x1C0AD0 RL_IDENTITY 0 NO_INPUT_QUANTITY 1.0 /end CHARACTERISTIC
/* src=families fam=O_fam_0003 ax=0x1B1874 ay=0x1B1874 */
/begin CHARACTERISTIC O_fam_0003_1C0AE4 "RE map_interp_O O_fam_0003 call=0x8009AD22" MAP 0x1C0AE4 RL_IDENTITY 0 NO_INPUT_QUANTITY 1.0 FORMAT "%%5.0"
 /begin AXIS_DESCR COM_AXIS NO_INPUT_QUANTITY NO_COMPU_METHOD 2 AXIS_PTS_REF AX_1B1874 /end AXIS_DESCR
 /begin AXIS_DESCR COM_AXIS NO_INPUT_QUANTITY NO_COMPU_METHOD 2 AXIS_PTS_REF AX_1B1874 /end AXIS_DESCR
/end CHARACTERISTIC
/begin CHARACTERISTIC turbo_base3B_1C0C2C "atlas9979 turbo_base3B@1C0C2C / Turbo boost pressure request (IdName Caddy 9979 " MAP 0x1C0C2C RL_IDENTITY 0 NO_INPUT_QUANTITY 1.0 FORMAT "%%5.0"
 /begin AXIS_DESCR COM_AXIS NO_INPUT_QUANTITY NO_COMPU_METHOD 16 AXIS_PTS_REF AX_1A7B26 /end AXIS_DESCR
 /begin AXIS_DESCR COM_AXIS NO_INPUT_QUANTITY NO_COMPU_METHOD 20 AXIS_PTS_REF AX_1A5B6C /end AXIS_DESCR
/end CHARACTERISTIC
/begin CHARACTERISTIC turbo_base3B_1C0EAC "atlas9979 turbo_base3B@1C0EAC / Turbo boost pressure request (IdName Caddy 9979 " MAP 0x1C0EAC RL_IDENTITY 0 NO_INPUT_QUANTITY 1.0 FORMAT "%%5.0"
 /begin AXIS_DESCR COM_AXIS NO_INPUT_QUANTITY NO_COMPU_METHOD 16 AXIS_PTS_REF AX_1A7B26 /end AXIS_DESCR
 /begin AXIS_DESCR COM_AXIS NO_INPUT_QUANTITY NO_COMPU_METHOD 20 AXIS_PTS_REF AX_1A5B6C /end AXIS_DESCR
/end CHARACTERISTIC
/begin CHARACTERISTIC turbo_base3B_1C112C "atlas9979 turbo_base3B@1C112C / Turbo boost pressure request (IdName Caddy 9979 " MAP 0x1C112C RL_IDENTITY 0 NO_INPUT_QUANTITY 1.0 FORMAT "%%5.0"
 /begin AXIS_DESCR COM_AXIS NO_INPUT_QUANTITY NO_COMPU_METHOD 16 AXIS_PTS_REF AX_1A7B26 /end AXIS_DESCR
 /begin AXIS_DESCR COM_AXIS NO_INPUT_QUANTITY NO_COMPU_METHOD 20 AXIS_PTS_REF AX_1A5B6C /end AXIS_DESCR
/end CHARACTERISTIC
/begin CHARACTERISTIC turbo_base3B_1C13AC "atlas9979 turbo_base3B@1C13AC / Turbo boost pressure request (IdName Caddy 9979 " MAP 0x1C13AC RL_IDENTITY 0 NO_INPUT_QUANTITY 1.0 FORMAT "%%5.0"
 /begin AXIS_DESCR COM_AXIS NO_INPUT_QUANTITY NO_COMPU_METHOD 16 AXIS_PTS_REF AX_1A7B26 /end AXIS_DESCR
 /begin AXIS_DESCR COM_AXIS NO_INPUT_QUANTITY NO_COMPU_METHOD 20 AXIS_PTS_REF AX_1A5B6C /end AXIS_DESCR
/end CHARACTERISTIC
/begin CHARACTERISTIC turbo_base3B_1C162C "atlas9979 turbo_base3B@1C162C / Turbo boost pressure request (IdName Caddy 9979 " MAP 0x1C162C RL_IDENTITY 0 NO_INPUT_QUANTITY 1.0 FORMAT "%%5.0"
 /begin AXIS_DESCR COM_AXIS NO_INPUT_QUANTITY NO_COMPU_METHOD 16 AXIS_PTS_REF AX_1A7B26 /end AXIS_DESCR
 /begin AXIS_DESCR COM_AXIS NO_INPUT_QUANTITY NO_COMPU_METHOD 20 AXIS_PTS_REF AX_1A5B6C /end AXIS_DESCR
/end CHARACTERISTIC
/begin CHARACTERISTIC turbo_base3B_1C18AC "atlas9979 turbo_base3B@1C18AC / Turbo boost pressure request (IdName Caddy 9979 " MAP 0x1C18AC RL_IDENTITY 0 NO_INPUT_QUANTITY 1.0 FORMAT "%%5.0"
 /begin AXIS_DESCR COM_AXIS NO_INPUT_QUANTITY NO_COMPU_METHOD 16 AXIS_PTS_REF AX_1A7B26 /end AXIS_DESCR
 /begin AXIS_DESCR COM_AXIS NO_INPUT_QUANTITY NO_COMPU_METHOD 20 AXIS_PTS_REF AX_1A5B6C /end AXIS_DESCR
/end CHARACTERISTIC
/* src=families fam=D_fam_0102 ax=0x1B68A8 ay=0x- */ /* STUB unknown size; axis_x=0x1B68A8 axis_y=0x- */
/begin CHARACTERISTIC D_fam_0102_1C1950 "RE map_interp_D D_fam_0102 call=0x800E2122; RE map_interp_I I_fam_0110 call=0x80" VALUE 0x1C1950 RL_IDENTITY 0 NO_INPUT_QUANTITY 1.0 /end CHARACTERISTIC
/* src=families fam=D_fam_0074 ax=0x1A2580 ay=0x- */ /* STUB unknown size; axis_x=0x1A2580 axis_y=0x- */
/begin CHARACTERISTIC D_fam_0074_1C197C "RE map_interp_D D_fam_0074 call=0x800E9084; RE map_interp_I I_fam_0113 call=0x80" VALUE 0x1C197C RL_IDENTITY 0 NO_INPUT_QUANTITY 1.0 /end CHARACTERISTIC
/begin CHARACTERISTIC turbo_base3B_1C1B2C "atlas9979 turbo_base3B@1C1B2C / Turbo boost pressure request (IdName Caddy 9979 " MAP 0x1C1B2C RL_IDENTITY 0 NO_INPUT_QUANTITY 1.0 FORMAT "%%5.0"
 /begin AXIS_DESCR COM_AXIS NO_INPUT_QUANTITY NO_COMPU_METHOD 16 AXIS_PTS_REF AX_1A7B26 /end AXIS_DESCR
 /begin AXIS_DESCR COM_AXIS NO_INPUT_QUANTITY NO_COMPU_METHOD 20 AXIS_PTS_REF AX_1A5B6C /end AXIS_DESCR
/end CHARACTERISTIC
/* src=families fam=fam_0006 ax=0x1AD874 ay=0x1AD930 */
/begin CHARACTERISTIC turbo_base3B_1C1B50 "HIGH 9980 ident = turbo_base3B; high: empreinte diverse = famille A2L turbo_base" MAP 0x1C1B50 RL_IDENTITY 0 NO_INPUT_QUANTITY 1.0 FORMAT "%%5.0"
 /begin AXIS_DESCR COM_AXIS NO_INPUT_QUANTITY NO_COMPU_METHOD 16 AXIS_PTS_REF AX_1AD874 /end AXIS_DESCR
 /begin AXIS_DESCR COM_AXIS NO_INPUT_QUANTITY NO_COMPU_METHOD 20 AXIS_PTS_REF AX_1AD930 /end AXIS_DESCR
/end CHARACTERISTIC
/begin CHARACTERISTIC turbo_base3B_1C1DAC "atlas9979 turbo_base3B@1C1DAC / Turbo boost pressure request (IdName Caddy 9979 " MAP 0x1C1DAC RL_IDENTITY 0 NO_INPUT_QUANTITY 1.0 FORMAT "%%5.0"
 /begin AXIS_DESCR COM_AXIS NO_INPUT_QUANTITY NO_COMPU_METHOD 16 AXIS_PTS_REF AX_1A7B26 /end AXIS_DESCR
 /begin AXIS_DESCR COM_AXIS NO_INPUT_QUANTITY NO_COMPU_METHOD 20 AXIS_PTS_REF AX_1A5B6C /end AXIS_DESCR
/end CHARACTERISTIC
/begin CHARACTERISTIC turbo_base3B_1C202C "atlas9979 turbo_base3B@1C202C / Turbo boost pressure request (IdName Caddy 9979 " MAP 0x1C202C RL_IDENTITY 0 NO_INPUT_QUANTITY 1.0 FORMAT "%%5.0"
 /begin AXIS_DESCR COM_AXIS NO_INPUT_QUANTITY NO_COMPU_METHOD 16 AXIS_PTS_REF AX_1A7B26 /end AXIS_DESCR
 /begin AXIS_DESCR COM_AXIS NO_INPUT_QUANTITY NO_COMPU_METHOD 20 AXIS_PTS_REF AX_1A5B6C /end AXIS_DESCR
/end CHARACTERISTIC
/* src=families fam=F_fam_0188 ax=0x- ay=0x- */
/begin CHARACTERISTIC F_fam_0188_1C206C "RE map_interp_F F_fam_0188 call=0x800F16FE; RE map_interp_K K_fam_0085 call=0x80" VALUE 0x1C206C RL_IDENTITY 0 NO_INPUT_QUANTITY 1.0 /end CHARACTERISTIC
/* src=families fam=C_fam_0096 ax=0x1AB830 ay=0x1BA714 */
/begin CHARACTERISTIC C_fam_0096_1C2714 "RE map_interp_C C_fam_0096 call=0x801124E0; RE map_interp_F F_fam_0067 call=0x80" MAP 0x1C2714 RL_IDENTITY 0 NO_INPUT_QUANTITY 1.0 FORMAT "%%5.0"
 /begin AXIS_DESCR COM_AXIS NO_INPUT_QUANTITY NO_COMPU_METHOD 2 AXIS_PTS_REF AX_1AB830 /end AXIS_DESCR
 /begin AXIS_DESCR COM_AXIS NO_INPUT_QUANTITY NO_COMPU_METHOD 2 AXIS_PTS_REF AX_1BA714 /end AXIS_DESCR
/end CHARACTERISTIC
/* src=families fam=C_fam_0095 ax=0x1AB830 ay=0x1A64E4 */
/begin CHARACTERISTIC C_fam_0095_1C2754 "RE map_interp_C C_fam_0095 call=0x80112420; RE map_interp_F F_fam_0016 call=0x80" MAP 0x1C2754 RL_IDENTITY 0 NO_INPUT_QUANTITY 1.0 FORMAT "%%5.0"
 /begin AXIS_DESCR COM_AXIS NO_INPUT_QUANTITY NO_COMPU_METHOD 2 AXIS_PTS_REF AX_1AB830 /end AXIS_DESCR
 /begin AXIS_DESCR COM_AXIS NO_INPUT_QUANTITY NO_COMPU_METHOD 2 AXIS_PTS_REF AX_1A64E4 /end AXIS_DESCR
/end CHARACTERISTIC
/* src=families fam=fam_0053 ax=0x1A64D4 ay=0x1A64E4 */
/begin CHARACTERISTIC map_horsA2L_1C2794 "RE interp_2d fam_0053 call=0x80112356" MAP 0x1C2794 RL_IDENTITY 0 NO_INPUT_QUANTITY 1.0 FORMAT "%%5.0"
 /begin AXIS_DESCR COM_AXIS NO_INPUT_QUANTITY NO_COMPU_METHOD 5 AXIS_PTS_REF AX_1A64D4 /end AXIS_DESCR
 /begin AXIS_DESCR COM_AXIS NO_INPUT_QUANTITY NO_COMPU_METHOD 2 AXIS_PTS_REF AX_1A64E4 /end AXIS_DESCR
/end CHARACTERISTIC
/* src=families fam=C_fam_0055 ax=0x1A1528 ay=0x1A36C0 */
/begin CHARACTERISTIC C_fam_0055_1C2920 "RE map_interp_C C_fam_0055 call=0x8011263C" MAP 0x1C2920 RL_IDENTITY 0 NO_INPUT_QUANTITY 1.0 FORMAT "%%5.0"
 /begin AXIS_DESCR COM_AXIS NO_INPUT_QUANTITY NO_COMPU_METHOD 2 AXIS_PTS_REF AX_1A1528 /end AXIS_DESCR
 /begin AXIS_DESCR COM_AXIS NO_INPUT_QUANTITY NO_COMPU_METHOD 2 AXIS_PTS_REF AX_1A36C0 /end AXIS_DESCR
/end CHARACTERISTIC
/* src=families fam=I_fam_0114 ax=0x- ay=0x- */
/begin CHARACTERISTIC I_fam_0114_1C2968 "RE map_interp_I I_fam_0114 call=0x800F167E" VALUE 0x1C2968 RL_IDENTITY 0 NO_INPUT_QUANTITY 1.0 /end CHARACTERISTIC
/* src=families fam=L_fam_0007 ax=0x1A9AC8 ay=0x1BD9E4 */
/begin CHARACTERISTIC L_fam_0007_1C2A24 "RE map_interp_L L_fam_0007 call=0x8009AE3A; RE map_interp_O O_fam_0001 call=0x80" MAP 0x1C2A24 RL_IDENTITY 0 NO_INPUT_QUANTITY 1.0 FORMAT "%%5.0"
 /begin AXIS_DESCR COM_AXIS NO_INPUT_QUANTITY NO_COMPU_METHOD 2 AXIS_PTS_REF AX_1A9AC8 /end AXIS_DESCR
 /begin AXIS_DESCR COM_AXIS NO_INPUT_QUANTITY NO_COMPU_METHOD 2 AXIS_PTS_REF AX_1BD9E4 /end AXIS_DESCR
/end CHARACTERISTIC
/begin CHARACTERISTIC turbo_base3B_1C2A2C "atlas9979 turbo_base3B@1C2A2C / Turbo boost pressure request (IdName Caddy 9979 " MAP 0x1C2A2C RL_IDENTITY 0 NO_INPUT_QUANTITY 1.0 FORMAT "%%5.0"
 /begin AXIS_DESCR COM_AXIS NO_INPUT_QUANTITY NO_COMPU_METHOD 16 AXIS_PTS_REF AX_1A7B26 /end AXIS_DESCR
 /begin AXIS_DESCR COM_AXIS NO_INPUT_QUANTITY NO_COMPU_METHOD 20 AXIS_PTS_REF AX_1A5B6C /end AXIS_DESCR
/end CHARACTERISTIC
/begin CHARACTERISTIC turbo_base3B_1C2CAC "atlas9979 turbo_base3B@1C2CAC / Turbo boost pressure request (IdName Caddy 9979 " MAP 0x1C2CAC RL_IDENTITY 0 NO_INPUT_QUANTITY 1.0 FORMAT "%%5.0"
 /begin AXIS_DESCR COM_AXIS NO_INPUT_QUANTITY NO_COMPU_METHOD 16 AXIS_PTS_REF AX_1A7B26 /end AXIS_DESCR
 /begin AXIS_DESCR COM_AXIS NO_INPUT_QUANTITY NO_COMPU_METHOD 20 AXIS_PTS_REF AX_1A5B6C /end AXIS_DESCR
/end CHARACTERISTIC
/begin CHARACTERISTIC turbo_base3B_1C2F2C "atlas9979 turbo_base3B@1C2F2C / Turbo boost pressure request (IdName Caddy 9979 " MAP 0x1C2F2C RL_IDENTITY 0 NO_INPUT_QUANTITY 1.0 FORMAT "%%5.0"
 /begin AXIS_DESCR COM_AXIS NO_INPUT_QUANTITY NO_COMPU_METHOD 16 AXIS_PTS_REF AX_1A7B26 /end AXIS_DESCR
 /begin AXIS_DESCR COM_AXIS NO_INPUT_QUANTITY NO_COMPU_METHOD 20 AXIS_PTS_REF AX_1A5B6C /end AXIS_DESCR
/end CHARACTERISTIC
/begin CHARACTERISTIC turbo_base3B_1C31AC "atlas9979 turbo_base3B@1C31AC / Turbo boost pressure request (IdName Caddy 9979 " MAP 0x1C31AC RL_IDENTITY 0 NO_INPUT_QUANTITY 1.0 FORMAT "%%5.0"
 /begin AXIS_DESCR COM_AXIS NO_INPUT_QUANTITY NO_COMPU_METHOD 16 AXIS_PTS_REF AX_1A7B26 /end AXIS_DESCR
 /begin AXIS_DESCR COM_AXIS NO_INPUT_QUANTITY NO_COMPU_METHOD 20 AXIS_PTS_REF AX_1A5B6C /end AXIS_DESCR
/end CHARACTERISTIC
/begin CHARACTERISTIC turbo_base3B_1C342C "atlas9979 turbo_base3B@1C342C / Turbo boost pressure request (IdName Caddy 9979 " MAP 0x1C342C RL_IDENTITY 0 NO_INPUT_QUANTITY 1.0 FORMAT "%%5.0"
 /begin AXIS_DESCR COM_AXIS NO_INPUT_QUANTITY NO_COMPU_METHOD 16 AXIS_PTS_REF AX_1A7B26 /end AXIS_DESCR
 /begin AXIS_DESCR COM_AXIS NO_INPUT_QUANTITY NO_COMPU_METHOD 20 AXIS_PTS_REF AX_1A5B6C /end AXIS_DESCR
/end CHARACTERISTIC
/begin CHARACTERISTIC turbo_base3B_1C36AC "atlas9979 turbo_base3B@1C36AC / Turbo boost pressure request (IdName Caddy 9979 " MAP 0x1C36AC RL_IDENTITY 0 NO_INPUT_QUANTITY 1.0 FORMAT "%%5.0"
 /begin AXIS_DESCR COM_AXIS NO_INPUT_QUANTITY NO_COMPU_METHOD 16 AXIS_PTS_REF AX_1A7B26 /end AXIS_DESCR
 /begin AXIS_DESCR COM_AXIS NO_INPUT_QUANTITY NO_COMPU_METHOD 20 AXIS_PTS_REF AX_1A5B6C /end AXIS_DESCR
/end CHARACTERISTIC
/* src=families fam=C_fam_0307 ax=0x- ay=0x- */
/begin CHARACTERISTIC C_fam_0307_1C37AC "RE map_interp_C C_fam_0307 call=0x800CD140" VALUE 0x1C37AC RL_IDENTITY 0 NO_INPUT_QUANTITY 1.0 /end CHARACTERISTIC
/* src=families fam=E_fam_0047 ax=0x- ay=0x- */
/begin CHARACTERISTIC E_fam_0047_1C37BC "RE map_interp_E E_fam_0047 call=0x80096F00" VALUE 0x1C37BC RL_IDENTITY 0 NO_INPUT_QUANTITY 1.0 /end CHARACTERISTIC
/* src=families fam=B_fam_0004 ax=0x1A6710 ay=0x1AE940 */
/begin CHARACTERISTIC B_fam_0004_1C37F4 "RE interp_2d_B B_fam_0004 call=0x800BD03A" MAP 0x1C37F4 RL_IDENTITY 0 NO_INPUT_QUANTITY 1.0 FORMAT "%%5.0"
 /begin AXIS_DESCR COM_AXIS NO_INPUT_QUANTITY NO_COMPU_METHOD 10 AXIS_PTS_REF AX_1A6710 /end AXIS_DESCR
 /begin AXIS_DESCR COM_AXIS NO_INPUT_QUANTITY NO_COMPU_METHOD 2 AXIS_PTS_REF AX_1AE940 /end AXIS_DESCR
/end CHARACTERISTIC
/* src=families fam=F_fam_0012 ax=0x1AA898 ay=0x1A666C */
/begin CHARACTERISTIC F_fam_0012_1C3890 "RE map_interp_F F_fam_0012 call=0x800F065E" MAP 0x1C3890 RL_IDENTITY 0 NO_INPUT_QUANTITY 1.0 FORMAT "%%5.0"
 /begin AXIS_DESCR COM_AXIS NO_INPUT_QUANTITY NO_COMPU_METHOD 2 AXIS_PTS_REF AX_1AA898 /end AXIS_DESCR
 /begin AXIS_DESCR COM_AXIS NO_INPUT_QUANTITY NO_COMPU_METHOD 2 AXIS_PTS_REF AX_1A666C /end AXIS_DESCR
/end CHARACTERISTIC
/* src=families fam=C_fam_0037 ax=0x1BB9C0 ay=0x- */
/begin CHARACTERISTIC C_fam_0037_1C3938 "RE map_interp_C C_fam_0037 call=0x800AE142" VALUE 0x1C3938 RL_IDENTITY 0 NO_INPUT_QUANTITY 1.0 /end CHARACTERISTIC
/* src=families fam=D_fam_0091 ax=0x1AF890 ay=0x- */ /* STUB unknown size; axis_x=0x1AF890 axis_y=0x- */
/begin CHARACTERISTIC D_fam_0091_1C3954 "RE map_interp_D D_fam_0091 call=0x800E2B7A; RE map_interp_I I_fam_0111 call=0x80" VALUE 0x1C3954 RL_IDENTITY 0 NO_INPUT_QUANTITY 1.0 /end CHARACTERISTIC
/* src=families fam=C_fam_0009 ax=0x1A53D4 ay=0x- */ /* STUB unknown size; axis_x=0x1A53D4 axis_y=0x- */
/begin CHARACTERISTIC C_fam_0009_1C3A4C "RE map_interp_C C_fam_0009 call=0x800A2964" VALUE 0x1C3A4C RL_IDENTITY 0 NO_INPUT_QUANTITY 1.0 /end CHARACTERISTIC
/* src=families fam=C_fam_0009 ax=0x- ay=0x- */
/begin CHARACTERISTIC C_fam_0009_1C3A58 "RE map_interp_C C_fam_0009 call=0x800A2908" VALUE 0x1C3A58 RL_IDENTITY 0 NO_INPUT_QUANTITY 1.0 /end CHARACTERISTIC
/* src=families fam=C_fam_0033 ax=0x1AF82C ay=0x- */ /* STUB unknown size; axis_x=0x1AF82C axis_y=0x- */
/begin CHARACTERISTIC C_fam_0033_1C3A70 "RE map_interp_C C_fam_0033 call=0x8008E718" VALUE 0x1C3A70 RL_IDENTITY 0 NO_INPUT_QUANTITY 1.0 /end CHARACTERISTIC
/* src=families fam=C_fam_0009 ax=0x1A53D4 ay=0x- */ /* STUB unknown size; axis_x=0x1A53D4 axis_y=0x- */
/begin CHARACTERISTIC C_fam_0009_1C3A84 "RE map_interp_C C_fam_0009 call=0x800A2988" VALUE 0x1C3A84 RL_IDENTITY 0 NO_INPUT_QUANTITY 1.0 /end CHARACTERISTIC
/* src=families fam=C_fam_0033 ax=0x1AF82C ay=0x- */ /* STUB unknown size; axis_x=0x1AF82C axis_y=0x- */
/begin CHARACTERISTIC C_fam_0033_1C3A9C "RE map_interp_C C_fam_0033 call=0x8008E6FE" VALUE 0x1C3A9C RL_IDENTITY 0 NO_INPUT_QUANTITY 1.0 /end CHARACTERISTIC
/begin CHARACTERISTIC turbo_int_trq_correction2C "atlas9979 turbo_int_trq_correction2C / Turbo boost correction by internal torque" MAP 0x1C3AAC RL_IDENTITY 0 NO_INPUT_QUANTITY 1.0 FORMAT "%%5.0"
 /begin AXIS_DESCR COM_AXIS NO_INPUT_QUANTITY NO_COMPU_METHOD 12 AXIS_PTS_REF AX_1A7BD2 /end AXIS_DESCR
 /begin AXIS_DESCR COM_AXIS NO_INPUT_QUANTITY NO_COMPU_METHOD 16 AXIS_PTS_REF AX_1A5C6A /end AXIS_DESCR
/end CHARACTERISTIC
/* src=families fam=fam_0004 ax=0x1AE8AC ay=0x1B5978 */
/begin CHARACTERISTIC turbo_int_trq_correction2C_1C3A "HIGH 9980 ident = turbo_int_trq_correction2C; high: empreinte diverse = famille " MAP 0x1C3ABC RL_IDENTITY 0 NO_INPUT_QUANTITY 1.0 FORMAT "%%5.0"
 /begin AXIS_DESCR COM_AXIS NO_INPUT_QUANTITY NO_COMPU_METHOD 12 AXIS_PTS_REF AX_1AE8AC /end AXIS_DESCR
 /begin AXIS_DESCR COM_AXIS NO_INPUT_QUANTITY NO_COMPU_METHOD 16 AXIS_PTS_REF AX_1B5978 /end AXIS_DESCR
/end CHARACTERISTIC
/* src=families fam=B_fam_0037 ax=0x- ay=0x- */
/begin CHARACTERISTIC B_fam_0037_1C3AC4 "RE interp_2d_B B_fam_0037 call=0x800CF1D8" VALUE 0x1C3AC4 RL_IDENTITY 0 NO_INPUT_QUANTITY 1.0 /end CHARACTERISTIC
/* src=families fam=C_fam_0146 ax=0x1A6538 ay=0x- */ /* STUB unknown size; axis_x=0x1A6538 axis_y=0x- */
/begin CHARACTERISTIC C_fam_0146_1C3B50 "RE map_interp_C C_fam_0146 call=0x800AFAE4" VALUE 0x1C3B50 RL_IDENTITY 0 NO_INPUT_QUANTITY 1.0 /end CHARACTERISTIC
/* src=families fam=C_fam_0132 ax=0x1A0588 ay=0x- */ /* STUB unknown size; axis_x=0x1A0588 axis_y=0x- */
/begin CHARACTERISTIC C_fam_0132_1C3B5C "RE map_interp_C C_fam_0132 call=0x800EABDE" VALUE 0x1C3B5C RL_IDENTITY 0 NO_INPUT_QUANTITY 1.0 /end CHARACTERISTIC
/begin CHARACTERISTIC turbo_int_trq_correction2C_1C3D "atlas9979 turbo_int_trq_correction2C@1C3DAC / Turbo boost correction by internal" MAP 0x1C3DAC RL_IDENTITY 0 NO_INPUT_QUANTITY 1.0 FORMAT "%%5.0"
 /begin AXIS_DESCR COM_AXIS NO_INPUT_QUANTITY NO_COMPU_METHOD 12 AXIS_PTS_REF AX_1A7BD2 /end AXIS_DESCR
 /begin AXIS_DESCR COM_AXIS NO_INPUT_QUANTITY NO_COMPU_METHOD 16 AXIS_PTS_REF AX_1A5C6A /end AXIS_DESCR
/end CHARACTERISTIC
/begin CHARACTERISTIC turbo_int_trq_correction2C_1C40 "atlas9979 turbo_int_trq_correction2C@1C40AC / Turbo boost correction by internal" MAP 0x1C40AC RL_IDENTITY 0 NO_INPUT_QUANTITY 1.0 FORMAT "%%5.0"
 /begin AXIS_DESCR COM_AXIS NO_INPUT_QUANTITY NO_COMPU_METHOD 12 AXIS_PTS_REF AX_1A7BD2 /end AXIS_DESCR
 /begin AXIS_DESCR COM_AXIS NO_INPUT_QUANTITY NO_COMPU_METHOD 16 AXIS_PTS_REF AX_1A5C6A /end AXIS_DESCR
/end CHARACTERISTIC
/* src=atlas9979 fam=F_fam_0192 ax=0x1A7BD2 ay=0x1A5C6A */
/begin CHARACTERISTIC turbo_int_trq_correction2C_1C43 "atlas9979 turbo_int_trq_correction2C@1C43AC / Turbo boost correction by internal" MAP 0x1C43AC RL_IDENTITY 0 NO_INPUT_QUANTITY 1.0 FORMAT "%%5.0"
 /begin AXIS_DESCR COM_AXIS NO_INPUT_QUANTITY NO_COMPU_METHOD 12 AXIS_PTS_REF AX_1A7BD2 /end AXIS_DESCR
 /begin AXIS_DESCR COM_AXIS NO_INPUT_QUANTITY NO_COMPU_METHOD 16 AXIS_PTS_REF AX_1A5C6A /end AXIS_DESCR
/end CHARACTERISTIC
/* src=atlas9979 fam=fam_0070 ax=0x1A7BD2 ay=0x1A5C6A */
/begin CHARACTERISTIC turbo_int_trq_correction2C_1C46 "atlas9979 turbo_int_trq_correction2C@1C46AC / Turbo boost correction by internal" MAP 0x1C46AC RL_IDENTITY 0 NO_INPUT_QUANTITY 1.0 FORMAT "%%5.0"
 /begin AXIS_DESCR COM_AXIS NO_INPUT_QUANTITY NO_COMPU_METHOD 12 AXIS_PTS_REF AX_1A7BD2 /end AXIS_DESCR
 /begin AXIS_DESCR COM_AXIS NO_INPUT_QUANTITY NO_COMPU_METHOD 16 AXIS_PTS_REF AX_1A5C6A /end AXIS_DESCR
/end CHARACTERISTIC
/* src=families fam=F_fam_0012 ax=0x1AA898 ay=0x1A666C */
/begin CHARACTERISTIC F_fam_0012_1C4898 "RE map_interp_F F_fam_0012 call=0x800F067C; RE map_interp_G G_fam_0033 call=0x80" MAP 0x1C4898 RL_IDENTITY 0 NO_INPUT_QUANTITY 1.0 FORMAT "%%5.0"
 /begin AXIS_DESCR COM_AXIS NO_INPUT_QUANTITY NO_COMPU_METHOD 2 AXIS_PTS_REF AX_1AA898 /end AXIS_DESCR
 /begin AXIS_DESCR COM_AXIS NO_INPUT_QUANTITY NO_COMPU_METHOD 2 AXIS_PTS_REF AX_1A666C /end AXIS_DESCR
/end CHARACTERISTIC
/* src=families fam=E_fam_0023 ax=0x1AA9FC ay=0x1B1874 */
/begin CHARACTERISTIC E_fam_0023_1C48F0 "RE map_interp_E E_fam_0023 call=0x80080D2A" MAP 0x1C48F0 RL_IDENTITY 0 NO_INPUT_QUANTITY 1.0 FORMAT "%%5.0"
 /begin AXIS_DESCR COM_AXIS NO_INPUT_QUANTITY NO_COMPU_METHOD 2 AXIS_PTS_REF AX_1AA9FC /end AXIS_DESCR
 /begin AXIS_DESCR COM_AXIS NO_INPUT_QUANTITY NO_COMPU_METHOD 2 AXIS_PTS_REF AX_1B1874 /end AXIS_DESCR
/end CHARACTERISTIC
/* src=families fam=N_fam_0003 ax=0x1A3470 ay=0x1A7648 */
/begin CHARACTERISTIC N_fam_0003_1C4918 "RE map_interp_N N_fam_0003 call=0x800ED996" MAP 0x1C4918 RL_IDENTITY 0 NO_INPUT_QUANTITY 1.0 FORMAT "%%5.0"
 /begin AXIS_DESCR COM_AXIS NO_INPUT_QUANTITY NO_COMPU_METHOD 2 AXIS_PTS_REF AX_1A3470 /end AXIS_DESCR
 /begin AXIS_DESCR COM_AXIS NO_INPUT_QUANTITY NO_COMPU_METHOD 2 AXIS_PTS_REF AX_1A7648 /end AXIS_DESCR
/end CHARACTERISTIC
/* src=families fam=C_fam_0196 ax=0x1A06F8 ay=0x- */ /* STUB unknown size; axis_x=0x1A06F8 axis_y=0x- */
/begin CHARACTERISTIC C_fam_0196_1C4940 "RE map_interp_C C_fam_0196 call=0x801125BC" VALUE 0x1C4940 RL_IDENTITY 0 NO_INPUT_QUANTITY 1.0 /end CHARACTERISTIC
/* src=families fam=C_fam_0342 ax=0x- ay=0x- */
/begin CHARACTERISTIC C_fam_0342_1C4958 "RE map_interp_C C_fam_0342 call=0x801135FE" VALUE 0x1C4958 RL_IDENTITY 0 NO_INPUT_QUANTITY 1.0 /end CHARACTERISTIC
/* src=families fam=C_fam_0073 ax=0x1A36C0 ay=0x1BB9F8 */
/begin CHARACTERISTIC C_fam_0073_1C4968 "RE map_interp_C C_fam_0073 call=0x80112610" MAP 0x1C4968 RL_IDENTITY 0 NO_INPUT_QUANTITY 1.0 FORMAT "%%5.0"
 /begin AXIS_DESCR COM_AXIS NO_INPUT_QUANTITY NO_COMPU_METHOD 2 AXIS_PTS_REF AX_1A36C0 /end AXIS_DESCR
 /begin AXIS_DESCR COM_AXIS NO_INPUT_QUANTITY NO_COMPU_METHOD 2 AXIS_PTS_REF AX_1BB9F8 /end AXIS_DESCR
/end CHARACTERISTIC
/* src=families fam=E_fam_0090 ax=0x1B4284 ay=0x- */ /* STUB unknown size; axis_x=0x1B4284 axis_y=0x- */
/begin CHARACTERISTIC E_fam_0090_1C4988 "RE map_interp_E E_fam_0090 call=0x800806E0" VALUE 0x1C4988 RL_IDENTITY 0 NO_INPUT_QUANTITY 1.0 /end CHARACTERISTIC
/* src=families fam=fam_0027 ax=0x1A0728 ay=0x1A0660 */
/begin CHARACTERISTIC map_horsA2L_1C4994 "RE interp_2d fam_0027 call=0x8007D730" MAP 0x1C4994 RL_IDENTITY 0 NO_INPUT_QUANTITY 1.0 FORMAT "%%5.0"
 /begin AXIS_DESCR COM_AXIS NO_INPUT_QUANTITY NO_COMPU_METHOD 2 AXIS_PTS_REF AX_1A0728 /end AXIS_DESCR
 /begin AXIS_DESCR COM_AXIS NO_INPUT_QUANTITY NO_COMPU_METHOD 2 AXIS_PTS_REF AX_1A0660 /end AXIS_DESCR
/end CHARACTERISTIC
/* src=families fam=F_fam_0044 ax=0x1A24C8 ay=0x1A1588 */
/begin CHARACTERISTIC F_fam_0044_1C4B58 "RE map_interp_F F_fam_0044 call=0x800BB608" MAP 0x1C4B58 RL_IDENTITY 0 NO_INPUT_QUANTITY 1.0 FORMAT "%%5.0"
 /begin AXIS_DESCR COM_AXIS NO_INPUT_QUANTITY NO_COMPU_METHOD 2 AXIS_PTS_REF AX_1A24C8 /end AXIS_DESCR
 /begin AXIS_DESCR COM_AXIS NO_INPUT_QUANTITY NO_COMPU_METHOD 12 AXIS_PTS_REF AX_1A1588 /end AXIS_DESCR
/end CHARACTERISTIC
/* src=families fam=fam_0092 ax=0x1A15AC ay=0x19B74C */
/begin CHARACTERISTIC map_horsA2L_1C4BD8 "RE interp_2d fam_0092 call=0x800E986C" MAP 0x1C4BD8 RL_IDENTITY 0 NO_INPUT_QUANTITY 1.0 FORMAT "%%5.0"
 /begin AXIS_DESCR COM_AXIS NO_INPUT_QUANTITY NO_COMPU_METHOD 2 AXIS_PTS_REF AX_1A15AC /end AXIS_DESCR
 /begin AXIS_DESCR COM_AXIS NO_INPUT_QUANTITY NO_COMPU_METHOD 2 AXIS_PTS_REF AX_19B74C /end AXIS_DESCR
/end CHARACTERISTIC
/* src=families fam=D_fam_0106 ax=0x1BF944 ay=0x- */ /* STUB unknown size; axis_x=0x1BF944 axis_y=0x- */
/begin CHARACTERISTIC D_fam_0106_1C4DD8 "RE map_interp_D D_fam_0106 call=0x800E92F2; RE map_interp_F F_fam_0020 call=0x80" VALUE 0x1C4DD8 RL_IDENTITY 0 NO_INPUT_QUANTITY 1.0 /end CHARACTERISTIC
/* src=families fam=F_fam_0179 ax=0x- ay=0x- */
/begin CHARACTERISTIC F_fam_0179_1C4F18 "RE map_interp_F F_fam_0179 call=0x800E9336" VALUE 0x1C4F18 RL_IDENTITY 0 NO_INPUT_QUANTITY 1.0 /end CHARACTERISTIC
/* src=families fam=fam_0114 ax=0x1BF6B4 ay=0x19875C */
/begin CHARACTERISTIC map_horsA2L_1C56DC "RE interp_2d fam_0114 call=0x801126A0" MAP 0x1C56DC RL_IDENTITY 0 NO_INPUT_QUANTITY 1.0 FORMAT "%%5.0"
 /begin AXIS_DESCR COM_AXIS NO_INPUT_QUANTITY NO_COMPU_METHOD 2 AXIS_PTS_REF AX_1BF6B4 /end AXIS_DESCR
 /begin AXIS_DESCR COM_AXIS NO_INPUT_QUANTITY NO_COMPU_METHOD 2 AXIS_PTS_REF AX_19875C /end AXIS_DESCR
/end CHARACTERISTIC
/* src=families fam=J_fam_0010 ax=0x1A068C ay=0x1A0698 */
/begin CHARACTERISTIC J_fam_0010_1C5794 "RE map_interp_J J_fam_0010 call=0x800BCB56; RE map_interp_O O_fam_0008 call=0x80" MAP 0x1C5794 RL_IDENTITY 0 NO_INPUT_QUANTITY 1.0 FORMAT "%%5.0"
 /begin AXIS_DESCR COM_AXIS NO_INPUT_QUANTITY NO_COMPU_METHOD 2 AXIS_PTS_REF AX_1A068C /end AXIS_DESCR
 /begin AXIS_DESCR COM_AXIS NO_INPUT_QUANTITY NO_COMPU_METHOD 2 AXIS_PTS_REF AX_1A0698 /end AXIS_DESCR
/end CHARACTERISTIC
/* src=families fam=B_fam_0005 ax=0x1A6724 ay=0x1AE940 */
/begin CHARACTERISTIC B_fam_0005_1C57F4 "RE interp_2d_B B_fam_0005 call=0x800BD0F4" MAP 0x1C57F4 RL_IDENTITY 0 NO_INPUT_QUANTITY 1.0 FORMAT "%%5.0"
 /begin AXIS_DESCR COM_AXIS NO_INPUT_QUANTITY NO_COMPU_METHOD 2 AXIS_PTS_REF AX_1A6724 /end AXIS_DESCR
 /begin AXIS_DESCR COM_AXIS NO_INPUT_QUANTITY NO_COMPU_METHOD 2 AXIS_PTS_REF AX_1AE940 /end AXIS_DESCR
/end CHARACTERISTIC
/* src=families fam=F_fam_0076 ax=0x1A56E0 ay=0x- */ /* STUB unknown size; axis_x=0x1A56E0 axis_y=0x- */
/begin CHARACTERISTIC F_fam_0076_1C58A0 "RE map_interp_F F_fam_0076 call=0x800F06A0" VALUE 0x1C58A0 RL_IDENTITY 0 NO_INPUT_QUANTITY 1.0 /end CHARACTERISTIC
/begin CHARACTERISTIC turbo_int_trq_correction2C_1C58 "atlas9979 turbo_int_trq_correction2C@1C58AC / Turbo boost correction by internal" MAP 0x1C58AC RL_IDENTITY 0 NO_INPUT_QUANTITY 1.0 FORMAT "%%5.0"
 /begin AXIS_DESCR COM_AXIS NO_INPUT_QUANTITY NO_COMPU_METHOD 12 AXIS_PTS_REF AX_1A7BD2 /end AXIS_DESCR
 /begin AXIS_DESCR COM_AXIS NO_INPUT_QUANTITY NO_COMPU_METHOD 16 AXIS_PTS_REF AX_1A5C6A /end AXIS_DESCR
/end CHARACTERISTIC
/* src=families fam=E_fam_0067 ax=0x- ay=0x- */
/begin CHARACTERISTIC E_fam_0067_1C58C0 "RE map_interp_E E_fam_0067 call=0x80080CEC" VALUE 0x1C58C0 RL_IDENTITY 0 NO_INPUT_QUANTITY 1.0 /end CHARACTERISTIC
/* src=families fam=C_fam_0068 ax=0x1A3528 ay=0x1A168C */
/begin CHARACTERISTIC C_fam_0068_1C58D0 "RE map_interp_C C_fam_0068 call=0x800BDEB8; RE map_interp_D D_fam_0029 call=0x80" MAP 0x1C58D0 RL_IDENTITY 0 NO_INPUT_QUANTITY 1.0 FORMAT "%%5.0"
 /begin AXIS_DESCR COM_AXIS NO_INPUT_QUANTITY NO_COMPU_METHOD 46 AXIS_PTS_REF AX_1A3528 /end AXIS_DESCR
 /begin AXIS_DESCR COM_AXIS NO_INPUT_QUANTITY NO_COMPU_METHOD 26 AXIS_PTS_REF AX_1A168C /end AXIS_DESCR
/end CHARACTERISTIC
/* src=families fam=B_fam_0012 ax=0x1A0648 ay=0x1BC9F8 */
/begin CHARACTERISTIC B_fam_0012_1C58E0 "RE interp_2d_B B_fam_0012 call=0x8007B2B4" MAP 0x1C58E0 RL_IDENTITY 0 NO_INPUT_QUANTITY 1.0 FORMAT "%%5.0"
 /begin AXIS_DESCR COM_AXIS NO_INPUT_QUANTITY NO_COMPU_METHOD 2 AXIS_PTS_REF AX_1A0648 /end AXIS_DESCR
 /begin AXIS_DESCR COM_AXIS NO_INPUT_QUANTITY NO_COMPU_METHOD 2 AXIS_PTS_REF AX_1BC9F8 /end AXIS_DESCR
/end CHARACTERISTIC
/* src=families fam=fam_0165 ax=0x199650 ay=0x19C450 */
/begin CHARACTERISTIC map_horsA2L_1C5940 "RE interp_2d fam_0165 call=0x800F03C4" MAP 0x1C5940 RL_IDENTITY 0 NO_INPUT_QUANTITY 1.0 FORMAT "%%5.0"
 /begin AXIS_DESCR COM_AXIS NO_INPUT_QUANTITY NO_COMPU_METHOD 2 AXIS_PTS_REF AX_199650 /end AXIS_DESCR
 /begin AXIS_DESCR COM_AXIS NO_INPUT_QUANTITY NO_COMPU_METHOD 2 AXIS_PTS_REF AX_19C450 /end AXIS_DESCR
/end CHARACTERISTIC
/* src=families fam=O_fam_0002 ax=0x1AAAE8 ay=0x1A9AE8 */
/begin CHARACTERISTIC O_fam_0002_1C5A04 "RE map_interp_O O_fam_0002 call=0x8009B05C" MAP 0x1C5A04 RL_IDENTITY 0 NO_INPUT_QUANTITY 1.0 FORMAT "%%5.0"
 /begin AXIS_DESCR COM_AXIS NO_INPUT_QUANTITY NO_COMPU_METHOD 2 AXIS_PTS_REF AX_1AAAE8 /end AXIS_DESCR
 /begin AXIS_DESCR COM_AXIS NO_INPUT_QUANTITY NO_COMPU_METHOD 2 AXIS_PTS_REF AX_1A9AE8 /end AXIS_DESCR
/end CHARACTERISTIC
/* src=families fam=fam_0017 ax=0x1B491C ay=0x1B1960 */
/begin CHARACTERISTIC fam_0017_1C5A58 "RE interp_2d fam_0017 call=0x800E3DB0" MAP 0x1C5A58 RL_IDENTITY 0 NO_INPUT_QUANTITY 1.0 FORMAT "%%5.0"
 /begin AXIS_DESCR COM_AXIS NO_INPUT_QUANTITY NO_COMPU_METHOD 2 AXIS_PTS_REF AX_1B491C /end AXIS_DESCR
 /begin AXIS_DESCR COM_AXIS NO_INPUT_QUANTITY NO_COMPU_METHOD 2 AXIS_PTS_REF AX_1B1960 /end AXIS_DESCR
/end CHARACTERISTIC
/* src=families fam=fam_0017 ax=0x1B491C ay=0x1B1960 */
/begin CHARACTERISTIC map_horsA2L_1C5A84 "RE interp_2d fam_0017 call=0x800E3D5A" MAP 0x1C5A84 RL_IDENTITY 0 NO_INPUT_QUANTITY 1.0 FORMAT "%%5.0"
 /begin AXIS_DESCR COM_AXIS NO_INPUT_QUANTITY NO_COMPU_METHOD 2 AXIS_PTS_REF AX_1B491C /end AXIS_DESCR
 /begin AXIS_DESCR COM_AXIS NO_INPUT_QUANTITY NO_COMPU_METHOD 2 AXIS_PTS_REF AX_1B1960 /end AXIS_DESCR
/end CHARACTERISTIC
/* src=families fam=fam_0173 ax=0x19E558 ay=0x198778 */
/begin CHARACTERISTIC map_horsA2L_1C5AC4 "RE interp_2d fam_0173 call=0x800F5E84" MAP 0x1C5AC4 RL_IDENTITY 0 NO_INPUT_QUANTITY 1.0 FORMAT "%%5.0"
 /begin AXIS_DESCR COM_AXIS NO_INPUT_QUANTITY NO_COMPU_METHOD 2 AXIS_PTS_REF AX_19E558 /end AXIS_DESCR
 /begin AXIS_DESCR COM_AXIS NO_INPUT_QUANTITY NO_COMPU_METHOD 2 AXIS_PTS_REF AX_198778 /end AXIS_DESCR
/end CHARACTERISTIC
/begin CHARACTERISTIC turbo_int_trq_correction2C_1C5B "atlas9979 turbo_int_trq_correction2C@1C5BAC / Turbo boost correction by internal" MAP 0x1C5BAC RL_IDENTITY 0 NO_INPUT_QUANTITY 1.0 FORMAT "%%5.0"
 /begin AXIS_DESCR COM_AXIS NO_INPUT_QUANTITY NO_COMPU_METHOD 12 AXIS_PTS_REF AX_1A7BD2 /end AXIS_DESCR
 /begin AXIS_DESCR COM_AXIS NO_INPUT_QUANTITY NO_COMPU_METHOD 16 AXIS_PTS_REF AX_1A5C6A /end AXIS_DESCR
/end CHARACTERISTIC
/begin CHARACTERISTIC turbo_int_trq_correction2C_1C5E "atlas9979 turbo_int_trq_correction2C@1C5EAC / Turbo boost correction by internal" MAP 0x1C5EAC RL_IDENTITY 0 NO_INPUT_QUANTITY 1.0 FORMAT "%%5.0"
 /begin AXIS_DESCR COM_AXIS NO_INPUT_QUANTITY NO_COMPU_METHOD 12 AXIS_PTS_REF AX_1A7BD2 /end AXIS_DESCR
 /begin AXIS_DESCR COM_AXIS NO_INPUT_QUANTITY NO_COMPU_METHOD 16 AXIS_PTS_REF AX_1A5C6A /end AXIS_DESCR
/end CHARACTERISTIC
/begin CHARACTERISTIC turbo_int_trq_correction2C_1C67 "atlas9979 turbo_int_trq_correction2C@1C67AC / Turbo boost correction by internal" MAP 0x1C67AC RL_IDENTITY 0 NO_INPUT_QUANTITY 1.0 FORMAT "%%5.0"
 /begin AXIS_DESCR COM_AXIS NO_INPUT_QUANTITY NO_COMPU_METHOD 12 AXIS_PTS_REF AX_1A7BD2 /end AXIS_DESCR
 /begin AXIS_DESCR COM_AXIS NO_INPUT_QUANTITY NO_COMPU_METHOD 16 AXIS_PTS_REF AX_1A5C6A /end AXIS_DESCR
/end CHARACTERISTIC
/* src=families fam=C_fam_0258 ax=0x1B7820 ay=0x- */ /* STUB unknown size; axis_x=0x1B7820 axis_y=0x- */
/begin CHARACTERISTIC C_fam_0258_1C68D4 "RE map_interp_C C_fam_0258 call=0x800CC43E" VALUE 0x1C68D4 RL_IDENTITY 0 NO_INPUT_QUANTITY 1.0 /end CHARACTERISTIC
/* src=families fam=C_fam_0141 ax=0x1A5460 ay=0x- */ /* STUB unknown size; axis_x=0x1A5460 axis_y=0x- */
/begin CHARACTERISTIC C_fam_0141_1C68EC "RE map_interp_C C_fam_0141 call=0x8008DC5E" VALUE 0x1C68EC RL_IDENTITY 0 NO_INPUT_QUANTITY 1.0 /end CHARACTERISTIC
/* src=families fam=C_fam_0142 ax=0x1A5474 ay=0x- */ /* STUB unknown size; axis_x=0x1A5474 axis_y=0x- */
/begin CHARACTERISTIC C_fam_0142_1C68FC "RE map_interp_C C_fam_0142 call=0x8008D1A2" VALUE 0x1C68FC RL_IDENTITY 0 NO_INPUT_QUANTITY 1.0 /end CHARACTERISTIC
/* src=atlas9979 fam=- ax=0x1A8302 ay=0x1A5360 */
/begin CHARACTERISTIC turbo_atm6A "atlas9979 turbo_atm6A / Turbo boost pressure limiter by ATM (IdName Caddy 9979 -" MAP 0x1C692C RL_IDENTITY 0 NO_INPUT_QUANTITY 1.0 FORMAT "%%5.0"
 /begin AXIS_DESCR COM_AXIS NO_INPUT_QUANTITY NO_COMPU_METHOD 8 AXIS_PTS_REF AX_1A8302 /end AXIS_DESCR
 /begin AXIS_DESCR COM_AXIS NO_INPUT_QUANTITY NO_COMPU_METHOD 16 AXIS_PTS_REF AX_1A5360 /end AXIS_DESCR
/end CHARACTERISTIC
/* src=atlas9979 fam=- ax=0x1A8302 ay=0x1A5360 */
/begin CHARACTERISTIC turbo_atm6A_1C6A2C "atlas9979 turbo_atm6A@1C6A2C / Turbo boost pressure limiter by ATM (IdName Caddy" MAP 0x1C6A2C RL_IDENTITY 0 NO_INPUT_QUANTITY 1.0 FORMAT "%%5.0"
 /begin AXIS_DESCR COM_AXIS NO_INPUT_QUANTITY NO_COMPU_METHOD 8 AXIS_PTS_REF AX_1A8302 /end AXIS_DESCR
 /begin AXIS_DESCR COM_AXIS NO_INPUT_QUANTITY NO_COMPU_METHOD 16 AXIS_PTS_REF AX_1A5360 /end AXIS_DESCR
/end CHARACTERISTIC
/* src=families fam=F_fam_0176 ax=0x- ay=0x- */
/begin CHARACTERISTIC F_fam_0176_1C6BD8 "RE map_interp_F F_fam_0176 call=0x800E90EC" VALUE 0x1C6BD8 RL_IDENTITY 0 NO_INPUT_QUANTITY 1.0 /end CHARACTERISTIC
/* src=families fam=E_fam_0063 ax=0x1A8910 ay=0x- */ /* STUB unknown size; axis_x=0x1A8910 axis_y=0x- */
/begin CHARACTERISTIC E_fam_0063_1C7798 "RE map_interp_E E_fam_0063 call=0x800CF11E" VALUE 0x1C7798 RL_IDENTITY 0 NO_INPUT_QUANTITY 1.0 /end CHARACTERISTIC
/* src=families fam=E_fam_0019 ax=0x1A8910 ay=0x1BC7B0 */
/begin CHARACTERISTIC E_fam_0019_1C77A8 "RE map_interp_E E_fam_0019 call=0x800CF0F8" MAP 0x1C77A8 RL_IDENTITY 0 NO_INPUT_QUANTITY 1.0 FORMAT "%%5.0"
 /begin AXIS_DESCR COM_AXIS NO_INPUT_QUANTITY NO_COMPU_METHOD 2 AXIS_PTS_REF AX_1A8910 /end AXIS_DESCR
 /begin AXIS_DESCR COM_AXIS NO_INPUT_QUANTITY NO_COMPU_METHOD 2 AXIS_PTS_REF AX_1BC7B0 /end AXIS_DESCR
/end CHARACTERISTIC
/* src=families fam=E_fam_0033 ax=0x1A7630 ay=0x- */ /* STUB unknown size; axis_x=0x1A7630 axis_y=0x- */
/begin CHARACTERISTIC E_fam_0033_1C77B8 "RE map_interp_E E_fam_0033 call=0x800956B2" VALUE 0x1C77B8 RL_IDENTITY 0 NO_INPUT_QUANTITY 1.0 /end CHARACTERISTIC
/* src=families fam=M_fam_0006 ax=0x1B2874 ay=0x1AC814 */
/begin CHARACTERISTIC M_fam_0006_1C77F4 "RE map_interp_M M_fam_0006 call=0x800D2728" MAP 0x1C77F4 RL_IDENTITY 0 NO_INPUT_QUANTITY 1.0 FORMAT "%%5.0"
 /begin AXIS_DESCR COM_AXIS NO_INPUT_QUANTITY NO_COMPU_METHOD 2 AXIS_PTS_REF AX_1B2874 /end AXIS_DESCR
 /begin AXIS_DESCR COM_AXIS NO_INPUT_QUANTITY NO_COMPU_METHOD 2 AXIS_PTS_REF AX_1AC814 /end AXIS_DESCR
/end CHARACTERISTIC
/* src=families fam=fam_0099 ax=0x1B9A34 ay=0x- */ /* STUB unknown size; axis_x=0x1B9A34 axis_y=0x- */
/begin CHARACTERISTIC fam_0099_1C78CC "RE interp_2d fam_0099 call=0x800E40D2; RE map_interp_C C_fam_0204 call=0x800E40A" VALUE 0x1C78CC RL_IDENTITY 0 NO_INPUT_QUANTITY 1.0 /end CHARACTERISTIC
/* src=families fam=C_fam_0205 ax=0x- ay=0x- */
/begin CHARACTERISTIC C_fam_0205_1C78DC "RE map_interp_C C_fam_0205 call=0x800E3E82" VALUE 0x1C78DC RL_IDENTITY 0 NO_INPUT_QUANTITY 1.0 /end CHARACTERISTIC
/* src=families fam=C_fam_0181 ax=0x- ay=0x- */
/begin CHARACTERISTIC C_fam_0181_1C78EC "RE map_interp_C C_fam_0181 call=0x8009AFF4" VALUE 0x1C78EC RL_IDENTITY 0 NO_INPUT_QUANTITY 1.0 /end CHARACTERISTIC
/* src=families fam=C_fam_0126 ax=0x1B8A60 ay=0x1B584C */
/begin CHARACTERISTIC C_fam_0126_1C78FC "RE map_interp_C C_fam_0126 call=0x800E3E52" MAP 0x1C78FC RL_IDENTITY 0 NO_INPUT_QUANTITY 1.0 FORMAT "%%5.0"
 /begin AXIS_DESCR COM_AXIS NO_INPUT_QUANTITY NO_COMPU_METHOD 2 AXIS_PTS_REF AX_1B8A60 /end AXIS_DESCR
 /begin AXIS_DESCR COM_AXIS NO_INPUT_QUANTITY NO_COMPU_METHOD 2 AXIS_PTS_REF AX_1B584C /end AXIS_DESCR
/end CHARACTERISTIC
/* src=families fam=B_fam_0062 ax=0x- ay=0x- */
/begin CHARACTERISTIC B_fam_0062_1C7920 "RE interp_2d_B B_fam_0062 call=0x800FA92E" VALUE 0x1C7920 RL_IDENTITY 0 NO_INPUT_QUANTITY 1.0 /end CHARACTERISTIC
/* src=families fam=C_fam_0015 ax=0x1AB808 ay=0x1A993C */
/begin CHARACTERISTIC C_fam_0015_1C7968 "RE map_interp_C C_fam_0015 call=0x800E4562; RE map_interp_E E_fam_0008 call=0x80" MAP 0x1C7968 RL_IDENTITY 0 NO_INPUT_QUANTITY 1.0 FORMAT "%%5.0"
 /begin AXIS_DESCR COM_AXIS NO_INPUT_QUANTITY NO_COMPU_METHOD 2 AXIS_PTS_REF AX_1AB808 /end AXIS_DESCR
 /begin AXIS_DESCR COM_AXIS NO_INPUT_QUANTITY NO_COMPU_METHOD 5 AXIS_PTS_REF AX_1A993C /end AXIS_DESCR
/end CHARACTERISTIC
/* src=families fam=C_fam_0017 ax=0x1AB81C ay=0x1AA908 */
/begin CHARACTERISTIC C_fam_0017_1C7978 "RE map_interp_C C_fam_0017 call=0x800E4470; RE map_interp_E E_fam_0005 call=0x80" MAP 0x1C7978 RL_IDENTITY 0 NO_INPUT_QUANTITY 1.0 FORMAT "%%5.0"
 /begin AXIS_DESCR COM_AXIS NO_INPUT_QUANTITY NO_COMPU_METHOD 2 AXIS_PTS_REF AX_1AB81C /end AXIS_DESCR
 /begin AXIS_DESCR COM_AXIS NO_INPUT_QUANTITY NO_COMPU_METHOD 2 AXIS_PTS_REF AX_1AA908 /end AXIS_DESCR
/end CHARACTERISTIC
/* src=families fam=E_fam_0053 ax=0x1A371C ay=0x- */ /* STUB unknown size; axis_x=0x1A371C axis_y=0x- */
/begin CHARACTERISTIC E_fam_0053_1C798C "RE map_interp_E E_fam_0053 call=0x800F1B90" VALUE 0x1C798C RL_IDENTITY 0 NO_INPUT_QUANTITY 1.0 /end CHARACTERISTIC
/* src=families fam=E_fam_0028 ax=0x1B6938 ay=0x1AD8DC */
/begin CHARACTERISTIC E_fam_0028_1C799C "RE map_interp_E E_fam_0028 call=0x800D6760" MAP 0x1C799C RL_IDENTITY 0 NO_INPUT_QUANTITY 1.0 FORMAT "%%5.0"
 /begin AXIS_DESCR COM_AXIS NO_INPUT_QUANTITY NO_COMPU_METHOD 2 AXIS_PTS_REF AX_1B6938 /end AXIS_DESCR
 /begin AXIS_DESCR COM_AXIS NO_INPUT_QUANTITY NO_COMPU_METHOD 2 AXIS_PTS_REF AX_1AD8DC /end AXIS_DESCR
/end CHARACTERISTIC
/* src=families fam=C_fam_0037 ax=0x1BB9C0 ay=0x- */
/begin CHARACTERISTIC C_fam_0037_1C79A8 "RE map_interp_C C_fam_0037 call=0x800AE126; RE map_interp_I I_fam_0093 call=0x80" VALUE 0x1C79A8 RL_IDENTITY 0 NO_INPUT_QUANTITY 1.0 /end CHARACTERISTIC
/* src=families fam=fam_0048 ax=0x1A564C ay=0x1B9998 */
/begin CHARACTERISTIC map_horsA2L_1C79B8 "RE interp_2d fam_0048 call=0x800AE078; RE map_interp_C C_fam_0144 call=0x800AE09" MAP 0x1C79B8 RL_IDENTITY 0 NO_INPUT_QUANTITY 1.0 FORMAT "%%5.0"
 /begin AXIS_DESCR COM_AXIS NO_INPUT_QUANTITY NO_COMPU_METHOD 2 AXIS_PTS_REF AX_1A564C /end AXIS_DESCR
 /begin AXIS_DESCR COM_AXIS NO_INPUT_QUANTITY NO_COMPU_METHOD 2 AXIS_PTS_REF AX_1B9998 /end AXIS_DESCR
/end CHARACTERISTIC
/* src=families fam=E_fam_0017 ax=0x1A88EC ay=0x1A74E4 */
/begin CHARACTERISTIC E_fam_0017_1C79E8 "RE map_interp_E E_fam_0017 call=0x8008799C" MAP 0x1C79E8 RL_IDENTITY 0 NO_INPUT_QUANTITY 1.0 FORMAT "%%5.0"
 /begin AXIS_DESCR COM_AXIS NO_INPUT_QUANTITY NO_COMPU_METHOD 2 AXIS_PTS_REF AX_1A88EC /end AXIS_DESCR
 /begin AXIS_DESCR COM_AXIS NO_INPUT_QUANTITY NO_COMPU_METHOD 2 AXIS_PTS_REF AX_1A74E4 /end AXIS_DESCR
/end CHARACTERISTIC
/* src=families fam=E_fam_0013 ax=0x1A66E0 ay=0x1A74F4 */
/begin CHARACTERISTIC E_fam_0013_1C79F8 "RE map_interp_E E_fam_0013 call=0x80087A06" MAP 0x1C79F8 RL_IDENTITY 0 NO_INPUT_QUANTITY 1.0 FORMAT "%%5.0"
 /begin AXIS_DESCR COM_AXIS NO_INPUT_QUANTITY NO_COMPU_METHOD 51 AXIS_PTS_REF AX_1A66E0 /end AXIS_DESCR
 /begin AXIS_DESCR COM_AXIS NO_INPUT_QUANTITY NO_COMPU_METHOD 2 AXIS_PTS_REF AX_1A74F4 /end AXIS_DESCR
/end CHARACTERISTIC
/* src=families fam=C_fam_0013 ax=0x1A73DC ay=0x1AB87C */
/begin CHARACTERISTIC C_fam_0013_1C7A24 "RE map_interp_C C_fam_0013 call=0x800FC09A" MAP 0x1C7A24 RL_IDENTITY 0 NO_INPUT_QUANTITY 1.0 FORMAT "%%5.0"
 /begin AXIS_DESCR COM_AXIS NO_INPUT_QUANTITY NO_COMPU_METHOD 2 AXIS_PTS_REF AX_1A73DC /end AXIS_DESCR
 /begin AXIS_DESCR COM_AXIS NO_INPUT_QUANTITY NO_COMPU_METHOD 2 AXIS_PTS_REF AX_1AB87C /end AXIS_DESCR
/end CHARACTERISTIC
/* src=families fam=C_fam_0022 ax=0x1AD908 ay=0x1AB87C */
/begin CHARACTERISTIC C_fam_0022_1C7A30 "RE map_interp_C C_fam_0022 call=0x800FC11E" MAP 0x1C7A30 RL_IDENTITY 0 NO_INPUT_QUANTITY 1.0 FORMAT "%%5.0"
 /begin AXIS_DESCR COM_AXIS NO_INPUT_QUANTITY NO_COMPU_METHOD 2 AXIS_PTS_REF AX_1AD908 /end AXIS_DESCR
 /begin AXIS_DESCR COM_AXIS NO_INPUT_QUANTITY NO_COMPU_METHOD 2 AXIS_PTS_REF AX_1AB87C /end AXIS_DESCR
/end CHARACTERISTIC
/* src=families fam=fam_0174 ax=0x19E56C ay=0x19974C */
/begin CHARACTERISTIC map_horsA2L_1C7AC4 "RE interp_2d fam_0174 call=0x800F5F92" MAP 0x1C7AC4 RL_IDENTITY 0 NO_INPUT_QUANTITY 1.0 FORMAT "%%5.0"
 /begin AXIS_DESCR COM_AXIS NO_INPUT_QUANTITY NO_COMPU_METHOD 2 AXIS_PTS_REF AX_19E56C /end AXIS_DESCR
 /begin AXIS_DESCR COM_AXIS NO_INPUT_QUANTITY NO_COMPU_METHOD 2 AXIS_PTS_REF AX_19974C /end AXIS_DESCR
/end CHARACTERISTIC
/* src=families fam=fam_0022 ax=0x19F564 ay=0x19A744 */
/begin CHARACTERISTIC map_horsA2L_1C7B10 "RE interp_2d fam_0022 call=0x80111FEA" MAP 0x1C7B10 RL_IDENTITY 0 NO_INPUT_QUANTITY 1.0 FORMAT "%%5.0"
 /begin AXIS_DESCR COM_AXIS NO_INPUT_QUANTITY NO_COMPU_METHOD 2 AXIS_PTS_REF AX_19F564 /end AXIS_DESCR
 /begin AXIS_DESCR COM_AXIS NO_INPUT_QUANTITY NO_COMPU_METHOD 2 AXIS_PTS_REF AX_19A744 /end AXIS_DESCR
/end CHARACTERISTIC
/* src=families fam=C_fam_0266 ax=0x1A2774 ay=0x- */ /* STUB unknown size; axis_x=0x1A2774 axis_y=0x- */
/begin CHARACTERISTIC C_fam_0266_1C8000 "RE map_interp_C C_fam_0266 call=0x80096466" VALUE 0x1C8000 RL_IDENTITY 0 NO_INPUT_QUANTITY 1.0 /end CHARACTERISTIC
/* src=families fam=C_fam_0042 ax=0x1AB8F8 ay=0x- */ /* STUB unknown size; axis_x=0x1AB8F8 axis_y=0x- */
/begin CHARACTERISTIC C_fam_0042_1C8090 "RE map_interp_C C_fam_0042 call=0x800B8850" VALUE 0x1C8090 RL_IDENTITY 0 NO_INPUT_QUANTITY 1.0 /end CHARACTERISTIC
/* src=families fam=C_fam_0143 ax=0x1A5634 ay=0x- */ /* STUB unknown size; axis_x=0x1A5634 axis_y=0x- */
/begin CHARACTERISTIC C_fam_0143_1C80A0 "RE map_interp_C C_fam_0143 call=0x8010F1E6" VALUE 0x1C80A0 RL_IDENTITY 0 NO_INPUT_QUANTITY 1.0 /end CHARACTERISTIC
/begin CHARACTERISTIC I_fam_0001_1C80AC "RE map_interp_I I_fam_0001 call=0x8011C4DC" VALUE 0x1C80AC RL_IDENTITY 0 NO_INPUT_QUANTITY 1.0 /end CHARACTERISTIC
/* src=families fam=C_fam_0032 ax=0x1A9928 ay=0x- */ /* STUB unknown size; axis_x=0x1A9928 axis_y=0x- */
/begin CHARACTERISTIC C_fam_0032_1C8390 "RE map_interp_C C_fam_0032 call=0x800EB192" VALUE 0x1C8390 RL_IDENTITY 0 NO_INPUT_QUANTITY 1.0 /end CHARACTERISTIC
/* src=families fam=C_fam_0270 ax=0x1B682C ay=0x- */ /* STUB unknown size; axis_x=0x1B682C axis_y=0x- */
/begin CHARACTERISTIC C_fam_0270_1C83C4 "RE map_interp_C C_fam_0270 call=0x800C0A20" VALUE 0x1C83C4 RL_IDENTITY 0 NO_INPUT_QUANTITY 1.0 /end CHARACTERISTIC
/* src=families fam=J_fam_0056 ax=0x- ay=0x- */
/begin CHARACTERISTIC J_fam_0056_1C8488 "RE map_interp_J J_fam_0056 call=0x801007FE" VALUE 0x1C8488 RL_IDENTITY 0 NO_INPUT_QUANTITY 1.0 /end CHARACTERISTIC
/* src=families fam=C_fam_0208 ax=0x- ay=0x- */
/begin CHARACTERISTIC C_fam_0208_1C84AC "RE map_interp_C C_fam_0208 call=0x80121C68" VALUE 0x1C84AC RL_IDENTITY 0 NO_INPUT_QUANTITY 1.0 /end CHARACTERISTIC
/* src=families fam=fam_0175 ax=0x- ay=0x- */
/begin CHARACTERISTIC map_horsA2L_1CD450 "RE interp_2d fam_0175 call=0x80100730" VALUE 0x1C84BC RL_IDENTITY 0 NO_INPUT_QUANTITY 1.0 /end CHARACTERISTIC
/* src=families fam=E_fam_0068 ax=0x- ay=0x- */
/begin CHARACTERISTIC E_fam_0068_1C8568 "RE map_interp_E E_fam_0068 call=0x80105F84" VALUE 0x1C8568 RL_IDENTITY 0 NO_INPUT_QUANTITY 1.0 /end CHARACTERISTIC
/* src=families fam=D_fam_0230 ax=0x- ay=0x- */
/begin CHARACTERISTIC D_fam_0230_1C8574 "RE map_interp_D D_fam_0230 call=0x801061B8" VALUE 0x1C8574 RL_IDENTITY 0 NO_INPUT_QUANTITY 1.0 /end CHARACTERISTIC
/* src=families fam=I_fam_0086 ax=0x- ay=0x- */
/begin CHARACTERISTIC I_fam_0086_1C87B8 "RE map_interp_I I_fam_0086 call=0x80093B62" VALUE 0x1C87B8 RL_IDENTITY 0 NO_INPUT_QUANTITY 1.0 /end CHARACTERISTIC
/* src=families fam=F_fam_0120 ax=0x- ay=0x- */
/begin CHARACTERISTIC F_fam_0120_1C87F8 "RE map_interp_F F_fam_0120 call=0x80093ADE" VALUE 0x1C87F8 RL_IDENTITY 0 NO_INPUT_QUANTITY 1.0 /end CHARACTERISTIC
/* src=families fam=C_fam_0309 ax=0x- ay=0x- */
/begin CHARACTERISTIC C_fam_0309_1C884C "RE map_interp_C C_fam_0309 call=0x800D6466" VALUE 0x1C884C RL_IDENTITY 0 NO_INPUT_QUANTITY 1.0 /end CHARACTERISTIC
/* src=families fam=C_fam_0164 ax=0x1B0914 ay=0x- */ /* STUB unknown size; axis_x=0x1B0914 axis_y=0x- */
/begin CHARACTERISTIC C_fam_0164_1C885C "RE map_interp_C C_fam_0164 call=0x800AE73E" VALUE 0x1C885C RL_IDENTITY 0 NO_INPUT_QUANTITY 1.0 /end CHARACTERISTIC
/* src=families fam=E_fam_0089 ax=0x- ay=0x- */
/begin CHARACTERISTIC E_fam_0089_1C886C "RE map_interp_E E_fam_0089 call=0x8007981C" VALUE 0x1C886C RL_IDENTITY 0 NO_INPUT_QUANTITY 1.0 /end CHARACTERISTIC
/* src=families fam=I_fam_0013 ax=0x1B7920 ay=0x- */ /* STUB unknown size; axis_x=0x1B7920 axis_y=0x- */
/begin CHARACTERISTIC I_fam_0013_1C887C "RE map_interp_I I_fam_0013 call=0x8007974E" VALUE 0x1C887C RL_IDENTITY 0 NO_INPUT_QUANTITY 1.0 /end CHARACTERISTIC
/* src=families fam=C_fam_0300 ax=0x- ay=0x- */
/begin CHARACTERISTIC C_fam_0300_1C896C "RE map_interp_C C_fam_0300 call=0x800C2296" VALUE 0x1C896C RL_IDENTITY 0 NO_INPUT_QUANTITY 1.0 /end CHARACTERISTIC
/* src=families fam=fam_0006 ax=0x1AD874 ay=0x1AD930 */
/begin CHARACTERISTIC map_horsA2L_1C8978 "RE interp_2d fam_0006 call=0x800F61FE" MAP 0x1C8978 RL_IDENTITY 0 NO_INPUT_QUANTITY 1.0 FORMAT "%%5.0"
 /begin AXIS_DESCR COM_AXIS NO_INPUT_QUANTITY NO_COMPU_METHOD 16 AXIS_PTS_REF AX_1AD874 /end AXIS_DESCR
 /begin AXIS_DESCR COM_AXIS NO_INPUT_QUANTITY NO_COMPU_METHOD 20 AXIS_PTS_REF AX_1AD930 /end AXIS_DESCR
/end CHARACTERISTIC
/* src=families fam=C_fam_0235 ax=0x1B1908 ay=0x- */
/begin CHARACTERISTIC C_fam_0235_1C89CC "RE map_interp_C C_fam_0235 call=0x80095930" VALUE 0x1C89CC RL_IDENTITY 0 NO_INPUT_QUANTITY 1.0 /end CHARACTERISTIC
/begin CHARACTERISTIC C_fam_0010_1C89D8 "RE map_interp_C C_fam_0010 call=0x8009597E" VALUE 0x1C89D8 RL_IDENTITY 0 NO_INPUT_QUANTITY 1.0 /end CHARACTERISTIC
/* src=families fam=C_fam_0167 ax=0x1B1908 ay=0x- */
/begin CHARACTERISTIC C_fam_0167_1C89E4 "RE map_interp_C C_fam_0167 call=0x800944C0" VALUE 0x1C89E4 RL_IDENTITY 0 NO_INPUT_QUANTITY 1.0 /end CHARACTERISTIC
/* src=families fam=I_fam_0002 ax=0x1A2734 ay=0x1AD8D0 */
/begin CHARACTERISTIC I_fam_0002_1C89F0 "RE map_interp_I I_fam_0002 call=0x80074F14" MAP 0x1C89F0 RL_IDENTITY 0 NO_INPUT_QUANTITY 1.0 FORMAT "%%5.0"
 /begin AXIS_DESCR COM_AXIS NO_INPUT_QUANTITY NO_COMPU_METHOD 2 AXIS_PTS_REF AX_1A2734 /end AXIS_DESCR
 /begin AXIS_DESCR COM_AXIS NO_INPUT_QUANTITY NO_COMPU_METHOD 2 AXIS_PTS_REF AX_1AD8D0 /end AXIS_DESCR
/end CHARACTERISTIC
/* src=families fam=fam_0010 ax=0x1A1710 ay=0x1A1678 */
/begin CHARACTERISTIC map_horsA2L_1C89FC "RE interp_2d fam_0010 call=0x8007DB10" MAP 0x1C89FC RL_IDENTITY 0 NO_INPUT_QUANTITY 1.0 FORMAT "%%5.0"
 /begin AXIS_DESCR COM_AXIS NO_INPUT_QUANTITY NO_COMPU_METHOD 2 AXIS_PTS_REF AX_1A1710 /end AXIS_DESCR
 /begin AXIS_DESCR COM_AXIS NO_INPUT_QUANTITY NO_COMPU_METHOD 2 AXIS_PTS_REF AX_1A1678 /end AXIS_DESCR
/end CHARACTERISTIC
/* src=families fam=B_fam_0065 ax=0x- ay=0x- */
/begin CHARACTERISTIC B_fam_0065_1C8A08 "RE interp_2d_B B_fam_0065 call=0x801244CE" VALUE 0x1C8A08 RL_IDENTITY 0 NO_INPUT_QUANTITY 1.0 /end CHARACTERISTIC
/* src=families fam=O_fam_0018 ax=0x- ay=0x- */
/begin CHARACTERISTIC O_fam_0018_1C8A24 "RE map_interp_O O_fam_0018 call=0x801244F0" VALUE 0x1C8A24 RL_IDENTITY 0 NO_INPUT_QUANTITY 1.0 /end CHARACTERISTIC
/* src=families fam=N_fam_0033 ax=0x- ay=0x- */
/begin CHARACTERISTIC N_fam_0033_1C8AB8 "RE map_interp_N N_fam_0033 call=0x8011B130" VALUE 0x1C8AB8 RL_IDENTITY 0 NO_INPUT_QUANTITY 1.0 /end CHARACTERISTIC
/begin CHARACTERISTIC C_fam_0005_1C8EE0 "RE map_interp_C C_fam_0005 call=0x800F32C2" VALUE 0x1C8EE0 RL_IDENTITY 0 NO_INPUT_QUANTITY 1.0 /end CHARACTERISTIC
/begin CHARACTERISTIC C_fam_0005_1C8EF4 "RE map_interp_C C_fam_0005 call=0x800F3292" VALUE 0x1C8EF4 RL_IDENTITY 0 NO_INPUT_QUANTITY 1.0 /end CHARACTERISTIC
/* src=families fam=I_fam_0049 ax=0x1A98F4 ay=0x- */ /* STUB unknown size; axis_x=0x1A98F4 axis_y=0x- */
/begin CHARACTERISTIC I_fam_0049_1C8F08 "RE map_interp_I I_fam_0049 call=0x8009BF5C" VALUE 0x1C8F08 RL_IDENTITY 0 NO_INPUT_QUANTITY 1.0 /end CHARACTERISTIC
/* src=families fam=B_fam_0016 ax=0x1AA8C8 ay=0x1A06E0 */
/begin CHARACTERISTIC B_fam_0016_1C8F18 "RE interp_2d_B B_fam_0016 call=0x800FFB84" MAP 0x1C8F18 RL_IDENTITY 0 NO_INPUT_QUANTITY 1.0 FORMAT "%%5.0"
 /begin AXIS_DESCR COM_AXIS NO_INPUT_QUANTITY NO_COMPU_METHOD 2 AXIS_PTS_REF AX_1AA8C8 /end AXIS_DESCR
 /begin AXIS_DESCR COM_AXIS NO_INPUT_QUANTITY NO_COMPU_METHOD 2 AXIS_PTS_REF AX_1A06E0 /end AXIS_DESCR
/end CHARACTERISTIC
/begin CHARACTERISTIC map_horsA2L_1C9040 "RE interp_2d fam_0005 call=0x800CC792" MAP 0x1C9040 RL_IDENTITY 0 NO_INPUT_QUANTITY 1.0 FORMAT "%%5.0"
 /begin AXIS_DESCR COM_AXIS NO_INPUT_QUANTITY NO_COMPU_METHOD 2 AXIS_PTS_REF AX_1AD850 /end AXIS_DESCR
 /begin AXIS_DESCR COM_AXIS NO_INPUT_QUANTITY NO_COMPU_METHOD 2 AXIS_PTS_REF AX_1B292C /end AXIS_DESCR
/end CHARACTERISTIC
/begin CHARACTERISTIC I_fam_0001_1C9084 "RE map_interp_I I_fam_0001 call=0x8011C51A" VALUE 0x1C9084 RL_IDENTITY 0 NO_INPUT_QUANTITY 1.0 /end CHARACTERISTIC
/begin CHARACTERISTIC map_horsA2L_1C909C "RE interp_2d fam_0005 call=0x800CC814" MAP 0x1C909C RL_IDENTITY 0 NO_INPUT_QUANTITY 1.0 FORMAT "%%5.0"
 /begin AXIS_DESCR COM_AXIS NO_INPUT_QUANTITY NO_COMPU_METHOD 2 AXIS_PTS_REF AX_1AD850 /end AXIS_DESCR
 /begin AXIS_DESCR COM_AXIS NO_INPUT_QUANTITY NO_COMPU_METHOD 2 AXIS_PTS_REF AX_1B292C /end AXIS_DESCR
/end CHARACTERISTIC
/* src=families fam=fam_0062 ax=0x1A88EC ay=0x1B89C8 */
/begin CHARACTERISTIC map_horsA2L_1C92B4 "RE interp_2d fam_0062 call=0x80087954" MAP 0x1C92B4 RL_IDENTITY 0 NO_INPUT_QUANTITY 1.0 FORMAT "%%5.0"
 /begin AXIS_DESCR COM_AXIS NO_INPUT_QUANTITY NO_COMPU_METHOD 2 AXIS_PTS_REF AX_1A88EC /end AXIS_DESCR
 /begin AXIS_DESCR COM_AXIS NO_INPUT_QUANTITY NO_COMPU_METHOD 2 AXIS_PTS_REF AX_1B89C8 /end AXIS_DESCR
/end CHARACTERISTIC
/* src=families fam=B_fam_0002 ax=0x1A88FC ay=0x1A8934 */
/begin CHARACTERISTIC B_fam_0002_1C92EC "RE interp_2d_B B_fam_0002 call=0x800954F8" MAP 0x1C92EC RL_IDENTITY 0 NO_INPUT_QUANTITY 1.0 FORMAT "%%5.0"
 /begin AXIS_DESCR COM_AXIS NO_INPUT_QUANTITY NO_COMPU_METHOD 2 AXIS_PTS_REF AX_1A88FC /end AXIS_DESCR
 /begin AXIS_DESCR COM_AXIS NO_INPUT_QUANTITY NO_COMPU_METHOD 2 AXIS_PTS_REF AX_1A8934 /end AXIS_DESCR
/end CHARACTERISTIC
/* src=families fam=M_fam_0013 ax=0x1A4670 ay=0x- */ /* STUB unknown size; axis_x=0x1A4670 axis_y=0x- */
/begin CHARACTERISTIC M_fam_0013_1C93A0 "RE map_interp_M M_fam_0013 call=0x800AEEDA" VALUE 0x1C93A0 RL_IDENTITY 0 NO_INPUT_QUANTITY 1.0 /end CHARACTERISTIC
/* src=families fam=F_fam_0097 ax=0x- ay=0x- */
/begin CHARACTERISTIC F_fam_0097_1C9444 "RE map_interp_F F_fam_0097 call=0x800883A8" VALUE 0x1C9444 RL_IDENTITY 0 NO_INPUT_QUANTITY 1.0 /end CHARACTERISTIC
/* src=families fam=E_fam_0078 ax=0x- ay=0x- */
/begin CHARACTERISTIC E_fam_0078_1C94FC "RE map_interp_E E_fam_0078 call=0x8012202E" VALUE 0x1C94FC RL_IDENTITY 0 NO_INPUT_QUANTITY 1.0 /end CHARACTERISTIC
/* src=families fam=D_fam_0001 ax=0x- ay=0x- */
/begin CHARACTERISTIC D_fam_0001_1C956C "RE map_interp_D D_fam_0001 call=0x80097452" VALUE 0x1C956C RL_IDENTITY 0 NO_INPUT_QUANTITY 1.0 /end CHARACTERISTIC
/* src=families fam=D_fam_0207 ax=0x- ay=0x- */
/begin CHARACTERISTIC D_fam_0207_1C9610 "RE map_interp_D D_fam_0207 call=0x800D2820" VALUE 0x1C9610 RL_IDENTITY 0 NO_INPUT_QUANTITY 1.0 /end CHARACTERISTIC
/* src=families fam=D_fam_0061 ax=0x1B7914 ay=0x1AC814 */
/begin CHARACTERISTIC D_fam_0061_1C9620 "RE map_interp_D D_fam_0061 call=0x800D27A4" MAP 0x1C9620 RL_IDENTITY 0 NO_INPUT_QUANTITY 1.0 FORMAT "%%5.0"
 /begin AXIS_DESCR COM_AXIS NO_INPUT_QUANTITY NO_COMPU_METHOD 2 AXIS_PTS_REF AX_1B7914 /end AXIS_DESCR
 /begin AXIS_DESCR COM_AXIS NO_INPUT_QUANTITY NO_COMPU_METHOD 2 AXIS_PTS_REF AX_1AC814 /end AXIS_DESCR
/end CHARACTERISTIC
/* src=families fam=G_fam_0017 ax=0x- ay=0x- */
/begin CHARACTERISTIC G_fam_0017_1C96C4 "RE map_interp_G G_fam_0017 call=0x800972AA" VALUE 0x1C96C4 RL_IDENTITY 0 NO_INPUT_QUANTITY 1.0 /end CHARACTERISTIC
/* src=families fam=G_fam_0018 ax=0x- ay=0x- */
/begin CHARACTERISTIC G_fam_0018_1C96F0 "RE map_interp_G G_fam_0018 call=0x80097346" VALUE 0x1C96F0 RL_IDENTITY 0 NO_INPUT_QUANTITY 1.0 /end CHARACTERISTIC
/* src=families fam=H_fam_0078 ax=0x- ay=0x- */
/begin CHARACTERISTIC H_fam_0078_1C9750 "RE map_interp_H H_fam_0078 call=0x800990F0" VALUE 0x1C9750 RL_IDENTITY 0 NO_INPUT_QUANTITY 1.0 /end CHARACTERISTIC
/* src=families fam=I_fam_0013 ax=0x1B7920 ay=0x- */ /* STUB unknown size; axis_x=0x1B7920 axis_y=0x- */
/begin CHARACTERISTIC I_fam_0013_1C984C "RE map_interp_I I_fam_0013 call=0x80079736" VALUE 0x1C984C RL_IDENTITY 0 NO_INPUT_QUANTITY 1.0 /end CHARACTERISTIC
/* src=families fam=F_fam_0013 ax=0x1AB924 ay=0x1B7C18 */
/begin CHARACTERISTIC F_fam_0013_1C985C "RE map_interp_F F_fam_0013 call=0x800740BC" MAP 0x1C985C RL_IDENTITY 0 NO_INPUT_QUANTITY 1.0 FORMAT "%%5.0"
 /begin AXIS_DESCR COM_AXIS NO_INPUT_QUANTITY NO_COMPU_METHOD 2 AXIS_PTS_REF AX_1AB924 /end AXIS_DESCR
 /begin AXIS_DESCR COM_AXIS NO_INPUT_QUANTITY NO_COMPU_METHOD 2 AXIS_PTS_REF AX_1B7C18 /end AXIS_DESCR
/end CHARACTERISTIC
/* src=families fam=E_fam_0123 ax=0x- ay=0x- */
/begin CHARACTERISTIC E_fam_0123_1C9A1C "RE map_interp_E E_fam_0123 call=0x80118C82" VALUE 0x1C9A1C RL_IDENTITY 0 NO_INPUT_QUANTITY 1.0 /end CHARACTERISTIC
/* src=families fam=fam_0030 ax=0x1A151C ay=0x1A26F4 */
/begin CHARACTERISTIC map_horsA2L_1C9A34 "RE interp_2d fam_0030 call=0x8010F34C; RE map_interp_C C_fam_0066 call=0x8010F36" MAP 0x1C9A34 RL_IDENTITY 0 NO_INPUT_QUANTITY 1.0 FORMAT "%%5.0"
 /begin AXIS_DESCR COM_AXIS NO_INPUT_QUANTITY NO_COMPU_METHOD 2 AXIS_PTS_REF AX_1A151C /end AXIS_DESCR
 /begin AXIS_DESCR COM_AXIS NO_INPUT_QUANTITY NO_COMPU_METHOD 2 AXIS_PTS_REF AX_1A26F4 /end AXIS_DESCR
/end CHARACTERISTIC
/begin CHARACTERISTIC map_horsA2L_1C9AE4 "RE interp_2d fam_0002 call=0x800EC152" MAP 0x1C9AE4 RL_IDENTITY 0 NO_INPUT_QUANTITY 1.0 FORMAT "%%5.0"
 /begin AXIS_DESCR COM_AXIS NO_INPUT_QUANTITY NO_COMPU_METHOD 2 AXIS_PTS_REF AX_1A8864 /end AXIS_DESCR
 /begin AXIS_DESCR COM_AXIS NO_INPUT_QUANTITY NO_COMPU_METHOD 2 AXIS_PTS_REF AX_1AC87C /end AXIS_DESCR
/end CHARACTERISTIC
/* src=families fam=C_fam_0330 ax=0x- ay=0x- */
/begin CHARACTERISTIC C_fam_0330_1C9EC8 "RE map_interp_C C_fam_0330 call=0x800FBBA2" VALUE 0x1C9EC8 RL_IDENTITY 0 NO_INPUT_QUANTITY 1.0 /end CHARACTERISTIC
/* src=families fam=fam_0023 ax=0x1A7710 ay=0x19A508 */
/begin CHARACTERISTIC map_horsA2L_1C9ED4 "RE interp_2d fam_0023 call=0x80095F96" MAP 0x1C9ED4 RL_IDENTITY 0 NO_INPUT_QUANTITY 1.0 FORMAT "%%5.0"
 /begin AXIS_DESCR COM_AXIS NO_INPUT_QUANTITY NO_COMPU_METHOD 2 AXIS_PTS_REF AX_1A7710 /end AXIS_DESCR
 /begin AXIS_DESCR COM_AXIS NO_INPUT_QUANTITY NO_COMPU_METHOD 2 AXIS_PTS_REF AX_19A508 /end AXIS_DESCR
/end CHARACTERISTIC
/* src=families fam=fam_0060 ax=0x1A88EC ay=0x1A14C4 */
/begin CHARACTERISTIC map_horsA2L_1CA2BC "RE interp_2d fam_0060 call=0x80087904" MAP 0x1CA2BC RL_IDENTITY 0 NO_INPUT_QUANTITY 1.0 FORMAT "%%5.0"
 /begin AXIS_DESCR COM_AXIS NO_INPUT_QUANTITY NO_COMPU_METHOD 2 AXIS_PTS_REF AX_1A88EC /end AXIS_DESCR
 /begin AXIS_DESCR COM_AXIS NO_INPUT_QUANTITY NO_COMPU_METHOD 2 AXIS_PTS_REF AX_1A14C4 /end AXIS_DESCR
/end CHARACTERISTIC
/* src=families fam=B_fam_0034 ax=0x1A4640 ay=0x- */ /* STUB unknown size; axis_x=0x1A4640 axis_y=0x- */
/begin CHARACTERISTIC B_fam_0034_1CA380 "RE interp_2d_B B_fam_0034 call=0x800B3AA6" VALUE 0x1CA380 RL_IDENTITY 0 NO_INPUT_QUANTITY 1.0 /end CHARACTERISTIC
/begin CHARACTERISTIC map_horsA2L_1D5430 "RE interp_2d fam_0008 call=0x8010662A" VALUE 0x1CA43C RL_IDENTITY 0 NO_INPUT_QUANTITY 1.0 /end CHARACTERISTIC
/* src=families fam=F_fam_0098 ax=0x- ay=0x- */
/begin CHARACTERISTIC F_fam_0098_1CA44C "RE map_interp_F F_fam_0098 call=0x800883C0" VALUE 0x1CA44C RL_IDENTITY 0 NO_INPUT_QUANTITY 1.0 /end CHARACTERISTIC
/* src=families fam=fam_0177 ax=0x- ay=0x- */
/begin CHARACTERISTIC fam_0177_1CA484 "RE interp_2d fam_0177 call=0x801055DA" VALUE 0x1CA484 RL_IDENTITY 0 NO_INPUT_QUANTITY 1.0 /end CHARACTERISTIC
/* src=families fam=fam_0183 ax=0x- ay=0x- */
/begin CHARACTERISTIC map_horsA2L_1CE450 "RE interp_2d fam_0183 call=0x80121AFA" VALUE 0x1CA4CC RL_IDENTITY 0 NO_INPUT_QUANTITY 1.0 /end CHARACTERISTIC
/* src=families fam=D_fam_0002 ax=0x- ay=0x- */
/begin CHARACTERISTIC D_fam_0002_1CA574 "RE map_interp_D D_fam_0002 call=0x800974FA" VALUE 0x1CA574 RL_IDENTITY 0 NO_INPUT_QUANTITY 1.0 /end CHARACTERISTIC
/* src=families fam=K_fam_0051 ax=0x- ay=0x- */
/begin CHARACTERISTIC K_fam_0051_1CA620 "RE map_interp_K K_fam_0051 call=0x80093A44" VALUE 0x1CA620 RL_IDENTITY 0 NO_INPUT_QUANTITY 1.0 /end CHARACTERISTIC
/* src=families fam=E_fam_0117 ax=0x- ay=0x- */
/begin CHARACTERISTIC E_fam_0117_1CA978 "RE map_interp_E E_fam_0117 call=0x8010B35A" VALUE 0x1CA978 RL_IDENTITY 0 NO_INPUT_QUANTITY 1.0 /end CHARACTERISTIC
/* src=families fam=C_fam_0252 ax=0x1A26D0 ay=0x1A64F4 */
/begin CHARACTERISTIC C_fam_0252_1CAA28 "RE map_interp_C C_fam_0252 call=0x800B7B42; RE map_interp_D D_fam_0025 call=0x80" MAP 0x1CAA28 RL_IDENTITY 0 NO_INPUT_QUANTITY 1.0 FORMAT "%%5.0"
 /begin AXIS_DESCR COM_AXIS NO_INPUT_QUANTITY NO_COMPU_METHOD 2 AXIS_PTS_REF AX_1A26D0 /end AXIS_DESCR
 /begin AXIS_DESCR COM_AXIS NO_INPUT_QUANTITY NO_COMPU_METHOD 2 AXIS_PTS_REF AX_1A64F4 /end AXIS_DESCR
/end CHARACTERISTIC
/* src=families fam=M_fam_0014 ax=0x- ay=0x- */
/begin CHARACTERISTIC M_fam_0014_1CAA3C "RE map_interp_M M_fam_0014 call=0x8009E4EA" VALUE 0x1CAA3C RL_IDENTITY 0 NO_INPUT_QUANTITY 1.0 /end CHARACTERISTIC
/* src=families fam=C_fam_0148 ax=0x1A6690 ay=0x- */ /* STUB unknown size; axis_x=0x1A6690 axis_y=0x- */
/begin CHARACTERISTIC C_fam_0148_1CAA88 "RE map_interp_C C_fam_0148 call=0x8010F2D2" VALUE 0x1CAA88 RL_IDENTITY 0 NO_INPUT_QUANTITY 1.0 /end CHARACTERISTIC
/* src=families fam=fam_0021 ax=0x1BCA3C ay=0x- */ /* STUB unknown size; axis_x=0x1BCA3C axis_y=0x- */
/begin CHARACTERISTIC map_horsA2L_1CAE84 "RE interp_2d fam_0021 call=0x800E4146" VALUE 0x1CAE84 RL_IDENTITY 0 NO_INPUT_QUANTITY 1.0 /end CHARACTERISTIC
/* src=families fam=E_fam_0011 ax=0x1A2720 ay=0x1BB960 */
/begin CHARACTERISTIC E_fam_0011_1CB388 "RE map_interp_E E_fam_0011 call=0x800B3988; RE map_interp_F F_fam_0002 call=0x80" MAP 0x1CB388 RL_IDENTITY 0 NO_INPUT_QUANTITY 1.0 FORMAT "%%5.0"
 /begin AXIS_DESCR COM_AXIS NO_INPUT_QUANTITY NO_COMPU_METHOD 2 AXIS_PTS_REF AX_1A2720 /end AXIS_DESCR
 /begin AXIS_DESCR COM_AXIS NO_INPUT_QUANTITY NO_COMPU_METHOD 2 AXIS_PTS_REF AX_1BB960 /end AXIS_DESCR
/end CHARACTERISTIC
/* src=families fam=I_fam_0072 ax=0x- ay=0x- */
/begin CHARACTERISTIC I_fam_0072_1CB454 "RE map_interp_I I_fam_0072 call=0x8008833E" VALUE 0x1CB454 RL_IDENTITY 0 NO_INPUT_QUANTITY 1.0 /end CHARACTERISTIC
/* src=families fam=fam_0176 ax=0x- ay=0x- */
/begin CHARACTERISTIC map_horsA2L_1D5488 "RE interp_2d fam_0176 call=0x80105574" VALUE 0x1CB48C RL_IDENTITY 0 NO_INPUT_QUANTITY 1.0 /end CHARACTERISTIC
/* src=families fam=G_fam_0019 ax=0x- ay=0x- */
/begin CHARACTERISTIC G_fam_0019_1CB6C0 "RE map_interp_G G_fam_0019 call=0x800973E0" VALUE 0x1CB6C0 RL_IDENTITY 0 NO_INPUT_QUANTITY 1.0 /end CHARACTERISTIC
/* src=families fam=G_fam_0116 ax=0x- ay=0x- */
/begin CHARACTERISTIC G_fam_0116_1CB6FC "RE map_interp_G G_fam_0116 call=0x800BB6F8" VALUE 0x1CB6FC RL_IDENTITY 0 NO_INPUT_QUANTITY 1.0 /end CHARACTERISTIC
/* src=families fam=H_fam_0092 ax=0x- ay=0x- */
/begin CHARACTERISTIC H_fam_0092_1CB700 "RE map_interp_H H_fam_0092 call=0x80099260" VALUE 0x1CB700 RL_IDENTITY 0 NO_INPUT_QUANTITY 1.0 /end CHARACTERISTIC
/* src=families fam=E_fam_0100 ax=0x- ay=0x- */
/begin CHARACTERISTIC E_fam_0100_1CB82C "RE map_interp_E E_fam_0100 call=0x800B1332" VALUE 0x1CB82C RL_IDENTITY 0 NO_INPUT_QUANTITY 1.0 /end CHARACTERISTIC
/* src=families fam=E_fam_0101 ax=0x- ay=0x- */
/begin CHARACTERISTIC E_fam_0101_1CB838 "RE map_interp_E E_fam_0101 call=0x800B134C" VALUE 0x1CB838 RL_IDENTITY 0 NO_INPUT_QUANTITY 1.0 /end CHARACTERISTIC
/* src=families fam=F_fam_0082 ax=0x1B7C18 ay=0x- */ /* STUB unknown size; axis_x=0x1B7C18 axis_y=0x- */
/begin CHARACTERISTIC F_fam_0082_1CB87C "RE map_interp_F F_fam_0082 call=0x800740E0" VALUE 0x1CB87C RL_IDENTITY 0 NO_INPUT_QUANTITY 1.0 /end CHARACTERISTIC
/* src=families fam=C_fam_0277 ax=0x- ay=0x- */
/begin CHARACTERISTIC C_fam_0277_1CB944 "RE map_interp_C C_fam_0277 call=0x8010EBBA" VALUE 0x1CB944 RL_IDENTITY 0 NO_INPUT_QUANTITY 1.0 /end CHARACTERISTIC
/* src=families fam=E_fam_0113 ax=0x- ay=0x- */
/begin CHARACTERISTIC E_fam_0113_1CB958 "RE map_interp_E E_fam_0113 call=0x80108714" VALUE 0x1CB958 RL_IDENTITY 0 NO_INPUT_QUANTITY 1.0 /end CHARACTERISTIC
/* src=families fam=E_fam_0119 ax=0x- ay=0x- */
/begin CHARACTERISTIC E_fam_0119_1CB968 "RE map_interp_E E_fam_0119 call=0x8010EB32" VALUE 0x1CB968 RL_IDENTITY 0 NO_INPUT_QUANTITY 1.0 /end CHARACTERISTIC
/* src=families fam=E_fam_0114 ax=0x- ay=0x- */
/begin CHARACTERISTIC E_fam_0114_1CB974 "RE map_interp_E E_fam_0114 call=0x8010938C" VALUE 0x1CB974 RL_IDENTITY 0 NO_INPUT_QUANTITY 1.0 /end CHARACTERISTIC
/* src=families fam=E_fam_0065 ax=0x- ay=0x- */
/begin CHARACTERISTIC E_fam_0065_1CBA70 "RE map_interp_E E_fam_0065 call=0x8009E5B6" VALUE 0x1CBA70 RL_IDENTITY 0 NO_INPUT_QUANTITY 1.0 /end CHARACTERISTIC
/* src=families fam=E_fam_0098 ax=0x- ay=0x- */
/begin CHARACTERISTIC E_fam_0098_1CBA7C "RE map_interp_E E_fam_0098 call=0x8009DFC0" VALUE 0x1CBA7C RL_IDENTITY 0 NO_INPUT_QUANTITY 1.0 /end CHARACTERISTIC
/* src=families fam=E_fam_0050 ax=0x1AA914 ay=0x- */ /* STUB unknown size; axis_x=0x1AA914 axis_y=0x- */
/begin CHARACTERISTIC E_fam_0050_1CBA84 "RE map_interp_E E_fam_0050 call=0x800C671C" VALUE 0x1CBA84 RL_IDENTITY 0 NO_INPUT_QUANTITY 1.0 /end CHARACTERISTIC
/* src=families fam=E_fam_0081 ax=0x1AA914 ay=0x- */ /* STUB unknown size; axis_x=0x1AA914 axis_y=0x- */
/begin CHARACTERISTIC E_fam_0081_1CBA94 "RE map_interp_E E_fam_0081 call=0x800C66CA" VALUE 0x1CBA94 RL_IDENTITY 0 NO_INPUT_QUANTITY 1.0 /end CHARACTERISTIC
/begin CHARACTERISTIC map_horsA2L_1CBAE4 "RE interp_2d fam_0002 call=0x800EC120" MAP 0x1CBAE4 RL_IDENTITY 0 NO_INPUT_QUANTITY 1.0 FORMAT "%%5.0"
 /begin AXIS_DESCR COM_AXIS NO_INPUT_QUANTITY NO_COMPU_METHOD 2 AXIS_PTS_REF AX_1A8864 /end AXIS_DESCR
 /begin AXIS_DESCR COM_AXIS NO_INPUT_QUANTITY NO_COMPU_METHOD 2 AXIS_PTS_REF AX_1AC87C /end AXIS_DESCR
/end CHARACTERISTIC
/* src=families fam=fam_0034 ax=0x1A2534 ay=0x1A3650 */
/begin CHARACTERISTIC map_horsA2L_1CBE40 "RE interp_2d fam_0034 call=0x80074D4E" MAP 0x1CBE40 RL_IDENTITY 0 NO_INPUT_QUANTITY 1.0 FORMAT "%%5.0"
 /begin AXIS_DESCR COM_AXIS NO_INPUT_QUANTITY NO_COMPU_METHOD 2 AXIS_PTS_REF AX_1A2534 /end AXIS_DESCR
 /begin AXIS_DESCR COM_AXIS NO_INPUT_QUANTITY NO_COMPU_METHOD 2 AXIS_PTS_REF AX_1A3650 /end AXIS_DESCR
/end CHARACTERISTIC
/* src=families fam=fam_0035 ax=0x1A2710 ay=0x1A365C */
/begin CHARACTERISTIC map_horsA2L_1CBE7C "RE interp_2d fam_0035 call=0x80074D78" MAP 0x1CBE7C RL_IDENTITY 0 NO_INPUT_QUANTITY 1.0 FORMAT "%%5.0"
 /begin AXIS_DESCR COM_AXIS NO_INPUT_QUANTITY NO_COMPU_METHOD 2 AXIS_PTS_REF AX_1A2710 /end AXIS_DESCR
 /begin AXIS_DESCR COM_AXIS NO_INPUT_QUANTITY NO_COMPU_METHOD 28 AXIS_PTS_REF AX_1A365C /end AXIS_DESCR
/end CHARACTERISTIC
/* src=families fam=B_fam_0038 ax=0x1A360C ay=0x- */ /* STUB unknown size; axis_x=0x1A360C axis_y=0x- */
/begin CHARACTERISTIC B_fam_0038_1CBED4 "RE interp_2d_B B_fam_0038 call=0x800C851A" VALUE 0x1CBED4 RL_IDENTITY 0 NO_INPUT_QUANTITY 1.0 /end CHARACTERISTIC
/* src=families fam=B_fam_0017 ax=0x1AA8C8 ay=0x1A4700 */
/begin CHARACTERISTIC B_fam_0017_1CBF18 "RE interp_2d_B B_fam_0017 call=0x800FFB58" MAP 0x1CBF18 RL_IDENTITY 0 NO_INPUT_QUANTITY 1.0 FORMAT "%%5.0"
 /begin AXIS_DESCR COM_AXIS NO_INPUT_QUANTITY NO_COMPU_METHOD 2 AXIS_PTS_REF AX_1AA8C8 /end AXIS_DESCR
 /begin AXIS_DESCR COM_AXIS NO_INPUT_QUANTITY NO_COMPU_METHOD 2 AXIS_PTS_REF AX_1A4700 /end AXIS_DESCR
/end CHARACTERISTIC
/begin CHARACTERISTIC fam_0001_1CBF80 "RE interp_2d fam_0001 call=0x800CC53E; AccPed-like 8x16 placeholder (APP_r/nmot " MAP 0x1CBF80 RL_IDENTITY 0 NO_INPUT_QUANTITY 1.0 FORMAT "%%5.0"
 /begin AXIS_DESCR COM_AXIS NO_INPUT_QUANTITY NO_COMPU_METHOD 8 AXIS_PTS_REF AX_1AA8E4 /end AXIS_DESCR
 /begin AXIS_DESCR COM_AXIS NO_INPUT_QUANTITY NO_COMPU_METHOD 16 AXIS_PTS_REF AX_1B3900 /end AXIS_DESCR
/end CHARACTERISTIC
/begin CHARACTERISTIC fam_0001_1CBFC0 "RE interp_2d fam_0001 call=0x800CC6E4; AccPed-like 8x16 placeholder (APP_r/nmot " MAP 0x1CBFC0 RL_IDENTITY 0 NO_INPUT_QUANTITY 1.0 FORMAT "%%5.0"
 /begin AXIS_DESCR COM_AXIS NO_INPUT_QUANTITY NO_COMPU_METHOD 8 AXIS_PTS_REF AX_1AA8E4 /end AXIS_DESCR
 /begin AXIS_DESCR COM_AXIS NO_INPUT_QUANTITY NO_COMPU_METHOD 16 AXIS_PTS_REF AX_1B3900 /end AXIS_DESCR
/end CHARACTERISTIC
/* src=families fam=fam_0011 ax=0x1A66E0 ay=0x1A74F4 */
/begin CHARACTERISTIC map_horsA2L_1CC0EC "RE interp_2d fam_0011 call=0x80087A78" MAP 0x1CC0EC RL_IDENTITY 0 NO_INPUT_QUANTITY 1.0 FORMAT "%%5.0"
 /begin AXIS_DESCR COM_AXIS NO_INPUT_QUANTITY NO_COMPU_METHOD 51 AXIS_PTS_REF AX_1A66E0 /end AXIS_DESCR
 /begin AXIS_DESCR COM_AXIS NO_INPUT_QUANTITY NO_COMPU_METHOD 2 AXIS_PTS_REF AX_1A74F4 /end AXIS_DESCR
/end CHARACTERISTIC
/* src=families fam=fam_0115 ax=0x1A6600 ay=0x199448 */
/begin CHARACTERISTIC map_horsA2L_1CC29C "RE interp_2d fam_0115 call=0x80087876" MAP 0x1CC29C RL_IDENTITY 0 NO_INPUT_QUANTITY 1.0 FORMAT "%%5.0"
 /begin AXIS_DESCR COM_AXIS NO_INPUT_QUANTITY NO_COMPU_METHOD 2 AXIS_PTS_REF AX_1A6600 /end AXIS_DESCR
 /begin AXIS_DESCR COM_AXIS NO_INPUT_QUANTITY NO_COMPU_METHOD 2 AXIS_PTS_REF AX_199448 /end AXIS_DESCR
/end CHARACTERISTIC
/* src=families fam=fam_0080 ax=0x1B38F8 ay=0x1A14D8 */
/begin CHARACTERISTIC map_horsA2L_1CC330 "RE interp_2d fam_0080 call=0x800BFC0C" MAP 0x1CC330 RL_IDENTITY 0 NO_INPUT_QUANTITY 1.0 FORMAT "%%5.0"
 /begin AXIS_DESCR COM_AXIS NO_INPUT_QUANTITY NO_COMPU_METHOD 2 AXIS_PTS_REF AX_1B38F8 /end AXIS_DESCR
 /begin AXIS_DESCR COM_AXIS NO_INPUT_QUANTITY NO_COMPU_METHOD 2 AXIS_PTS_REF AX_1A14D8 /end AXIS_DESCR
/end CHARACTERISTIC
/* src=families fam=C_fam_0231 ax=0x- ay=0x- */
/begin CHARACTERISTIC C_fam_0231_1CC4CC "RE map_interp_C C_fam_0231 call=0x801060C6" VALUE 0x1CC4CC RL_IDENTITY 0 NO_INPUT_QUANTITY 1.0 /end CHARACTERISTIC
/* src=families fam=fam_0135 ax=0x- ay=0x- */
/begin CHARACTERISTIC map_horsA2L_1CE464 "RE interp_2d fam_0135 call=0x80121C1E" VALUE 0x1CC4D8 RL_IDENTITY 0 NO_INPUT_QUANTITY 1.0 /end CHARACTERISTIC
/* src=families fam=D_fam_0164 ax=0x- ay=0x- */
/begin CHARACTERISTIC D_fam_0164_1CC5C4 "RE map_interp_D D_fam_0164 call=0x80093D76" VALUE 0x1CC5C4 RL_IDENTITY 0 NO_INPUT_QUANTITY 1.0 /end CHARACTERISTIC
/* src=families fam=K_fam_0052 ax=0x- ay=0x- */
/begin CHARACTERISTIC K_fam_0052_1CC618 "RE map_interp_K K_fam_0052 call=0x80093B4C" VALUE 0x1CC618 RL_IDENTITY 0 NO_INPUT_QUANTITY 1.0 /end CHARACTERISTIC
/* src=families fam=G_fam_0117 ax=0x- ay=0x- */
/begin CHARACTERISTIC G_fam_0117_1CC6DC "RE map_interp_G G_fam_0117 call=0x800BB748" VALUE 0x1CC6DC RL_IDENTITY 0 NO_INPUT_QUANTITY 1.0 /end CHARACTERISTIC
/* src=families fam=H_fam_0104 ax=0x- ay=0x- */
/begin CHARACTERISTIC H_fam_0104_1CC774 "RE map_interp_H H_fam_0104 call=0x800994B0" VALUE 0x1CC774 RL_IDENTITY 0 NO_INPUT_QUANTITY 1.0 /end CHARACTERISTIC
/* src=families fam=C_fam_0279 ax=0x- ay=0x- */
/begin CHARACTERISTIC C_fam_0279_1CC804 "RE map_interp_C C_fam_0279 call=0x80085EA0" VALUE 0x1CC804 RL_IDENTITY 0 NO_INPUT_QUANTITY 1.0 /end CHARACTERISTIC
/* src=families fam=B_fam_0024 ax=0x- ay=0x1A4720 */ /* STUB unknown size; axis_x=0x- axis_y=0x1A4720 */
/begin CHARACTERISTIC B_fam_0024_1CC810 "RE interp_2d_B B_fam_0024 call=0x8010681A" VALUE 0x1CC810 RL_IDENTITY 0 NO_INPUT_QUANTITY 1.0 /end CHARACTERISTIC
/* src=families fam=E_fam_0118 ax=0x- ay=0x- */
/begin CHARACTERISTIC E_fam_0118_1CC944 "RE map_interp_E E_fam_0118 call=0x8010EAC4" VALUE 0x1CC944 RL_IDENTITY 0 NO_INPUT_QUANTITY 1.0 /end CHARACTERISTIC
/* src=families fam=C_fam_0239 ax=0x- ay=0x- */
/begin CHARACTERISTIC C_fam_0239_1CCA04 "RE map_interp_C C_fam_0239 call=0x8008F8F0" VALUE 0x1CCA04 RL_IDENTITY 0 NO_INPUT_QUANTITY 1.0 /end CHARACTERISTIC
/* src=families fam=C_fam_0240 ax=0x- ay=0x- */
/begin CHARACTERISTIC C_fam_0240_1CCA18 "RE map_interp_C C_fam_0240 call=0x8008FAC4" VALUE 0x1CCA18 RL_IDENTITY 0 NO_INPUT_QUANTITY 1.0 /end CHARACTERISTIC
/* src=families fam=C_fam_0134 ax=0x1A147C ay=0x- */ /* STUB unknown size; axis_x=0x1A147C axis_y=0x- */
/begin CHARACTERISTIC C_fam_0134_1CCA2C "RE map_interp_C C_fam_0134 call=0x8008EE16" VALUE 0x1CCA2C RL_IDENTITY 0 NO_INPUT_QUANTITY 1.0 /end CHARACTERISTIC
/* src=families fam=E_fam_0034 ax=0x1A7680 ay=0x- */ /* STUB unknown size; axis_x=0x1A7680 axis_y=0x- */
/begin CHARACTERISTIC E_fam_0034_1CCA48 "RE map_interp_E E_fam_0034 call=0x80106E84" VALUE 0x1CCA48 RL_IDENTITY 0 NO_INPUT_QUANTITY 1.0 /end CHARACTERISTIC
/* src=families fam=C_fam_0136 ax=0x1A3668 ay=0x- */ /* STUB unknown size; axis_x=0x1A3668 axis_y=0x- */
/begin CHARACTERISTIC C_fam_0136_1CCE78 "RE map_interp_C C_fam_0136 call=0x8008C778" VALUE 0x1CCE78 RL_IDENTITY 0 NO_INPUT_QUANTITY 1.0 /end CHARACTERISTIC
/* src=families fam=O_fam_0006 ax=0x1A5500 ay=0x1A14E4 */
/begin CHARACTERISTIC O_fam_0006_1CCEF4 "RE map_interp_O O_fam_0006 call=0x800A5790" MAP 0x1CCEF4 RL_IDENTITY 0 NO_INPUT_QUANTITY 1.0 FORMAT "%%5.0"
 /begin AXIS_DESCR COM_AXIS NO_INPUT_QUANTITY NO_COMPU_METHOD 2 AXIS_PTS_REF AX_1A5500 /end AXIS_DESCR
 /begin AXIS_DESCR COM_AXIS NO_INPUT_QUANTITY NO_COMPU_METHOD 2 AXIS_PTS_REF AX_1A14E4 /end AXIS_DESCR
/end CHARACTERISTIC
/* src=families fam=F_fam_0084 ax=0x- ay=0x- */
/begin CHARACTERISTIC F_fam_0084_1CCF58 "RE map_interp_F F_fam_0084 call=0x80087C42" VALUE 0x1CCF58 RL_IDENTITY 0 NO_INPUT_QUANTITY 1.0 /end CHARACTERISTIC
/* src=families fam=O_fam_0004 ax=0x1A8928 ay=0x1B1874 */
/begin CHARACTERISTIC O_fam_0004_1CD000 "RE map_interp_O O_fam_0004 call=0x80096BAC" MAP 0x1CD000 RL_IDENTITY 0 NO_INPUT_QUANTITY 1.0 FORMAT "%%5.0"
 /begin AXIS_DESCR COM_AXIS NO_INPUT_QUANTITY NO_COMPU_METHOD 2 AXIS_PTS_REF AX_1A8928 /end AXIS_DESCR
 /begin AXIS_DESCR COM_AXIS NO_INPUT_QUANTITY NO_COMPU_METHOD 2 AXIS_PTS_REF AX_1B1874 /end AXIS_DESCR
/end CHARACTERISTIC
/begin CHARACTERISTIC map_horsA2L_1CD09C "RE interp_2d fam_0005 call=0x800CC7DA" MAP 0x1CD09C RL_IDENTITY 0 NO_INPUT_QUANTITY 1.0 FORMAT "%%5.0"
 /begin AXIS_DESCR COM_AXIS NO_INPUT_QUANTITY NO_COMPU_METHOD 2 AXIS_PTS_REF AX_1AD850 /end AXIS_DESCR
 /begin AXIS_DESCR COM_AXIS NO_INPUT_QUANTITY NO_COMPU_METHOD 2 AXIS_PTS_REF AX_1B292C /end AXIS_DESCR
/end CHARACTERISTIC
/* src=families fam=E_fam_0104 ax=0x- ay=0x- */
/begin CHARACTERISTIC E_fam_0104_1CD388 "RE map_interp_E E_fam_0104 call=0x800B3DDC" VALUE 0x1CD388 RL_IDENTITY 0 NO_INPUT_QUANTITY 1.0 /end CHARACTERISTIC
/* src=families fam=C_fam_0131 ax=0x- ay=0x1A5680 */ /* STUB unknown size; axis_x=0x- axis_y=0x1A5680 */
/begin CHARACTERISTIC C_fam_0131_1CD394 "RE map_interp_C C_fam_0131 call=0x800ADEDA" VALUE 0x1CD394 RL_IDENTITY 0 NO_INPUT_QUANTITY 1.0 /end CHARACTERISTIC
/* src=families fam=M_fam_0010 ax=0x- ay=0x1A5680 */ /* STUB unknown size; axis_x=0x- axis_y=0x1A5680 */
/begin CHARACTERISTIC M_fam_0010_1CD3A0 "RE map_interp_M M_fam_0010 call=0x800ADEBE" VALUE 0x1CD3A0 RL_IDENTITY 0 NO_INPUT_QUANTITY 1.0 /end CHARACTERISTIC
/* src=horsA2L fam=- ax=0x1D04B8 ay=0x1CD450 */ /* STUB unknown size; axis_x=0x1D04B8 axis_y=0x1CD450 */
/begin CHARACTERISTIC map_horsA2L_1CD450_1CD450 "low: 8000/A000 fill - pas une grille Nm lisible (ex. 1C4994); identique 64o vs 9" VALUE 0x1CD450 RL_IDENTITY 0 NO_INPUT_QUANTITY 1.0 /end CHARACTERISTIC
/* src=families fam=D_fam_0003 ax=0x- ay=0x- */
/begin CHARACTERISTIC D_fam_0003_1CD550 "RE map_interp_D D_fam_0003 call=0x80097596" VALUE 0x1CD550 RL_IDENTITY 0 NO_INPUT_QUANTITY 1.0 /end CHARACTERISTIC
/* src=families fam=D_fam_0002 ax=0x- ay=0x- */
/begin CHARACTERISTIC D_fam_0002_1CD5C8 "RE map_interp_D D_fam_0002 call=0x80097490" VALUE 0x1CD5C8 RL_IDENTITY 0 NO_INPUT_QUANTITY 1.0 /end CHARACTERISTIC
/* src=families fam=G_fam_0098 ax=0x- ay=0x- */
/begin CHARACTERISTIC G_fam_0098_1CD664 "RE map_interp_G G_fam_0098 call=0x80093BA6" VALUE 0x1CD664 RL_IDENTITY 0 NO_INPUT_QUANTITY 1.0 /end CHARACTERISTIC
/* src=families fam=G_fam_0118 ax=0x- ay=0x- */
/begin CHARACTERISTIC G_fam_0118_1CD6D8 "RE map_interp_G G_fam_0118 call=0x800BB798" VALUE 0x1CD6D8 RL_IDENTITY 0 NO_INPUT_QUANTITY 1.0 /end CHARACTERISTIC
/* src=families fam=I_fam_0087 ax=0x- ay=0x- */
/begin CHARACTERISTIC I_fam_0087_1CD7BC "RE map_interp_I I_fam_0087 call=0x80093C58" VALUE 0x1CD7BC RL_IDENTITY 0 NO_INPUT_QUANTITY 1.0 /end CHARACTERISTIC
/* src=families fam=fam_0095 ax=0x1A7710 ay=0x19D6D4 */
/begin CHARACTERISTIC map_horsA2L_1CD900 "RE interp_2d fam_0095 call=0x80096066" MAP 0x1CD900 RL_IDENTITY 0 NO_INPUT_QUANTITY 1.0 FORMAT "%%5.0"
 /begin AXIS_DESCR COM_AXIS NO_INPUT_QUANTITY NO_COMPU_METHOD 2 AXIS_PTS_REF AX_1A7710 /end AXIS_DESCR
 /begin AXIS_DESCR COM_AXIS NO_INPUT_QUANTITY NO_COMPU_METHOD 2 AXIS_PTS_REF AX_19D6D4 /end AXIS_DESCR
/end CHARACTERISTIC
/* src=families fam=M_fam_0012 ax=0x1A06C8 ay=0x- */ /* STUB unknown size; axis_x=0x1A06C8 axis_y=0x- */
/begin CHARACTERISTIC M_fam_0012_1CD94C "RE map_interp_M M_fam_0012 call=0x80118D16" VALUE 0x1CD94C RL_IDENTITY 0 NO_INPUT_QUANTITY 1.0 /end CHARACTERISTIC
/* src=families fam=C_fam_0236 ax=0x1A2490 ay=0x- */ /* STUB unknown size; axis_x=0x1A2490 axis_y=0x- */
/begin CHARACTERISTIC C_fam_0236_1CD9BC "RE map_interp_C C_fam_0236 call=0x800AF0DC" VALUE 0x1CD9BC RL_IDENTITY 0 NO_INPUT_QUANTITY 1.0 /end CHARACTERISTIC
/* src=families fam=I_fam_0002 ax=0x1A2734 ay=0x1AD8D0 */
/begin CHARACTERISTIC I_fam_0002_1CD9EC "RE map_interp_I I_fam_0002 call=0x80074F06" MAP 0x1CD9EC RL_IDENTITY 0 NO_INPUT_QUANTITY 1.0 FORMAT "%%5.0"
 /begin AXIS_DESCR COM_AXIS NO_INPUT_QUANTITY NO_COMPU_METHOD 2 AXIS_PTS_REF AX_1A2734 /end AXIS_DESCR
 /begin AXIS_DESCR COM_AXIS NO_INPUT_QUANTITY NO_COMPU_METHOD 2 AXIS_PTS_REF AX_1AD8D0 /end AXIS_DESCR
/end CHARACTERISTIC
/begin CHARACTERISTIC C_fam_0010_1CD9F8 "RE map_interp_C C_fam_0010 call=0x8009596C" VALUE 0x1CD9F8 RL_IDENTITY 0 NO_INPUT_QUANTITY 1.0 /end CHARACTERISTIC
/* src=families fam=C_fam_0251 ax=0x1A647C ay=0x- */ /* STUB unknown size; axis_x=0x1A647C axis_y=0x- */
/begin CHARACTERISTIC C_fam_0251_1CDA00 "RE map_interp_C C_fam_0251 call=0x800A1432" VALUE 0x1CDA00 RL_IDENTITY 0 NO_INPUT_QUANTITY 1.0 /end CHARACTERISTIC
/* src=families fam=E_fam_0127 ax=0x- ay=0x- */
/begin CHARACTERISTIC E_fam_0127_1CDA14 "RE map_interp_E E_fam_0127 call=0x80119F6E" VALUE 0x1CDA14 RL_IDENTITY 0 NO_INPUT_QUANTITY 1.0 /end CHARACTERISTIC
/* src=families fam=O_fam_0010 ax=0x- ay=0x- */
/begin CHARACTERISTIC O_fam_0010_1CDA20 "RE map_interp_O O_fam_0010 call=0x80116DCA" VALUE 0x1CDA20 RL_IDENTITY 0 NO_INPUT_QUANTITY 1.0 /end CHARACTERISTIC
/* src=families fam=F_fam_0009 ax=0x1A8864 ay=0x1AC87C */
/begin CHARACTERISTIC F_fam_0009_1CDAE4 "RE map_interp_F F_fam_0009 call=0x800EC21E" MAP 0x1CDAE4 RL_IDENTITY 0 NO_INPUT_QUANTITY 1.0 FORMAT "%%5.0"
 /begin AXIS_DESCR COM_AXIS NO_INPUT_QUANTITY NO_COMPU_METHOD 2 AXIS_PTS_REF AX_1A8864 /end AXIS_DESCR
 /begin AXIS_DESCR COM_AXIS NO_INPUT_QUANTITY NO_COMPU_METHOD 2 AXIS_PTS_REF AX_1AC87C /end AXIS_DESCR
/end CHARACTERISTIC
/* src=atlas9979 fam=- ax=0x1A8FBE ay=0x1A8692 */
/begin CHARACTERISTIC duration_inj6A "atlas9979 duration_inj6A / Injection duration (IdName Caddy 9979 - verifier sur " MAP 0x1CDC84 RL_IDENTITY 0 NO_INPUT_QUANTITY 1.0 FORMAT "%%5.0"
 /begin AXIS_DESCR COM_AXIS NO_INPUT_QUANTITY NO_COMPU_METHOD 18 AXIS_PTS_REF AX_1A8FBE /end AXIS_DESCR
 /begin AXIS_DESCR COM_AXIS NO_INPUT_QUANTITY NO_COMPU_METHOD 24 AXIS_PTS_REF AX_1A8692 /end AXIS_DESCR
/end CHARACTERISTIC
/begin CHARACTERISTIC C_fam_0010_1CDE44 "RE map_interp_C C_fam_0010 call=0x800959B6" VALUE 0x1CDE44 RL_IDENTITY 0 NO_INPUT_QUANTITY 1.0 /end CHARACTERISTIC
/* src=families fam=C_fam_0247 ax=0x1A3674 ay=0x- */ /* STUB unknown size; axis_x=0x1A3674 axis_y=0x- */
/begin CHARACTERISTIC C_fam_0247_1CDE50 "RE map_interp_C C_fam_0247 call=0x8008B652" VALUE 0x1CDE50 RL_IDENTITY 0 NO_INPUT_QUANTITY 1.0 /end CHARACTERISTIC
/* src=families fam=F_fam_0041 ax=0x1A163C ay=0x1A57F0 */
/begin CHARACTERISTIC F_fam_0041_1CDE5C "RE map_interp_F F_fam_0041 call=0x8007E3D0" MAP 0x1CDE5C RL_IDENTITY 0 NO_INPUT_QUANTITY 1.0 FORMAT "%%5.0"
 /begin AXIS_DESCR COM_AXIS NO_INPUT_QUANTITY NO_COMPU_METHOD 5 AXIS_PTS_REF AX_1A163C /end AXIS_DESCR
 /begin AXIS_DESCR COM_AXIS NO_INPUT_QUANTITY NO_COMPU_METHOD 2 AXIS_PTS_REF AX_1A57F0 /end AXIS_DESCR
/end CHARACTERISTIC
/* src=families fam=B_fam_0006 ax=0x1AA840 ay=0x1AD8DC */
/begin CHARACTERISTIC B_fam_0006_1CDE8C "RE interp_2d_B B_fam_0006 call=0x800D6784; RE map_interp_C C_fam_0030 call=0x800" MAP 0x1CDE8C RL_IDENTITY 0 NO_INPUT_QUANTITY 1.0 FORMAT "%%5.0"
 /begin AXIS_DESCR COM_AXIS NO_INPUT_QUANTITY NO_COMPU_METHOD 2 AXIS_PTS_REF AX_1AA840 /end AXIS_DESCR
 /begin AXIS_DESCR COM_AXIS NO_INPUT_QUANTITY NO_COMPU_METHOD 2 AXIS_PTS_REF AX_1AD8DC /end AXIS_DESCR
/end CHARACTERISTIC
/* src=families fam=I_fam_0041 ax=0x1B491C ay=0x1B1B04 */
/begin CHARACTERISTIC I_fam_0041_1CDF60 "RE map_interp_I I_fam_0041 call=0x800F8D96" MAP 0x1CDF60 RL_IDENTITY 0 NO_INPUT_QUANTITY 1.0 FORMAT "%%5.0"
 /begin AXIS_DESCR COM_AXIS NO_INPUT_QUANTITY NO_COMPU_METHOD 2 AXIS_PTS_REF AX_1B491C /end AXIS_DESCR
 /begin AXIS_DESCR COM_AXIS NO_INPUT_QUANTITY NO_COMPU_METHOD 2 AXIS_PTS_REF AX_1B1B04 /end AXIS_DESCR
/end CHARACTERISTIC
/* src=atlas9979 fam=- ax=0x1A8FBE ay=0x1A8692 */
/begin CHARACTERISTIC duration_inj6A_1CDFE4 "atlas9979 duration_inj6A@1CDFE4 / Injection duration (IdName Caddy 9979 - verifi" MAP 0x1CDFE4 RL_IDENTITY 0 NO_INPUT_QUANTITY 1.0 FORMAT "%%5.0"
 /begin AXIS_DESCR COM_AXIS NO_INPUT_QUANTITY NO_COMPU_METHOD 18 AXIS_PTS_REF AX_1A8FBE /end AXIS_DESCR
 /begin AXIS_DESCR COM_AXIS NO_INPUT_QUANTITY NO_COMPU_METHOD 24 AXIS_PTS_REF AX_1A8692 /end AXIS_DESCR
/end CHARACTERISTIC
/* src=families fam=B_fam_0008 ax=0x1A6614 ay=0x- */ /* STUB unknown size; axis_x=0x1A6614 axis_y=0x- */
/begin CHARACTERISTIC B_fam_0008_1CE29C "RE interp_2d_B B_fam_0008 call=0x80087B26" VALUE 0x1CE29C RL_IDENTITY 0 NO_INPUT_QUANTITY 1.0 /end CHARACTERISTIC
/* src=families fam=B_fam_0002 ax=0x1A88FC ay=0x1A8934 */
/begin CHARACTERISTIC B_fam_0002_1CE2CC "RE interp_2d_B B_fam_0002 call=0x800954AA" MAP 0x1CE2CC RL_IDENTITY 0 NO_INPUT_QUANTITY 1.0 FORMAT "%%5.0"
 /begin AXIS_DESCR COM_AXIS NO_INPUT_QUANTITY NO_COMPU_METHOD 2 AXIS_PTS_REF AX_1A88FC /end AXIS_DESCR
 /begin AXIS_DESCR COM_AXIS NO_INPUT_QUANTITY NO_COMPU_METHOD 2 AXIS_PTS_REF AX_1A8934 /end AXIS_DESCR
/end CHARACTERISTIC
/* src=families fam=M_fam_0004 ax=0x1AE94C ay=0x1B292C */
/begin CHARACTERISTIC M_fam_0004_1CE368 "RE map_interp_M M_fam_0004 call=0x800CC88C" MAP 0x1CE368 RL_IDENTITY 0 NO_INPUT_QUANTITY 1.0 FORMAT "%%5.0"
 /begin AXIS_DESCR COM_AXIS NO_INPUT_QUANTITY NO_COMPU_METHOD 2 AXIS_PTS_REF AX_1AE94C /end AXIS_DESCR
 /begin AXIS_DESCR COM_AXIS NO_INPUT_QUANTITY NO_COMPU_METHOD 2 AXIS_PTS_REF AX_1B292C /end AXIS_DESCR
/end CHARACTERISTIC
/* src=families fam=fam_0043 ax=0x1A4670 ay=0x1A4664 */
/begin CHARACTERISTIC map_horsA2L_1CE3BC "RE interp_2d fam_0043 call=0x800AEEA4" MAP 0x1CE3BC RL_IDENTITY 0 NO_INPUT_QUANTITY 1.0 FORMAT "%%5.0"
 /begin AXIS_DESCR COM_AXIS NO_INPUT_QUANTITY NO_COMPU_METHOD 6 AXIS_PTS_REF AX_1A4670 /end AXIS_DESCR
 /begin AXIS_DESCR COM_AXIS NO_INPUT_QUANTITY NO_COMPU_METHOD 2 AXIS_PTS_REF AX_1A4664 /end AXIS_DESCR
/end CHARACTERISTIC
/begin CHARACTERISTIC map_horsA2L_1D741C "RE interp_2d fam_0008 call=0x8010668C" VALUE 0x1CE404 RL_IDENTITY 0 NO_INPUT_QUANTITY 1.0 /end CHARACTERISTIC
/* src=horsA2L fam=- ax=0x- ay=0x1CE440 */ /* STUB unknown size; axis_x=0x- axis_y=0x1CE440 */
/begin CHARACTERISTIC map_horsA2L_1CE440 "low: pas dans l A2L/atlas 9979 (299 maps WinOLS) - nommer a la main si besoin; i" VALUE 0x1CE440 RL_IDENTITY 0 NO_INPUT_QUANTITY 1.0 /end CHARACTERISTIC
/* src=horsA2L fam=- ax=0x1D34A0 ay=0x1CE450 */ /* STUB unknown size; axis_x=0x1D34A0 axis_y=0x1CE450 */
/begin CHARACTERISTIC map_horsA2L_1CE450_1CE450 "low: pas dans l A2L/atlas 9979 (299 maps WinOLS) - nommer a la main si besoin; i" VALUE 0x1CE450 RL_IDENTITY 0 NO_INPUT_QUANTITY 1.0 /end CHARACTERISTIC
/* src=horsA2L fam=- ax=0x1D34B4 ay=0x1CE464 */ /* STUB unknown size; axis_x=0x1D34B4 axis_y=0x1CE464 */
/begin CHARACTERISTIC map_horsA2L_1CE464_1CE464 "low: pas dans l A2L/atlas 9979 (299 maps WinOLS) - nommer a la main si besoin; i" VALUE 0x1CE464 RL_IDENTITY 0 NO_INPUT_QUANTITY 1.0 /end CHARACTERISTIC
/* src=horsA2L fam=- ax=0x1CD470 ay=0x1CE478 */ /* STUB unknown size; axis_x=0x1CD470 axis_y=0x1CE478 */
/begin CHARACTERISTIC map_horsA2L_1CE478 "low: pas dans l A2L/atlas 9979 (299 maps WinOLS) - nommer a la main si besoin; i" VALUE 0x1CE478 RL_IDENTITY 0 NO_INPUT_QUANTITY 1.0 /end CHARACTERISTIC
/* src=families fam=D_fam_0233 ax=0x- ay=0x- */
/begin CHARACTERISTIC D_fam_0233_1CE4D8 "RE map_interp_D D_fam_0233 call=0x80110DCE; RE map_interp_I I_fam_0122 call=0x80" VALUE 0x1CE4D8 RL_IDENTITY 0 NO_INPUT_QUANTITY 1.0 /end CHARACTERISTIC
/* src=families fam=H_fam_0088 ax=0x- ay=0x- */
/begin CHARACTERISTIC H_fam_0088_1CE724 "RE map_interp_H H_fam_0088 call=0x8009921A" VALUE 0x1CE724 RL_IDENTITY 0 NO_INPUT_QUANTITY 1.0 /end CHARACTERISTIC
/* src=families fam=F_fam_0014 ax=0x1AC908 ay=0x1A9C38 */
/begin CHARACTERISTIC F_fam_0014_1CE85C "RE map_interp_F F_fam_0014 call=0x80074018" MAP 0x1CE85C RL_IDENTITY 0 NO_INPUT_QUANTITY 1.0 FORMAT "%%5.0"
 /begin AXIS_DESCR COM_AXIS NO_INPUT_QUANTITY NO_COMPU_METHOD 2 AXIS_PTS_REF AX_1AC908 /end AXIS_DESCR
 /begin AXIS_DESCR COM_AXIS NO_INPUT_QUANTITY NO_COMPU_METHOD 2 AXIS_PTS_REF AX_1A9C38 /end AXIS_DESCR
/end CHARACTERISTIC
/* src=families fam=F_fam_0015 ax=0x1AC940 ay=0x1AC85C */
/begin CHARACTERISTIC F_fam_0015_1CE97C "RE map_interp_F F_fam_0015 call=0x800AF186" MAP 0x1CE97C RL_IDENTITY 0 NO_INPUT_QUANTITY 1.0 FORMAT "%%5.0"
 /begin AXIS_DESCR COM_AXIS NO_INPUT_QUANTITY NO_COMPU_METHOD 2 AXIS_PTS_REF AX_1AC940 /end AXIS_DESCR
 /begin AXIS_DESCR COM_AXIS NO_INPUT_QUANTITY NO_COMPU_METHOD 2 AXIS_PTS_REF AX_1AC85C /end AXIS_DESCR
/end CHARACTERISTIC
/* src=families fam=C_fam_0213 ax=0x- ay=0x- */
/begin CHARACTERISTIC C_fam_0213_1CE988 "RE map_interp_C C_fam_0213 call=0x8009E512" VALUE 0x1CE988 RL_IDENTITY 0 NO_INPUT_QUANTITY 1.0 /end CHARACTERISTIC
/* src=families fam=F_fam_0042 ax=0x1A165C ay=0x1A77D0 */
/begin CHARACTERISTIC F_fam_0042_1CE994 "RE map_interp_F F_fam_0042 call=0x800866FA" MAP 0x1CE994 RL_IDENTITY 0 NO_INPUT_QUANTITY 1.0 FORMAT "%%5.0"
 /begin AXIS_DESCR COM_AXIS NO_INPUT_QUANTITY NO_COMPU_METHOD 2 AXIS_PTS_REF AX_1A165C /end AXIS_DESCR
 /begin AXIS_DESCR COM_AXIS NO_INPUT_QUANTITY NO_COMPU_METHOD 2 AXIS_PTS_REF AX_1A77D0 /end AXIS_DESCR
/end CHARACTERISTIC
/* src=families fam=E_fam_0060 ax=0x- ay=0x- */
/begin CHARACTERISTIC E_fam_0060_1CE9C4 "RE map_interp_E E_fam_0060 call=0x8010ED1A" VALUE 0x1CE9C4 RL_IDENTITY 0 NO_INPUT_QUANTITY 1.0 /end CHARACTERISTIC
/* src=families fam=C_fam_0317 ax=0x- ay=0x- */
/begin CHARACTERISTIC C_fam_0317_1CE9D4 "RE map_interp_C C_fam_0317 call=0x800E97D2" VALUE 0x1CE9D4 RL_IDENTITY 0 NO_INPUT_QUANTITY 1.0 /end CHARACTERISTIC
/* src=families fam=fam_0181 ax=0x19D5F0 ay=0x19D748 */
/begin CHARACTERISTIC map_horsA2L_1CE9E0 "RE interp_2d fam_0181 call=0x801127AE" MAP 0x1CE9E0 RL_IDENTITY 0 NO_INPUT_QUANTITY 1.0 FORMAT "%%5.0"
 /begin AXIS_DESCR COM_AXIS NO_INPUT_QUANTITY NO_COMPU_METHOD 2 AXIS_PTS_REF AX_19D5F0 /end AXIS_DESCR
 /begin AXIS_DESCR COM_AXIS NO_INPUT_QUANTITY NO_COMPU_METHOD 2 AXIS_PTS_REF AX_19D748 /end AXIS_DESCR
/end CHARACTERISTIC
/* src=families fam=M_fam_0009 ax=0x- ay=0x1A04D0 */ /* STUB unknown size; axis_x=0x- axis_y=0x1A04D0 */
/begin CHARACTERISTIC M_fam_0009_1CEA28 "RE map_interp_M M_fam_0009 call=0x80116C40" VALUE 0x1CEA28 RL_IDENTITY 0 NO_INPUT_QUANTITY 1.0 /end CHARACTERISTIC
/* src=families fam=E_fam_0126 ax=0x- ay=0x- */
/begin CHARACTERISTIC E_fam_0126_1CEA84 "RE map_interp_E E_fam_0126 call=0x80119C16" VALUE 0x1CEA84 RL_IDENTITY 0 NO_INPUT_QUANTITY 1.0 /end CHARACTERISTIC
/* src=families fam=E_fam_0125 ax=0x- ay=0x- */
/begin CHARACTERISTIC E_fam_0125_1CEAA4 "RE map_interp_E E_fam_0125 call=0x801197F8" VALUE 0x1CEAA4 RL_IDENTITY 0 NO_INPUT_QUANTITY 1.0 /end CHARACTERISTIC
/* src=families fam=fam_0086 ax=0x1B675C ay=0x1AD8D0 */
/begin CHARACTERISTIC map_horsA2L_1CEE20 "RE interp_2d fam_0086 call=0x80074E9C" MAP 0x1CEE20 RL_IDENTITY 0 NO_INPUT_QUANTITY 1.0 FORMAT "%%5.0"
 /begin AXIS_DESCR COM_AXIS NO_INPUT_QUANTITY NO_COMPU_METHOD 2 AXIS_PTS_REF AX_1B675C /end AXIS_DESCR
 /begin AXIS_DESCR COM_AXIS NO_INPUT_QUANTITY NO_COMPU_METHOD 2 AXIS_PTS_REF AX_1AD8D0 /end AXIS_DESCR
/end CHARACTERISTIC
/* src=families fam=C_fam_0122 ax=0x1B594C ay=0x1BBAD8 */
/begin CHARACTERISTIC C_fam_0122_1CEE94 "RE map_interp_C C_fam_0122 call=0x80082022; RE map_interp_F F_fam_0018 call=0x80" MAP 0x1CEE94 RL_IDENTITY 0 NO_INPUT_QUANTITY 1.0 FORMAT "%%5.0"
 /begin AXIS_DESCR COM_AXIS NO_INPUT_QUANTITY NO_COMPU_METHOD 2 AXIS_PTS_REF AX_1B594C /end AXIS_DESCR
 /begin AXIS_DESCR COM_AXIS NO_INPUT_QUANTITY NO_COMPU_METHOD 2 AXIS_PTS_REF AX_1BBAD8 /end AXIS_DESCR
/end CHARACTERISTIC
/* src=atlas9979 fam=- ax=0x180CDB ay=0x1A60CE */
/begin CHARACTERISTIC tqlim_speed2A "atlas9979 tqlim_speed2A / Torque limiter by vehicle speed (IdName Caddy 9979 - v" MAP 0x1CEED4 RL_IDENTITY 0 NO_INPUT_QUANTITY 1.0 FORMAT "%%5.0"
 /begin AXIS_DESCR COM_AXIS NO_INPUT_QUANTITY NO_COMPU_METHOD 6 AXIS_PTS_REF AX_180CDB /end AXIS_DESCR
 /begin AXIS_DESCR COM_AXIS NO_INPUT_QUANTITY NO_COMPU_METHOD 8 AXIS_PTS_REF AX_1A60CE /end AXIS_DESCR
/end CHARACTERISTIC
/* src=families fam=F_fam_0007 ax=0x1A565C ay=0x1A6660 */
/begin CHARACTERISTIC F_fam_0007_1CF39C "RE map_interp_F F_fam_0007 call=0x800ADBF4" MAP 0x1CF39C RL_IDENTITY 0 NO_INPUT_QUANTITY 1.0 FORMAT "%%5.0"
 /begin AXIS_DESCR COM_AXIS NO_INPUT_QUANTITY NO_COMPU_METHOD 2 AXIS_PTS_REF AX_1A565C /end AXIS_DESCR
 /begin AXIS_DESCR COM_AXIS NO_INPUT_QUANTITY NO_COMPU_METHOD 2 AXIS_PTS_REF AX_1A6660 /end AXIS_DESCR
/end CHARACTERISTIC
/* src=families fam=K_fam_0089 ax=0x- ay=0x- */
/begin CHARACTERISTIC K_fam_0089_1CF468 "RE map_interp_K K_fam_0089 call=0x80106320" VALUE 0x1CF468 RL_IDENTITY 0 NO_INPUT_QUANTITY 1.0 /end CHARACTERISTIC
/* src=families fam=K_fam_0090 ax=0x- ay=0x- */
/begin CHARACTERISTIC K_fam_0090_1CF474 "RE map_interp_K K_fam_0090 call=0x8010BD48" VALUE 0x1CF474 RL_IDENTITY 0 NO_INPUT_QUANTITY 1.0 /end CHARACTERISTIC
/* src=families fam=D_fam_0003 ax=0x- ay=0x- */
/begin CHARACTERISTIC D_fam_0003_1CF5C0 "RE map_interp_D D_fam_0003 call=0x80097532" VALUE 0x1CF5C0 RL_IDENTITY 0 NO_INPUT_QUANTITY 1.0 /end CHARACTERISTIC
/* src=families fam=K_fam_0053 ax=0x- ay=0x- */
/begin CHARACTERISTIC K_fam_0053_1CF60C "RE map_interp_K K_fam_0053 call=0x80093C42" VALUE 0x1CF60C RL_IDENTITY 0 NO_INPUT_QUANTITY 1.0 /end CHARACTERISTIC
/* src=families fam=H_fam_0070 ax=0x- ay=0x- */
/begin CHARACTERISTIC H_fam_0070_1CF6C8 "RE map_interp_H H_fam_0070 call=0x80098FDC" VALUE 0x1CF6C8 RL_IDENTITY 0 NO_INPUT_QUANTITY 1.0 /end CHARACTERISTIC
/* src=families fam=H_fam_0071 ax=0x- ay=0x- */
/begin CHARACTERISTIC H_fam_0071_1CF6EE "RE map_interp_H H_fam_0071 call=0x80098FEA" VALUE 0x1CF6EE RL_IDENTITY 0 NO_INPUT_QUANTITY 1.0 /end CHARACTERISTIC
/* src=families fam=E_fam_0051 ax=0x1A56AC ay=0x- */ /* STUB unknown size; axis_x=0x1A56AC axis_y=0x- */
/begin CHARACTERISTIC E_fam_0051_1CF818 "RE map_interp_E E_fam_0051 call=0x801064B8" VALUE 0x1CF818 RL_IDENTITY 0 NO_INPUT_QUANTITY 1.0 /end CHARACTERISTIC
/* src=families fam=E_fam_0031 ax=0x1A470C ay=0x- */ /* STUB unknown size; axis_x=0x1A470C axis_y=0x- */
/begin CHARACTERISTIC E_fam_0031_1CF838 "RE map_interp_E E_fam_0031 call=0x8013FAC2" VALUE 0x1CF838 RL_IDENTITY 0 NO_INPUT_QUANTITY 1.0 /end CHARACTERISTIC
/* src=families fam=C_fam_0043 ax=0x- ay=0x- */
/begin CHARACTERISTIC C_fam_0043_1CF900 "RE map_interp_C C_fam_0043 call=0x800F1BEE" VALUE 0x1CF900 RL_IDENTITY 0 NO_INPUT_QUANTITY 1.0 /end CHARACTERISTIC
/* src=families fam=C_fam_0257 ax=0x- ay=0x- */
/begin CHARACTERISTIC C_fam_0257_1CF90C "RE map_interp_C C_fam_0257 call=0x800F1CF6" VALUE 0x1CF90C RL_IDENTITY 0 NO_INPUT_QUANTITY 1.0 /end CHARACTERISTIC
/* src=families fam=fam_0168 ax=0x19C5DC ay=0x19C778 */
/begin CHARACTERISTIC map_horsA2L_1CF918 "RE interp_2d fam_0168 call=0x800F2134" MAP 0x1CF918 RL_IDENTITY 0 NO_INPUT_QUANTITY 1.0 FORMAT "%%5.0"
 /begin AXIS_DESCR COM_AXIS NO_INPUT_QUANTITY NO_COMPU_METHOD 2 AXIS_PTS_REF AX_19C5DC /end AXIS_DESCR
 /begin AXIS_DESCR COM_AXIS NO_INPUT_QUANTITY NO_COMPU_METHOD 2 AXIS_PTS_REF AX_19C778 /end AXIS_DESCR
/end CHARACTERISTIC
/* src=families fam=N_fam_0013 ax=0x1A54C0 ay=0x- */ /* STUB unknown size; axis_x=0x1A54C0 axis_y=0x- */
/begin CHARACTERISTIC N_fam_0013_1CF99C "RE map_interp_N N_fam_0013 call=0x800D0DE4" VALUE 0x1CF99C RL_IDENTITY 0 NO_INPUT_QUANTITY 1.0 /end CHARACTERISTIC
/* src=atlas9979 fam=- ax=0x1A90C2 ay=0x1A8EA6 */
/begin CHARACTERISTIC AccPed_trq4A "atlas9979 AccPed_trq4A / Drivers wish torque (IdName Caddy 9979 - verifier sur 9" MAP 0x1CF9C0 RL_IDENTITY 0 NO_INPUT_QUANTITY 1.0 FORMAT "%%5.0"
 /begin AXIS_DESCR COM_AXIS NO_INPUT_QUANTITY NO_COMPU_METHOD 8 AXIS_PTS_REF AX_1A90C2 /end AXIS_DESCR
 /begin AXIS_DESCR COM_AXIS NO_INPUT_QUANTITY NO_COMPU_METHOD 16 AXIS_PTS_REF AX_1A8EA6 /end AXIS_DESCR
/end CHARACTERISTIC
/* src=families fam=C_fam_0140 ax=0x1A46C0 ay=0x- */ /* STUB unknown size; axis_x=0x1A46C0 axis_y=0x- */
/begin CHARACTERISTIC C_fam_0140_1CFA30 "RE map_interp_C C_fam_0140 call=0x80116CAE" VALUE 0x1CFA30 RL_IDENTITY 0 NO_INPUT_QUANTITY 1.0 /end CHARACTERISTIC
/* src=families fam=E_fam_0080 ax=0x1A04D0 ay=0x- */ /* STUB unknown size; axis_x=0x1A04D0 axis_y=0x- */
/begin CHARACTERISTIC E_fam_0080_1CFA3C "RE map_interp_E E_fam_0080 call=0x80116C8E; RE map_interp_O O_fam_0012 call=0x80" VALUE 0x1CFA3C RL_IDENTITY 0 NO_INPUT_QUANTITY 1.0 /end CHARACTERISTIC
/* src=families fam=C_fam_0023 ax=0x1AD940 ay=0x1AC970 */
/begin CHARACTERISTIC C_fam_0023_1CFA84 "RE map_interp_C C_fam_0023 call=0x80119DB6" MAP 0x1CFA84 RL_IDENTITY 0 NO_INPUT_QUANTITY 1.0 FORMAT "%%5.0"
 /begin AXIS_DESCR COM_AXIS NO_INPUT_QUANTITY NO_COMPU_METHOD 2 AXIS_PTS_REF AX_1AD940 /end AXIS_DESCR
 /begin AXIS_DESCR COM_AXIS NO_INPUT_QUANTITY NO_COMPU_METHOD 2 AXIS_PTS_REF AX_1AC970 /end AXIS_DESCR
/end CHARACTERISTIC
/* src=families fam=C_fam_0023 ax=0x1AD940 ay=0x1AC970 */
/begin CHARACTERISTIC C_fam_0023_1CFAA8 "RE map_interp_C C_fam_0023 call=0x8011999C" MAP 0x1CFAA8 RL_IDENTITY 0 NO_INPUT_QUANTITY 1.0 FORMAT "%%5.0"
 /begin AXIS_DESCR COM_AXIS NO_INPUT_QUANTITY NO_COMPU_METHOD 2 AXIS_PTS_REF AX_1AD940 /end AXIS_DESCR
 /begin AXIS_DESCR COM_AXIS NO_INPUT_QUANTITY NO_COMPU_METHOD 2 AXIS_PTS_REF AX_1AC970 /end AXIS_DESCR
/end CHARACTERISTIC
/begin CHARACTERISTIC AccPed_trq4A_1CFAC0 "atlas9979 AccPed_trq4A@1CFAC0 / Drivers wish torque (IdName Caddy 9979 - verifie" MAP 0x1CFAC0 RL_IDENTITY 0 NO_INPUT_QUANTITY 1.0 FORMAT "%%5.0"
 /begin AXIS_DESCR COM_AXIS NO_INPUT_QUANTITY NO_COMPU_METHOD 8 AXIS_PTS_REF AX_1A90C2 /end AXIS_DESCR
 /begin AXIS_DESCR COM_AXIS NO_INPUT_QUANTITY NO_COMPU_METHOD 16 AXIS_PTS_REF AX_1A8752 /end AXIS_DESCR
/end CHARACTERISTIC
/* src=families fam=F_fam_0009 ax=0x1A8864 ay=0x1AC87C */
/begin CHARACTERISTIC F_fam_0009_1CFAE4 "RE map_interp_F F_fam_0009 call=0x800EC250" MAP 0x1CFAE4 RL_IDENTITY 0 NO_INPUT_QUANTITY 1.0 FORMAT "%%5.0"
 /begin AXIS_DESCR COM_AXIS NO_INPUT_QUANTITY NO_COMPU_METHOD 2 AXIS_PTS_REF AX_1A8864 /end AXIS_DESCR
 /begin AXIS_DESCR COM_AXIS NO_INPUT_QUANTITY NO_COMPU_METHOD 2 AXIS_PTS_REF AX_1AC87C /end AXIS_DESCR
/end CHARACTERISTIC
/begin CHARACTERISTIC AccPed_trq4A_1CFBC0 "atlas9979 AccPed_trq4A@1CFBC0 / Drivers wish torque (IdName Caddy 9979 - verifie" MAP 0x1CFBC0 RL_IDENTITY 0 NO_INPUT_QUANTITY 1.0 FORMAT "%%5.0"
 /begin AXIS_DESCR COM_AXIS NO_INPUT_QUANTITY NO_COMPU_METHOD 8 AXIS_PTS_REF AX_1A90C2 /end AXIS_DESCR
 /begin AXIS_DESCR COM_AXIS NO_INPUT_QUANTITY NO_COMPU_METHOD 16 AXIS_PTS_REF AX_1A8752 /end AXIS_DESCR
/end CHARACTERISTIC
/begin CHARACTERISTIC AccPed_trq4A_1CFCC0 "atlas9979 AccPed_trq4A@1CFCC0 / Drivers wish torque (IdName Caddy 9979 - verifie" MAP 0x1CFCC0 RL_IDENTITY 0 NO_INPUT_QUANTITY 1.0 FORMAT "%%5.0"
 /begin AXIS_DESCR COM_AXIS NO_INPUT_QUANTITY NO_COMPU_METHOD 8 AXIS_PTS_REF AX_1A90C2 /end AXIS_DESCR
 /begin AXIS_DESCR COM_AXIS NO_INPUT_QUANTITY NO_COMPU_METHOD 16 AXIS_PTS_REF AX_1A8752 /end AXIS_DESCR
/end CHARACTERISTIC
/* src=families fam=D_fam_0067 ax=0x1A0610 ay=0x- */
/begin CHARACTERISTIC D_fam_0067_1CFCE4 "RE map_interp_D D_fam_0067 call=0x800E2DFC; RE map_interp_F F_fam_0168 call=0x80" VALUE 0x1CFCE4 RL_IDENTITY 0 NO_INPUT_QUANTITY 1.0 /end CHARACTERISTIC
/* src=families fam=B_fam_0060 ax=0x- ay=0x- */
/begin CHARACTERISTIC B_fam_0060_1CFDA4 "RE interp_2d_B B_fam_0060 call=0x800E3236" VALUE 0x1CFDA4 RL_IDENTITY 0 NO_INPUT_QUANTITY 1.0 /end CHARACTERISTIC
/begin CHARACTERISTIC AccPed_trq4A_1CFDC0 "atlas9979 AccPed_trq4A@1CFDC0 / Drivers wish torque (IdName Caddy 9979 - verifie" MAP 0x1CFDC0 RL_IDENTITY 0 NO_INPUT_QUANTITY 1.0 FORMAT "%%5.0"
 /begin AXIS_DESCR COM_AXIS NO_INPUT_QUANTITY NO_COMPU_METHOD 8 AXIS_PTS_REF AX_1A90C2 /end AXIS_DESCR
 /begin AXIS_DESCR COM_AXIS NO_INPUT_QUANTITY NO_COMPU_METHOD 16 AXIS_PTS_REF AX_1A8752 /end AXIS_DESCR
/end CHARACTERISTIC
/* src=families fam=C_fam_0070 ax=0x1A3644 ay=0x1A066C */
/begin CHARACTERISTIC C_fam_0070_1CFE3C "RE map_interp_C C_fam_0070 call=0x8007D838" MAP 0x1CFE3C RL_IDENTITY 0 NO_INPUT_QUANTITY 1.0 FORMAT "%%5.0"
 /begin AXIS_DESCR COM_AXIS NO_INPUT_QUANTITY NO_COMPU_METHOD 2 AXIS_PTS_REF AX_1A3644 /end AXIS_DESCR
 /begin AXIS_DESCR COM_AXIS NO_INPUT_QUANTITY NO_COMPU_METHOD 2 AXIS_PTS_REF AX_1A066C /end AXIS_DESCR
/end CHARACTERISTIC
/* src=families fam=E_fam_0072 ax=0x- ay=0x- */
/begin CHARACTERISTIC E_fam_0072_1CFEB4 "RE map_interp_E E_fam_0072 call=0x80119B58" VALUE 0x1CFEB4 RL_IDENTITY 0 NO_INPUT_QUANTITY 1.0 /end CHARACTERISTIC
/begin CHARACTERISTIC AccPed_trq4A_1CFEC0 "atlas9979 AccPed_trq4A@1CFEC0 / Drivers wish torque (IdName Caddy 9979 - verifie" MAP 0x1CFEC0 RL_IDENTITY 0 NO_INPUT_QUANTITY 1.0 FORMAT "%%5.0"
 /begin AXIS_DESCR COM_AXIS NO_INPUT_QUANTITY NO_COMPU_METHOD 8 AXIS_PTS_REF AX_1A90C2 /end AXIS_DESCR
 /begin AXIS_DESCR COM_AXIS NO_INPUT_QUANTITY NO_COMPU_METHOD 16 AXIS_PTS_REF AX_1A8752 /end AXIS_DESCR
/end CHARACTERISTIC
/begin CHARACTERISTIC fam_0001_1CFF80 "RE interp_2d fam_0001 call=0x800CC5A8; AccPed-like 8x16 placeholder (APP_r/nmot " MAP 0x1CFF80 RL_IDENTITY 0 NO_INPUT_QUANTITY 1.0 FORMAT "%%5.0"
 /begin AXIS_DESCR COM_AXIS NO_INPUT_QUANTITY NO_COMPU_METHOD 8 AXIS_PTS_REF AX_1AA8E4 /end AXIS_DESCR
 /begin AXIS_DESCR COM_AXIS NO_INPUT_QUANTITY NO_COMPU_METHOD 16 AXIS_PTS_REF AX_1B3900 /end AXIS_DESCR
/end CHARACTERISTIC
/* src=atlas9979 fam=fam_0001 ax=0x1A90C2 ay=0x1A8EA6 */
/begin CHARACTERISTIC AccPed_trq4A_1CFFC0 "atlas9979 AccPed_trq4A@1CFFC0 / Drivers wish torque (IdName Caddy 9979 - verifie" MAP 0x1CFFC0 RL_IDENTITY 0 NO_INPUT_QUANTITY 1.0 FORMAT "%%5.0"
 /begin AXIS_DESCR COM_AXIS NO_INPUT_QUANTITY NO_COMPU_METHOD 8 AXIS_PTS_REF AX_1A90C2 /end AXIS_DESCR
 /begin AXIS_DESCR COM_AXIS NO_INPUT_QUANTITY NO_COMPU_METHOD 16 AXIS_PTS_REF AX_1A8EA6 /end AXIS_DESCR
/end CHARACTERISTIC
/begin CHARACTERISTIC airctl_hysteresisC "atlas9979 airctl_hysteresisC / EGR hysteresis (IdName Caddy 9979 - verifier sur " CURVE 0x1D0100 RL_IDENTITY 0 NO_INPUT_QUANTITY 1.0 FORMAT "%%5.0"
 /begin AXIS_DESCR COM_AXIS NO_INPUT_QUANTITY NO_COMPU_METHOD 16 AXIS_PTS_REF AX_1A8D76 /end AXIS_DESCR
/end CHARACTERISTIC
/begin CHARACTERISTIC airctl_hysteresisC_1D0120 "atlas9979 airctl_hysteresisC@1D0120 / EGR hysteresis (IdName Caddy 9979 - verifi" CURVE 0x1D0120 RL_IDENTITY 0 NO_INPUT_QUANTITY 1.0 FORMAT "%%5.0"
 /begin AXIS_DESCR COM_AXIS NO_INPUT_QUANTITY NO_COMPU_METHOD 16 AXIS_PTS_REF AX_1A8D76 /end AXIS_DESCR
/end CHARACTERISTIC
/begin CHARACTERISTIC airctl_hysteresisC_1D0160 "atlas9979 airctl_hysteresisC@1D0160 / EGR hysteresis (IdName Caddy 9979 - verifi" CURVE 0x1D0160 RL_IDENTITY 0 NO_INPUT_QUANTITY 1.0 FORMAT "%%5.0"
 /begin AXIS_DESCR COM_AXIS NO_INPUT_QUANTITY NO_COMPU_METHOD 16 AXIS_PTS_REF AX_1A8D76 /end AXIS_DESCR
/end CHARACTERISTIC
/begin CHARACTERISTIC airctl_hysteresisC_1D0180 "atlas9979 airctl_hysteresisC@1D0180 / EGR hysteresis (IdName Caddy 9979 - verifi" CURVE 0x1D0180 RL_IDENTITY 0 NO_INPUT_QUANTITY 1.0 FORMAT "%%5.0"
 /begin AXIS_DESCR COM_AXIS NO_INPUT_QUANTITY NO_COMPU_METHOD 16 AXIS_PTS_REF AX_1A8D76 /end AXIS_DESCR
/end CHARACTERISTIC
/* src=families fam=B_fam_0008 ax=0x- ay=0x- */
/begin CHARACTERISTIC B_fam_0008_1D02DC "RE interp_2d_B B_fam_0008 call=0x80087AC0" VALUE 0x1D02DC RL_IDENTITY 0 NO_INPUT_QUANTITY 1.0 /end CHARACTERISTIC
/* src=families fam=C_fam_0333 ax=0x- ay=0x- */
/begin CHARACTERISTIC C_fam_0333_1D04F4 "RE map_interp_C C_fam_0333 call=0x80105D1A" VALUE 0x1D04F4 RL_IDENTITY 0 NO_INPUT_QUANTITY 1.0 /end CHARACTERISTIC
/* src=families fam=F_fam_0198 ax=0x- ay=0x- */
/begin CHARACTERISTIC F_fam_0198_1D0528 "RE map_interp_F F_fam_0198 call=0x80106344" VALUE 0x1D0528 RL_IDENTITY 0 NO_INPUT_QUANTITY 1.0 /end CHARACTERISTIC
/* src=families fam=D_fam_0161 ax=0x- ay=0x- */
/begin CHARACTERISTIC D_fam_0161_1D0580 "RE map_interp_D D_fam_0161 call=0x80093A86" VALUE 0x1D0580 RL_IDENTITY 0 NO_INPUT_QUANTITY 1.0 /end CHARACTERISTIC
/* src=families fam=D_fam_0019 ax=0x- ay=0x- */
/begin CHARACTERISTIC D_fam_0019_1D0610 "RE map_interp_D D_fam_0019 call=0x800975CE" VALUE 0x1D0610 RL_IDENTITY 0 NO_INPUT_QUANTITY 1.0 /end CHARACTERISTIC
/* src=atlas9979 fam=- ax=0x1A90C2 ay=0x1A8EA6 */
/begin CHARACTERISTIC AccPed_trq4A_1D0640 "atlas9979 AccPed_trq4A@1D0640 / Drivers wish torque (IdName Caddy 9979 - verifie" MAP 0x1D0640 RL_IDENTITY 0 NO_INPUT_QUANTITY 1.0 FORMAT "%%5.0"
 /begin AXIS_DESCR COM_AXIS NO_INPUT_QUANTITY NO_COMPU_METHOD 8 AXIS_PTS_REF AX_1A90C2 /end AXIS_DESCR
 /begin AXIS_DESCR COM_AXIS NO_INPUT_QUANTITY NO_COMPU_METHOD 16 AXIS_PTS_REF AX_1A8EA6 /end AXIS_DESCR
/end CHARACTERISTIC
/* src=families fam=H_fam_0074 ax=0x- ay=0x- */
/begin CHARACTERISTIC H_fam_0074_1D0714 "RE map_interp_H H_fam_0074 call=0x8009901C" VALUE 0x1D0714 RL_IDENTITY 0 NO_INPUT_QUANTITY 1.0 /end CHARACTERISTIC
/* src=families fam=H_fam_0075 ax=0x- ay=0x- */
/begin CHARACTERISTIC H_fam_0075_1D073A "RE map_interp_H H_fam_0075 call=0x8009902A" VALUE 0x1D073A RL_IDENTITY 0 NO_INPUT_QUANTITY 1.0 /end CHARACTERISTIC
/* src=families fam=J_fam_0045 ax=0x- ay=0x- */
/begin CHARACTERISTIC J_fam_0045_1D0798 "RE map_interp_J J_fam_0045 call=0x8007928A" VALUE 0x1D0798 RL_IDENTITY 0 NO_INPUT_QUANTITY 1.0 /end CHARACTERISTIC
/* src=families fam=I_fam_0026 ax=0x- ay=0x- */
/begin CHARACTERISTIC I_fam_0026_1D07A4 "RE map_interp_I I_fam_0026 call=0x80097466" VALUE 0x1D07A4 RL_IDENTITY 0 NO_INPUT_QUANTITY 1.0 /end CHARACTERISTIC
/* src=families fam=E_fam_0091 ax=0x- ay=0x- */
/begin CHARACTERISTIC E_fam_0091_1D0804 "RE map_interp_E E_fam_0091 call=0x800823A6" VALUE 0x1D0804 RL_IDENTITY 0 NO_INPUT_QUANTITY 1.0 /end CHARACTERISTIC
/* src=families fam=E_fam_0042 ax=0x1B7914 ay=0x- */ /* STUB unknown size; axis_x=0x1B7914 axis_y=0x- */
/begin CHARACTERISTIC E_fam_0042_1D0814 "RE map_interp_E E_fam_0042 call=0x8009B6F6" VALUE 0x1D0814 RL_IDENTITY 0 NO_INPUT_QUANTITY 1.0 /end CHARACTERISTIC
/* src=families fam=O_fam_0016 ax=0x- ay=0x- */
/begin CHARACTERISTIC O_fam_0016_1D0824 "RE map_interp_O O_fam_0016 call=0x8009D546" VALUE 0x1D0824 RL_IDENTITY 0 NO_INPUT_QUANTITY 1.0 /end CHARACTERISTIC
/* src=families fam=C_fam_0212 ax=0x1A669C ay=0x- */ /* STUB unknown size; axis_x=0x1A669C axis_y=0x- */
/begin CHARACTERISTIC C_fam_0212_1D0858 "RE map_interp_C C_fam_0212 call=0x801068F0" VALUE 0x1D0858 RL_IDENTITY 0 NO_INPUT_QUANTITY 1.0 /end CHARACTERISTIC
/* src=atlas9979 fam=- ax=0x1A81FE ay=0x1A612A */
/begin CHARACTERISTIC tqlim_cluth_prot "atlas9979 tqlim_cluth_prot / Torque limiter for clutch protection (IdName Caddy " MAP 0x1D0860 RL_IDENTITY 0 NO_INPUT_QUANTITY 1.0 FORMAT "%%5.0"
 /begin AXIS_DESCR COM_AXIS NO_INPUT_QUANTITY NO_COMPU_METHOD 8 AXIS_PTS_REF AX_1A81FE /end AXIS_DESCR
 /begin AXIS_DESCR COM_AXIS NO_INPUT_QUANTITY NO_COMPU_METHOD 8 AXIS_PTS_REF AX_1A612A /end AXIS_DESCR
/end CHARACTERISTIC
/* src=families fam=C_fam_0091 ax=0x1A8BCC ay=0x1A73D0 */
/begin CHARACTERISTIC C_fam_0091_1D086C "RE map_interp_C C_fam_0091 call=0x800FC314" MAP 0x1D086C RL_IDENTITY 0 NO_INPUT_QUANTITY 1.0 FORMAT "%%5.0"
 /begin AXIS_DESCR COM_AXIS NO_INPUT_QUANTITY NO_COMPU_METHOD 2 AXIS_PTS_REF AX_1A8BCC /end AXIS_DESCR
 /begin AXIS_DESCR COM_AXIS NO_INPUT_QUANTITY NO_COMPU_METHOD 2 AXIS_PTS_REF AX_1A73D0 /end AXIS_DESCR
/end CHARACTERISTIC
/* src=families fam=C_fam_0022 ax=0x1AD908 ay=0x1AB87C */
/begin CHARACTERISTIC C_fam_0022_1D0878 "RE map_interp_C C_fam_0022 call=0x800FC25A" MAP 0x1D0878 RL_IDENTITY 0 NO_INPUT_QUANTITY 1.0 FORMAT "%%5.0"
 /begin AXIS_DESCR COM_AXIS NO_INPUT_QUANTITY NO_COMPU_METHOD 2 AXIS_PTS_REF AX_1AD908 /end AXIS_DESCR
 /begin AXIS_DESCR COM_AXIS NO_INPUT_QUANTITY NO_COMPU_METHOD 2 AXIS_PTS_REF AX_1AB87C /end AXIS_DESCR
/end CHARACTERISTIC
/* src=families fam=F_fam_0093 ax=0x- ay=0x- */
/begin CHARACTERISTIC F_fam_0093_1D08BC "RE map_interp_F F_fam_0093 call=0x80074040" VALUE 0x1D08BC RL_IDENTITY 0 NO_INPUT_QUANTITY 1.0 /end CHARACTERISTIC
/* src=families fam=B_fam_0056 ax=0x- ay=0x- */
/begin CHARACTERISTIC B_fam_0056_1D097C "RE interp_2d_B B_fam_0056 call=0x800CC380" VALUE 0x1D097C RL_IDENTITY 0 NO_INPUT_QUANTITY 1.0 /end CHARACTERISTIC
/* src=families fam=C_fam_0216 ax=0x1A6628 ay=0x- */ /* STUB unknown size; axis_x=0x1A6628 axis_y=0x- */
/begin CHARACTERISTIC C_fam_0216_1D0A20 "RE map_interp_C C_fam_0216 call=0x800DDB6E" VALUE 0x1D0A20 RL_IDENTITY 0 NO_INPUT_QUANTITY 1.0 /end CHARACTERISTIC
/* src=families fam=C_fam_0217 ax=0x1A760C ay=0x- */ /* STUB unknown size; axis_x=0x1A760C axis_y=0x- */
/begin CHARACTERISTIC C_fam_0217_1D0A2C "RE map_interp_C C_fam_0217 call=0x800DDB04" VALUE 0x1D0A2C RL_IDENTITY 0 NO_INPUT_QUANTITY 1.0 /end CHARACTERISTIC
/* src=families fam=fam_0019 ax=0x1B7938 ay=0x1AC92C */
/begin CHARACTERISTIC map_horsA2L_1D0A38 "RE interp_2d fam_0019 call=0x8012E6DA" MAP 0x1D0A38 RL_IDENTITY 0 NO_INPUT_QUANTITY 1.0 FORMAT "%%5.0"
 /begin AXIS_DESCR COM_AXIS NO_INPUT_QUANTITY NO_COMPU_METHOD 2 AXIS_PTS_REF AX_1B7938 /end AXIS_DESCR
 /begin AXIS_DESCR COM_AXIS NO_INPUT_QUANTITY NO_COMPU_METHOD 2 AXIS_PTS_REF AX_1AC92C /end AXIS_DESCR
/end CHARACTERISTIC
/* src=families fam=B_fam_0025 ax=0x- ay=0x1B6818 */ /* STUB unknown size; axis_x=0x- axis_y=0x1B6818 */
/begin CHARACTERISTIC B_fam_0025_1D0AA8 "RE interp_2d_B B_fam_0025 call=0x8010FED6" VALUE 0x1D0AA8 RL_IDENTITY 0 NO_INPUT_QUANTITY 1.0 /end CHARACTERISTIC
/* src=families fam=N_fam_0032 ax=0x- ay=0x- */
/begin CHARACTERISTIC N_fam_0032_1D0ACC "RE map_interp_N N_fam_0032 call=0x80116446" VALUE 0x1D0ACC RL_IDENTITY 0 NO_INPUT_QUANTITY 1.0 /end CHARACTERISTIC
/* src=families fam=C_fam_0139 ax=0x1A46A0 ay=0x- */ /* STUB unknown size; axis_x=0x1A46A0 axis_y=0x- */
/begin CHARACTERISTIC C_fam_0139_1D0ADC "RE map_interp_C C_fam_0139 call=0x8008749C" VALUE 0x1D0ADC RL_IDENTITY 0 NO_INPUT_QUANTITY 1.0 /end CHARACTERISTIC
/* src=families fam=E_fam_0124 ax=0x- ay=0x- */
/begin CHARACTERISTIC E_fam_0124_1D0ECC "RE map_interp_E E_fam_0124 call=0x80119724" VALUE 0x1D0ECC RL_IDENTITY 0 NO_INPUT_QUANTITY 1.0 /end CHARACTERISTIC
/* src=families fam=B_fam_0030 ax=0x1AD8E8 ay=0x- */ /* STUB unknown size; axis_x=0x1AD8E8 axis_y=0x- */
/begin CHARACTERISTIC B_fam_0030_1D0EE4 "RE interp_2d_B B_fam_0030 call=0x800AE028" VALUE 0x1D0EE4 RL_IDENTITY 0 NO_INPUT_QUANTITY 1.0 /end CHARACTERISTIC
/* src=families fam=C_fam_0192 ax=0x1A3464 ay=0x- */ /* STUB unknown size; axis_x=0x1A3464 axis_y=0x- */
/begin CHARACTERISTIC C_fam_0192_1D0F34 "RE map_interp_C C_fam_0192 call=0x800B1B10" VALUE 0x1D0F34 RL_IDENTITY 0 NO_INPUT_QUANTITY 1.0 /end CHARACTERISTIC
/* src=families fam=I_fam_0042 ax=0x1B491C ay=0x1B48F0 */
/begin CHARACTERISTIC I_fam_0042_1D0F80 "RE map_interp_I I_fam_0042 call=0x800F8DB8" MAP 0x1D0F80 RL_IDENTITY 0 NO_INPUT_QUANTITY 1.0 FORMAT "%%5.0"
 /begin AXIS_DESCR COM_AXIS NO_INPUT_QUANTITY NO_COMPU_METHOD 2 AXIS_PTS_REF AX_1B491C /end AXIS_DESCR
 /begin AXIS_DESCR COM_AXIS NO_INPUT_QUANTITY NO_COMPU_METHOD 2 AXIS_PTS_REF AX_1B48F0 /end AXIS_DESCR
/end CHARACTERISTIC
/* src=families fam=B_fam_0021 ax=0x1B1874 ay=0x1B1874 */
/begin CHARACTERISTIC B_fam_0021_1D1040 "RE interp_2d_B B_fam_0021 call=0x80096A6C" MAP 0x1D1040 RL_IDENTITY 0 NO_INPUT_QUANTITY 1.0 FORMAT "%%5.0"
 /begin AXIS_DESCR COM_AXIS NO_INPUT_QUANTITY NO_COMPU_METHOD 2 AXIS_PTS_REF AX_1B1874 /end AXIS_DESCR
 /begin AXIS_DESCR COM_AXIS NO_INPUT_QUANTITY NO_COMPU_METHOD 2 AXIS_PTS_REF AX_1B1874 /end AXIS_DESCR
/end CHARACTERISTIC
/begin CHARACTERISTIC B_fam_0003_1D12CC "RE interp_2d_B B_fam_0003 call=0x800873A8" MAP 0x1D12CC RL_IDENTITY 0 NO_INPUT_QUANTITY 1.0 FORMAT "%%5.0"
 /begin AXIS_DESCR COM_AXIS NO_INPUT_QUANTITY NO_COMPU_METHOD 2 AXIS_PTS_REF AX_1B4894 /end AXIS_DESCR
 /begin AXIS_DESCR COM_AXIS NO_INPUT_QUANTITY NO_COMPU_METHOD 2 AXIS_PTS_REF AX_1B2868 /end AXIS_DESCR
/end CHARACTERISTIC
/* src=families fam=M_fam_0004 ax=0x1AE94C ay=0x1B292C */
/begin CHARACTERISTIC M_fam_0004_1D13A8 "RE map_interp_M M_fam_0004 call=0x800CC852" MAP 0x1D13A8 RL_IDENTITY 0 NO_INPUT_QUANTITY 1.0 FORMAT "%%5.0"
 /begin AXIS_DESCR COM_AXIS NO_INPUT_QUANTITY NO_COMPU_METHOD 2 AXIS_PTS_REF AX_1AE94C /end AXIS_DESCR
 /begin AXIS_DESCR COM_AXIS NO_INPUT_QUANTITY NO_COMPU_METHOD 2 AXIS_PTS_REF AX_1B292C /end AXIS_DESCR
/end CHARACTERISTIC
/* src=families fam=fam_0180 ax=0x- ay=0x- */
/begin CHARACTERISTIC map_horsA2L_1D6408 "RE interp_2d fam_0180 call=0x801065F8" VALUE 0x1D144C RL_IDENTITY 0 NO_INPUT_QUANTITY 1.0 /end CHARACTERISTIC
/* src=families fam=fam_0134 ax=0x- ay=0x- */
/begin CHARACTERISTIC map_horsA2L_1CE478_1D14C4 "RE interp_2d fam_0134 call=0x80121E4C" VALUE 0x1D14C4 RL_IDENTITY 0 NO_INPUT_QUANTITY 1.0 /end CHARACTERISTIC
/* src=families fam=D_fam_0163 ax=0x- ay=0x- */
/begin CHARACTERISTIC D_fam_0163_1D15DC "RE map_interp_D D_fam_0163 call=0x80093C82" VALUE 0x1D15DC RL_IDENTITY 0 NO_INPUT_QUANTITY 1.0 /end CHARACTERISTIC
/* src=families fam=G_fam_0100 ax=0x- ay=0x- */
/begin CHARACTERISTIC G_fam_0100_1D16F0 "RE map_interp_G G_fam_0100 call=0x80093D90" VALUE 0x1D16F0 RL_IDENTITY 0 NO_INPUT_QUANTITY 1.0 /end CHARACTERISTIC
/* src=families fam=H_fam_0076 ax=0x- ay=0x- */
/begin CHARACTERISTIC H_fam_0076_1D1720 "RE map_interp_H H_fam_0076 call=0x8009903C" VALUE 0x1D1720 RL_IDENTITY 0 NO_INPUT_QUANTITY 1.0 /end CHARACTERISTIC
/* src=families fam=I_fam_0017 ax=0x- ay=0x- */
/begin CHARACTERISTIC I_fam_0017_1D17A0 "RE map_interp_I I_fam_0017 call=0x80097512" VALUE 0x1D17A0 RL_IDENTITY 0 NO_INPUT_QUANTITY 1.0 /end CHARACTERISTIC
/* src=families fam=F_fam_0090 ax=0x1A46D0 ay=0x- */ /* STUB unknown size; axis_x=0x1A46D0 axis_y=0x- */
/begin CHARACTERISTIC F_fam_0090_1D1A44 "RE map_interp_F F_fam_0090 call=0x8011BC7C" VALUE 0x1D1A44 RL_IDENTITY 0 NO_INPUT_QUANTITY 1.0 /end CHARACTERISTIC
/* src=families fam=F_fam_0081 ax=0x1B7964 ay=0x- */ /* STUB unknown size; axis_x=0x1B7964 axis_y=0x- */
/begin CHARACTERISTIC F_fam_0081_1D1B24 "RE map_interp_F F_fam_0081 call=0x800E2BD8" VALUE 0x1D1B24 RL_IDENTITY 0 NO_INPUT_QUANTITY 1.0 /end CHARACTERISTIC
/begin CHARACTERISTIC smoke_mapA "atlas9979 smoke_mapA / Smoke limitation by MAP (IdName Caddy 9979 - verifier sur" MAP 0x1D1D18 RL_IDENTITY 0 NO_INPUT_QUANTITY 1.0 FORMAT "%%5.0"
 /begin AXIS_DESCR COM_AXIS NO_INPUT_QUANTITY NO_COMPU_METHOD 19 AXIS_PTS_REF AX_1A9086 /end AXIS_DESCR
 /begin AXIS_DESCR COM_AXIS NO_INPUT_QUANTITY NO_COMPU_METHOD 18 AXIS_PTS_REF AX_1A8E06 /end AXIS_DESCR
/end CHARACTERISTIC
/* src=families fam=B_fam_0022 ax=0x1B38C0 ay=0x1A06D4 */
/begin CHARACTERISTIC B_fam_0022_1D1F00 "RE interp_2d_B B_fam_0022 call=0x800F4BA8" MAP 0x1D1F00 RL_IDENTITY 0 NO_INPUT_QUANTITY 1.0 FORMAT "%%5.0"
 /begin AXIS_DESCR COM_AXIS NO_INPUT_QUANTITY NO_COMPU_METHOD 2 AXIS_PTS_REF AX_1B38C0 /end AXIS_DESCR
 /begin AXIS_DESCR COM_AXIS NO_INPUT_QUANTITY NO_COMPU_METHOD 2 AXIS_PTS_REF AX_1A06D4 /end AXIS_DESCR
/end CHARACTERISTIC
/begin CHARACTERISTIC smoke_mapA_1D1FC4 "atlas9979 smoke_mapA@1D1FC4 / Smoke limitation by MAP (IdName Caddy 9979 - verif" MAP 0x1D1FC4 RL_IDENTITY 0 NO_INPUT_QUANTITY 1.0 FORMAT "%%5.0"
 /begin AXIS_DESCR COM_AXIS NO_INPUT_QUANTITY NO_COMPU_METHOD 19 AXIS_PTS_REF AX_1A9086 /end AXIS_DESCR
 /begin AXIS_DESCR COM_AXIS NO_INPUT_QUANTITY NO_COMPU_METHOD 18 AXIS_PTS_REF AX_1A8E06 /end AXIS_DESCR
/end CHARACTERISTIC
/begin CHARACTERISTIC smoke_mapA_1D2270 "atlas9979 smoke_mapA@1D2270 / Smoke limitation by MAP (IdName Caddy 9979 - verif" MAP 0x1D2270 RL_IDENTITY 0 NO_INPUT_QUANTITY 1.0 FORMAT "%%5.0"
 /begin AXIS_DESCR COM_AXIS NO_INPUT_QUANTITY NO_COMPU_METHOD 19 AXIS_PTS_REF AX_1A9086 /end AXIS_DESCR
 /begin AXIS_DESCR COM_AXIS NO_INPUT_QUANTITY NO_COMPU_METHOD 18 AXIS_PTS_REF AX_1A8E06 /end AXIS_DESCR
/end CHARACTERISTIC
/* src=families fam=C_fam_0147 ax=0x1A6628 ay=0x- */ /* STUB unknown size; axis_x=0x1A6628 axis_y=0x- */
/begin CHARACTERISTIC C_fam_0147_1D232C "RE map_interp_C C_fam_0147 call=0x800DDB38" VALUE 0x1D232C RL_IDENTITY 0 NO_INPUT_QUANTITY 1.0 /end CHARACTERISTIC
/* src=families fam=D_fam_0229 ax=0x- ay=0x- */
/begin CHARACTERISTIC D_fam_0229_1D24AC "RE map_interp_D D_fam_0229 call=0x801056A4" VALUE 0x1D24AC RL_IDENTITY 0 NO_INPUT_QUANTITY 1.0 /end CHARACTERISTIC
/* src=families fam=D_fam_0228 ax=0x- ay=0x- */
/begin CHARACTERISTIC D_fam_0228_1D24BC "RE map_interp_D D_fam_0228 call=0x80105626" VALUE 0x1D24BC RL_IDENTITY 0 NO_INPUT_QUANTITY 1.0 /end CHARACTERISTIC
/* src=families fam=fam_0178 ax=0x- ay=0x- */
/begin CHARACTERISTIC map_horsA2L_1CE440_1D24CC "RE interp_2d fam_0178 call=0x80105DE2" VALUE 0x1D24CC RL_IDENTITY 0 NO_INPUT_QUANTITY 1.0 /end CHARACTERISTIC
/begin CHARACTERISTIC smoke_mapA_1D251C "atlas9979 smoke_mapA@1D251C / Smoke limitation by MAP (IdName Caddy 9979 - verif" MAP 0x1D251C RL_IDENTITY 0 NO_INPUT_QUANTITY 1.0 FORMAT "%%5.0"
 /begin AXIS_DESCR COM_AXIS NO_INPUT_QUANTITY NO_COMPU_METHOD 19 AXIS_PTS_REF AX_1A9086 /end AXIS_DESCR
 /begin AXIS_DESCR COM_AXIS NO_INPUT_QUANTITY NO_COMPU_METHOD 18 AXIS_PTS_REF AX_1A8E06 /end AXIS_DESCR
/end CHARACTERISTIC
/* src=families fam=K_fam_0054 ax=0x- ay=0x- */
/begin CHARACTERISTIC K_fam_0054_1D2654 "RE map_interp_K K_fam_0054 call=0x80093D34" VALUE 0x1D2654 RL_IDENTITY 0 NO_INPUT_QUANTITY 1.0 /end CHARACTERISTIC
/* src=families fam=G_fam_0020 ax=0x- ay=0x- */
/begin CHARACTERISTIC G_fam_0020_1D26F4 "RE map_interp_G G_fam_0020 call=0x800974A6" VALUE 0x1D26F4 RL_IDENTITY 0 NO_INPUT_QUANTITY 1.0 /end CHARACTERISTIC
/* src=families fam=H_fam_0077 ax=0x- ay=0x- */
/begin CHARACTERISTIC H_fam_0077_1D2706 "RE map_interp_H H_fam_0077 call=0x8009904A" VALUE 0x1D2706 RL_IDENTITY 0 NO_INPUT_QUANTITY 1.0 /end CHARACTERISTIC
/* src=families fam=H_fam_0072 ax=0x- ay=0x- */
/begin CHARACTERISTIC H_fam_0072_1D272C "RE map_interp_H H_fam_0072 call=0x80098FFC" VALUE 0x1D272C RL_IDENTITY 0 NO_INPUT_QUANTITY 1.0 /end CHARACTERISTIC
/begin CHARACTERISTIC smoke_mapA_1D27C8 "atlas9979 smoke_mapA@1D27C8 / Smoke limitation by MAP (IdName Caddy 9979 - verif" MAP 0x1D27C8 RL_IDENTITY 0 NO_INPUT_QUANTITY 1.0 FORMAT "%%5.0"
 /begin AXIS_DESCR COM_AXIS NO_INPUT_QUANTITY NO_COMPU_METHOD 19 AXIS_PTS_REF AX_1A9086 /end AXIS_DESCR
 /begin AXIS_DESCR COM_AXIS NO_INPUT_QUANTITY NO_COMPU_METHOD 18 AXIS_PTS_REF AX_1A8E06 /end AXIS_DESCR
/end CHARACTERISTIC
/* src=families fam=I_fam_0054 ax=0x1B2868 ay=0x- */ /* STUB unknown size; axis_x=0x1B2868 axis_y=0x- */
/begin CHARACTERISTIC I_fam_0054_1D282C "RE map_interp_I I_fam_0054 call=0x80081ECA" VALUE 0x1D282C RL_IDENTITY 0 NO_INPUT_QUANTITY 1.0 /end CHARACTERISTIC
/* src=families fam=C_fam_0194 ax=0x1A54E4 ay=0x- */ /* STUB unknown size; axis_x=0x1A54E4 axis_y=0x- */
/begin CHARACTERISTIC C_fam_0194_1D2AEC "RE map_interp_C C_fam_0194 call=0x800DDF6E" VALUE 0x1D2AEC RL_IDENTITY 0 NO_INPUT_QUANTITY 1.0 /end CHARACTERISTIC
/* src=families fam=C_fam_0193 ax=0x1A54E4 ay=0x- */ /* STUB unknown size; axis_x=0x1A54E4 axis_y=0x- */
/begin CHARACTERISTIC C_fam_0193_1D2AFC "RE map_interp_C C_fam_0193 call=0x800DDF48" VALUE 0x1D2AFC RL_IDENTITY 0 NO_INPUT_QUANTITY 1.0 /end CHARACTERISTIC
/* src=atlas9979 fam=- ax=0x180C21 ay=0x1A8E2E */
/begin CHARACTERISTIC tqlim_fuel_temp2 "atlas9979 tqlim_fuel_temp2 / Torque limiter by fuel temperature (IdName Caddy 99" MAP 0x1D2C1C RL_IDENTITY 0 NO_INPUT_QUANTITY 1.0 FORMAT "%%5.0"
 /begin AXIS_DESCR COM_AXIS NO_INPUT_QUANTITY NO_COMPU_METHOD 4 AXIS_PTS_REF AX_180C21 /end AXIS_DESCR
 /begin AXIS_DESCR COM_AXIS NO_INPUT_QUANTITY NO_COMPU_METHOD 6 AXIS_PTS_REF AX_1A8E2E /end AXIS_DESCR
/end CHARACTERISTIC
/* src=families fam=fam_0064 ax=0x1AA850 ay=0x1AE8FC */
/begin CHARACTERISTIC map_horsA2L_1D2DC4 "RE interp_2d fam_0064 call=0x80080B06; RE map_interp_D D_fam_0041 call=0x80080B2" MAP 0x1D2DC4 RL_IDENTITY 0 NO_INPUT_QUANTITY 1.0 FORMAT "%%5.0"
 /begin AXIS_DESCR COM_AXIS NO_INPUT_QUANTITY NO_COMPU_METHOD 2 AXIS_PTS_REF AX_1AA850 /end AXIS_DESCR
 /begin AXIS_DESCR COM_AXIS NO_INPUT_QUANTITY NO_COMPU_METHOD 2 AXIS_PTS_REF AX_1AE8FC /end AXIS_DESCR
/end CHARACTERISTIC
/* src=families fam=F_fam_0019 ax=0x1B58D4 ay=0x1AA95C */
/begin CHARACTERISTIC F_fam_0019_1D2FA0 "RE map_interp_F F_fam_0019 call=0x800DEF9E" MAP 0x1D2FA0 RL_IDENTITY 0 NO_INPUT_QUANTITY 1.0 FORMAT "%%5.0"
 /begin AXIS_DESCR COM_AXIS NO_INPUT_QUANTITY NO_COMPU_METHOD 2 AXIS_PTS_REF AX_1B58D4 /end AXIS_DESCR
 /begin AXIS_DESCR COM_AXIS NO_INPUT_QUANTITY NO_COMPU_METHOD 2 AXIS_PTS_REF AX_1AA95C /end AXIS_DESCR
/end CHARACTERISTIC
/* src=families fam=C_fam_0268 ax=0x- ay=0x- */
/begin CHARACTERISTIC C_fam_0268_1D3000 "RE map_interp_C C_fam_0268 call=0x80096576" VALUE 0x1D3000 RL_IDENTITY 0 NO_INPUT_QUANTITY 1.0 /end CHARACTERISTIC
/* src=families fam=C_fam_0261 ax=0x1A1748 ay=0x- */ /* STUB unknown size; axis_x=0x1A1748 axis_y=0x- */
/begin CHARACTERISTIC C_fam_0261_1D3020 "RE map_interp_C C_fam_0261 call=0x8009615E" VALUE 0x1D3020 RL_IDENTITY 0 NO_INPUT_QUANTITY 1.0 /end CHARACTERISTIC
/* src=families fam=C_fam_0292 ax=0x- ay=0x- */
/begin CHARACTERISTIC C_fam_0292_1D30A0 "RE map_interp_C C_fam_0292 call=0x8009B28E" VALUE 0x1D30A0 RL_IDENTITY 0 NO_INPUT_QUANTITY 1.0 /end CHARACTERISTIC
/* src=families fam=C_fam_0238 ax=0x1A463C ay=0x- */ /* STUB unknown size; axis_x=0x1A463C axis_y=0x- */
/begin CHARACTERISTIC C_fam_0238_1D30B0 "RE map_interp_C C_fam_0238 call=0x800D05B2" VALUE 0x1D30B0 RL_IDENTITY 0 NO_INPUT_QUANTITY 1.0 /end CHARACTERISTIC
/end MODULE
/end PROJECT
