/*
* PCR2.1 Golf SW 9980 HW 03L997558A project SM2G0P
* Reverse-engineered skeleton - NOT Continental OEM A2L.
* First draft for WinOLS import. Incomplete. Do not flash from this file.
* WinOLS offset = Ghidra 80xxxxxx or A0xxxxxx & 0x1FFFFF
* example: Ghidra 0xA01CBE40 -> WinOLS 0x1CBE40
* Uses RL_IDENTITY / NO_INPUT_QUANTITY (WinOLS-friendly stub syntax).
* AXIS_PTS: u16 LE count read 2 or 4 bytes before axis if 2..64.
* AccPed-like (fam_0001 APP_r/nmot): 8x16 placeholder only.
* Atlas 9979 maps included with Caddy IdNames - offsets may differ on 9980.
* Interior horsA2L hits (pointer inside a larger map) are omitted.
* Rail-path extras + RAM MEASUREMENT: PCR21_Golf9980_RAIL_PATH.a2l
* Generated by map-finder/a2l/gen_golf9980_reverse_a2l.py
*/
ASAP2_VERSION 1 60
/begin PROJECT PCR21_Golf9980_REVERSE "RE PCR2.1 9980 SM2G0P - NOT OEM"
/begin MODULE PCR21_SM2G0P_9980 "Golf 03L997558A SW9980; reverse draft"
/* NOT OEM. RL_IDENTITY = raw UWORD grid. RAM MEASUREMENT = RE role names. */
/* AXIS_PTS 0x178574 count=? (unknown_use_2) - values not dumped */
/begin AXIS_PTS AX_178574 "RE axis ptr not OEM" 0x178574 RL_IDENTITY 0 NO_INPUT_QUANTITY 1.0 2 FORMAT "%%5.0" /end AXIS_PTS
/* AXIS_PTS 0x17955C count=? (unknown_use_2) - values not dumped */
/begin AXIS_PTS AX_17955C "RE axis ptr not OEM" 0x17955C RL_IDENTITY 0 NO_INPUT_QUANTITY 1.0 2 FORMAT "%%5.0" /end AXIS_PTS
/* AXIS_PTS 0x17A54C count=? (unknown_use_2) - values not dumped */
/begin AXIS_PTS AX_17A54C "RE axis ptr not OEM" 0x17A54C RL_IDENTITY 0 NO_INPUT_QUANTITY 1.0 2 FORMAT "%%5.0" /end AXIS_PTS
/* AXIS_PTS 0x17B450 count=? (unknown_use_2) - values not dumped */
/begin AXIS_PTS AX_17B450 "RE axis ptr not OEM" 0x17B450 RL_IDENTITY 0 NO_INPUT_QUANTITY 1.0 2 FORMAT "%%5.0" /end AXIS_PTS
/* AXIS_PTS 0x17B45C count=? (unknown_use_2) - values not dumped */
/begin AXIS_PTS AX_17B45C "RE axis ptr not OEM" 0x17B45C RL_IDENTITY 0 NO_INPUT_QUANTITY 1.0 2 FORMAT "%%5.0" /end AXIS_PTS
/* AXIS_PTS 0x17B478 count=? (unknown_use_2) - values not dumped */
/begin AXIS_PTS AX_17B478 "RE axis ptr not OEM" 0x17B478 RL_IDENTITY 0 NO_INPUT_QUANTITY 1.0 2 FORMAT "%%5.0" /end AXIS_PTS
/* AXIS_PTS 0x17C444 count=? (unknown_use_2) - values not dumped */
/begin AXIS_PTS AX_17C444 "RE axis ptr not OEM" 0x17C444 RL_IDENTITY 0 NO_INPUT_QUANTITY 1.0 2 FORMAT "%%5.0" /end AXIS_PTS
/* AXIS_PTS 0x17C460 count=? (unknown_use_2) - values not dumped */
/begin AXIS_PTS AX_17C460 "RE axis ptr not OEM" 0x17C460 RL_IDENTITY 0 NO_INPUT_QUANTITY 1.0 2 FORMAT "%%5.0" /end AXIS_PTS
/* AXIS_PTS 0x17C474 count=? (unknown_use_2) - values not dumped */
/begin AXIS_PTS AX_17C474 "RE axis ptr not OEM" 0x17C474 RL_IDENTITY 0 NO_INPUT_QUANTITY 1.0 2 FORMAT "%%5.0" /end AXIS_PTS
/* AXIS_PTS 0x17C540 count=? (unknown_use_2) - values not dumped */
/begin AXIS_PTS AX_17C540 "RE axis ptr not OEM" 0x17C540 RL_IDENTITY 0 NO_INPUT_QUANTITY 1.0 2 FORMAT "%%5.0" /end AXIS_PTS
/* AXIS_PTS 0x17C550 count=? (unknown_use_2) - values not dumped */
/begin AXIS_PTS AX_17C550 "RE axis ptr not OEM" 0x17C550 RL_IDENTITY 0 NO_INPUT_QUANTITY 1.0 2 FORMAT "%%5.0" /end AXIS_PTS
/* AXIS_PTS 0x17D408 count=? (unknown_use_2) - values not dumped */
/begin AXIS_PTS AX_17D408 "RE axis ptr not OEM" 0x17D408 RL_IDENTITY 0 NO_INPUT_QUANTITY 1.0 2 FORMAT "%%5.0" /end AXIS_PTS
/* AXIS_PTS 0x17D454 count=? (unknown_use_2) - values not dumped */
/begin AXIS_PTS AX_17D454 "RE axis ptr not OEM" 0x17D454 RL_IDENTITY 0 NO_INPUT_QUANTITY 1.0 2 FORMAT "%%5.0" /end AXIS_PTS
/* AXIS_PTS 0x17D460 count=? (unknown_use_2) - values not dumped */
/begin AXIS_PTS AX_17D460 "RE axis ptr not OEM" 0x17D460 RL_IDENTITY 0 NO_INPUT_QUANTITY 1.0 2 FORMAT "%%5.0" /end AXIS_PTS
/* AXIS_PTS 0x17D54C count=? (unknown_use_2) - values not dumped */
/begin AXIS_PTS AX_17D54C "RE axis ptr not OEM" 0x17D54C RL_IDENTITY 0 NO_INPUT_QUANTITY 1.0 2 FORMAT "%%5.0" /end AXIS_PTS
/* AXIS_PTS 0x17E40C count=? (unknown_use_2) - values not dumped */
/begin AXIS_PTS AX_17E40C "RE axis ptr not OEM" 0x17E40C RL_IDENTITY 0 NO_INPUT_QUANTITY 1.0 2 FORMAT "%%5.0" /end AXIS_PTS
/* AXIS_PTS 0x17E444 count=? (unknown_use_2) - values not dumped */
/begin AXIS_PTS AX_17E444 "RE axis ptr not OEM" 0x17E444 RL_IDENTITY 0 NO_INPUT_QUANTITY 1.0 2 FORMAT "%%5.0" /end AXIS_PTS
/* AXIS_PTS 0x17E454 count=? (unknown_use_2) - values not dumped */
/begin AXIS_PTS AX_17E454 "RE axis ptr not OEM" 0x17E454 RL_IDENTITY 0 NO_INPUT_QUANTITY 1.0 2 FORMAT "%%5.0" /end AXIS_PTS
/* AXIS_PTS 0x17E548 count=? (unknown_use_2) - values not dumped */
/begin AXIS_PTS AX_17E548 "RE axis ptr not OEM" 0x17E548 RL_IDENTITY 0 NO_INPUT_QUANTITY 1.0 2 FORMAT "%%5.0" /end AXIS_PTS
/* AXIS_PTS 0x17E558 count=? (unknown_use_2) - values not dumped */
/begin AXIS_PTS AX_17E558 "RE axis ptr not OEM" 0x17E558 RL_IDENTITY 0 NO_INPUT_QUANTITY 1.0 2 FORMAT "%%5.0" /end AXIS_PTS
/* AXIS_PTS 0x17E568 count=? (unknown_use_2) - values not dumped */
/begin AXIS_PTS AX_17E568 "RE axis ptr not OEM" 0x17E568 RL_IDENTITY 0 NO_INPUT_QUANTITY 1.0 2 FORMAT "%%5.0" /end AXIS_PTS
/* AXIS_PTS 0x17F444 count=? (unknown_use_2) - values not dumped */
/begin AXIS_PTS AX_17F444 "RE axis ptr not OEM" 0x17F444 RL_IDENTITY 0 NO_INPUT_QUANTITY 1.0 2 FORMAT "%%5.0" /end AXIS_PTS
/* AXIS_PTS 0x17F454 count=? (unknown_use_2) - values not dumped */
/begin AXIS_PTS AX_17F454 "RE axis ptr not OEM" 0x17F454 RL_IDENTITY 0 NO_INPUT_QUANTITY 1.0 2 FORMAT "%%5.0" /end AXIS_PTS
/* AXIS_PTS 0x17F550 count=? (unknown_use_2) - values not dumped */
/begin AXIS_PTS AX_17F550 "RE axis ptr not OEM" 0x17F550 RL_IDENTITY 0 NO_INPUT_QUANTITY 1.0 2 FORMAT "%%5.0" /end AXIS_PTS
/* AXIS_PTS 0x182570 count=? (unknown_use_2) - values not dumped */
/begin AXIS_PTS AX_182570 "RE axis ptr not OEM" 0x182570 RL_IDENTITY 0 NO_INPUT_QUANTITY 1.0 2 FORMAT "%%5.0" /end AXIS_PTS
/* AXIS_PTS 0x18357C count=? (unknown_use_2) - values not dumped */
/begin AXIS_PTS AX_18357C "RE axis ptr not OEM" 0x18357C RL_IDENTITY 0 NO_INPUT_QUANTITY 1.0 2 FORMAT "%%5.0" /end AXIS_PTS
/* AXIS_PTS 0x183EF6 count=8 (header_u16) - values not dumped */
/begin AXIS_PTS AX_183EF6 "RE axis ptr not OEM" 0x183EF6 RL_IDENTITY 0 NO_INPUT_QUANTITY 1.0 8 FORMAT "%%5.0" /end AXIS_PTS
/* AXIS_PTS 0x183F09 count=22 (header_u16) - values not dumped */
/begin AXIS_PTS AX_183F09 "RE axis ptr not OEM" 0x183F09 RL_IDENTITY 0 NO_INPUT_QUANTITY 1.0 22 FORMAT "%%5.0" /end AXIS_PTS
/* AXIS_PTS 0x184550 count=? (unknown_use_2) - values not dumped */
/begin AXIS_PTS AX_184550 "RE axis ptr not OEM" 0x184550 RL_IDENTITY 0 NO_INPUT_QUANTITY 1.0 2 FORMAT "%%5.0" /end AXIS_PTS
/* AXIS_PTS 0x184564 count=? (unknown_use_2) - values not dumped */
/begin AXIS_PTS AX_184564 "RE axis ptr not OEM" 0x184564 RL_IDENTITY 0 NO_INPUT_QUANTITY 1.0 2 FORMAT "%%5.0" /end AXIS_PTS
/* AXIS_PTS 0x189CF2 count=16 (header_u16) - values not dumped */
/begin AXIS_PTS AX_189CF2 "RE axis ptr not OEM" 0x189CF2 RL_IDENTITY 0 NO_INPUT_QUANTITY 1.0 16 FORMAT "%%5.0" /end AXIS_PTS
/* AXIS_PTS 0x18AA26 count=16 (header_u16) - values not dumped */
/begin AXIS_PTS AX_18AA26 "RE axis ptr not OEM" 0x18AA26 RL_IDENTITY 0 NO_INPUT_QUANTITY 1.0 16 FORMAT "%%5.0" /end AXIS_PTS
/* AXIS_PTS 0x1930CC count=16 (from_map) - values not dumped */
/begin AXIS_PTS AX_1930CC "RE axis ptr not OEM" 0x1930CC RL_IDENTITY 0 NO_INPUT_QUANTITY 1.0 16 FORMAT "%%5.0" /end AXIS_PTS
/* AXIS_PTS 0x1A0448 count=? (unknown_use_2) - values not dumped */
/begin AXIS_PTS AX_1A0448 "RE axis ptr not OEM" 0x1A0448 RL_IDENTITY 0 NO_INPUT_QUANTITY 1.0 2 FORMAT "%%5.0" /end AXIS_PTS
/* AXIS_PTS 0x1A0548 count=? (unknown_use_2) - values not dumped */
/begin AXIS_PTS AX_1A0548 "RE axis ptr not OEM" 0x1A0548 RL_IDENTITY 0 NO_INPUT_QUANTITY 1.0 2 FORMAT "%%5.0" /end AXIS_PTS
/* AXIS_PTS 0x1A0588 count=? (unknown_use_2) - values not dumped */
/begin AXIS_PTS AX_1A0588 "RE axis ptr not OEM" 0x1A0588 RL_IDENTITY 0 NO_INPUT_QUANTITY 1.0 2 FORMAT "%%5.0" /end AXIS_PTS
/* AXIS_PTS 0x1A06F8 count=? (unknown_use_2) - values not dumped */
/begin AXIS_PTS AX_1A06F8 "RE axis ptr not OEM" 0x1A06F8 RL_IDENTITY 0 NO_INPUT_QUANTITY 1.0 2 FORMAT "%%5.0" /end AXIS_PTS
/* AXIS_PTS 0x1A070C count=? (unknown_use_2) - values not dumped */
/begin AXIS_PTS AX_1A070C "RE axis ptr not OEM" 0x1A070C RL_IDENTITY 0 NO_INPUT_QUANTITY 1.0 2 FORMAT "%%5.0" /end AXIS_PTS
/* AXIS_PTS 0x1A0B8C count=? (unknown_use_2) - values not dumped */
/begin AXIS_PTS AX_1A0B8C "RE axis ptr not OEM" 0x1A0B8C RL_IDENTITY 0 NO_INPUT_QUANTITY 1.0 2 FORMAT "%%5.0" /end AXIS_PTS
/* AXIS_PTS 0x1A145C count=27 (header_u16) - values not dumped */
/begin AXIS_PTS AX_1A145C "RE axis ptr not OEM" 0x1A145C RL_IDENTITY 0 NO_INPUT_QUANTITY 1.0 27 FORMAT "%%5.0" /end AXIS_PTS
/* AXIS_PTS 0x1A14C4 count=? (unknown_use_2) - values not dumped */
/begin AXIS_PTS AX_1A14C4 "RE axis ptr not OEM" 0x1A14C4 RL_IDENTITY 0 NO_INPUT_QUANTITY 1.0 2 FORMAT "%%5.0" /end AXIS_PTS
/* AXIS_PTS 0x1A14F0 count=? (unknown_use_2) - values not dumped */
/begin AXIS_PTS AX_1A14F0 "RE axis ptr not OEM" 0x1A14F0 RL_IDENTITY 0 NO_INPUT_QUANTITY 1.0 2 FORMAT "%%5.0" /end AXIS_PTS
/* AXIS_PTS 0x1A14FC count=? (unknown_use_2) - values not dumped */
/begin AXIS_PTS AX_1A14FC "RE axis ptr not OEM" 0x1A14FC RL_IDENTITY 0 NO_INPUT_QUANTITY 1.0 2 FORMAT "%%5.0" /end AXIS_PTS
/* AXIS_PTS 0x1A1528 count=? (unknown_use_2) - values not dumped */
/begin AXIS_PTS AX_1A1528 "RE axis ptr not OEM" 0x1A1528 RL_IDENTITY 0 NO_INPUT_QUANTITY 1.0 2 FORMAT "%%5.0" /end AXIS_PTS
/* AXIS_PTS 0x1A15E8 count=? (unknown_use_2) - values not dumped */
/begin AXIS_PTS AX_1A15E8 "RE axis ptr not OEM" 0x1A15E8 RL_IDENTITY 0 NO_INPUT_QUANTITY 1.0 2 FORMAT "%%5.0" /end AXIS_PTS
/* AXIS_PTS 0x1A24AC count=? (unknown_use_2) - values not dumped */
/begin AXIS_PTS AX_1A24AC "RE axis ptr not OEM" 0x1A24AC RL_IDENTITY 0 NO_INPUT_QUANTITY 1.0 2 FORMAT "%%5.0" /end AXIS_PTS
/* AXIS_PTS 0x1A2550 count=? (unknown_use_2) - values not dumped */
/begin AXIS_PTS AX_1A2550 "RE axis ptr not OEM" 0x1A2550 RL_IDENTITY 0 NO_INPUT_QUANTITY 1.0 2 FORMAT "%%5.0" /end AXIS_PTS
/* AXIS_PTS 0x1A3510 count=? (unknown_use_2) - values not dumped */
/begin AXIS_PTS AX_1A3510 "RE axis ptr not OEM" 0x1A3510 RL_IDENTITY 0 NO_INPUT_QUANTITY 1.0 2 FORMAT "%%5.0" /end AXIS_PTS
/* AXIS_PTS 0x1A3674 count=? (unknown_use_2) - values not dumped */
/begin AXIS_PTS AX_1A3674 "RE axis ptr not OEM" 0x1A3674 RL_IDENTITY 0 NO_INPUT_QUANTITY 1.0 2 FORMAT "%%5.0" /end AXIS_PTS
/* AXIS_PTS 0x1A36DC count=49 (header_u16) - values not dumped */
/begin AXIS_PTS AX_1A36DC "RE axis ptr not OEM" 0x1A36DC RL_IDENTITY 0 NO_INPUT_QUANTITY 1.0 49 FORMAT "%%5.0" /end AXIS_PTS
/* AXIS_PTS 0x1A3B8C count=? (unknown_use_2) - values not dumped */
/begin AXIS_PTS AX_1A3B8C "RE axis ptr not OEM" 0x1A3B8C RL_IDENTITY 0 NO_INPUT_QUANTITY 1.0 2 FORMAT "%%5.0" /end AXIS_PTS
/* AXIS_PTS 0x1A444C count=8 (header_u16) - values not dumped */
/begin AXIS_PTS AX_1A444C "RE axis ptr not OEM" 0x1A444C RL_IDENTITY 0 NO_INPUT_QUANTITY 1.0 8 FORMAT "%%5.0" /end AXIS_PTS
/* AXIS_PTS 0x1A54F8 count=16 (header_u16) - values not dumped */
/begin AXIS_PTS AX_1A54F8 "RE axis ptr not OEM" 0x1A54F8 RL_IDENTITY 0 NO_INPUT_QUANTITY 1.0 16 FORMAT "%%5.0" /end AXIS_PTS
/* AXIS_PTS 0x1A5518 count=? (unknown_use_2) - values not dumped */
/begin AXIS_PTS AX_1A5518 "RE axis ptr not OEM" 0x1A5518 RL_IDENTITY 0 NO_INPUT_QUANTITY 1.0 2 FORMAT "%%5.0" /end AXIS_PTS
/* AXIS_PTS 0x1A5530 count=? (unknown_use_2) - values not dumped */
/begin AXIS_PTS AX_1A5530 "RE axis ptr not OEM" 0x1A5530 RL_IDENTITY 0 NO_INPUT_QUANTITY 1.0 2 FORMAT "%%5.0" /end AXIS_PTS
/* AXIS_PTS 0x1A555C count=? (unknown_use_2) - values not dumped */
/begin AXIS_PTS AX_1A555C "RE axis ptr not OEM" 0x1A555C RL_IDENTITY 0 NO_INPUT_QUANTITY 1.0 2 FORMAT "%%5.0" /end AXIS_PTS
/* AXIS_PTS 0x1A568C count=? (unknown_use_2) - values not dumped */
/begin AXIS_PTS AX_1A568C "RE axis ptr not OEM" 0x1A568C RL_IDENTITY 0 NO_INPUT_QUANTITY 1.0 2 FORMAT "%%5.0" /end AXIS_PTS
/* AXIS_PTS 0x1A56F0 count=? (unknown_use_2) - values not dumped */
/begin AXIS_PTS AX_1A56F0 "RE axis ptr not OEM" 0x1A56F0 RL_IDENTITY 0 NO_INPUT_QUANTITY 1.0 2 FORMAT "%%5.0" /end AXIS_PTS
/* AXIS_PTS 0x1A570C count=? (unknown_use_2) - values not dumped */
/begin AXIS_PTS AX_1A570C "RE axis ptr not OEM" 0x1A570C RL_IDENTITY 0 NO_INPUT_QUANTITY 1.0 2 FORMAT "%%5.0" /end AXIS_PTS
/* AXIS_PTS 0x1A5768 count=15 (header_u16) - values not dumped */
/begin AXIS_PTS AX_1A5768 "RE axis ptr not OEM" 0x1A5768 RL_IDENTITY 0 NO_INPUT_QUANTITY 1.0 15 FORMAT "%%5.0" /end AXIS_PTS
/* AXIS_PTS 0x1A6504 count=6 (header_u16) - values not dumped */
/begin AXIS_PTS AX_1A6504 "RE axis ptr not OEM" 0x1A6504 RL_IDENTITY 0 NO_INPUT_QUANTITY 1.0 6 FORMAT "%%5.0" /end AXIS_PTS
/* AXIS_PTS 0x1A6514 count=8 (header_u16) - values not dumped */
/begin AXIS_PTS AX_1A6514 "RE axis ptr not OEM" 0x1A6514 RL_IDENTITY 0 NO_INPUT_QUANTITY 1.0 8 FORMAT "%%5.0" /end AXIS_PTS
/* AXIS_PTS 0x1A6600 count=? (unknown_use_2) - values not dumped */
/begin AXIS_PTS AX_1A6600 "RE axis ptr not OEM" 0x1A6600 RL_IDENTITY 0 NO_INPUT_QUANTITY 1.0 2 FORMAT "%%5.0" /end AXIS_PTS
/* AXIS_PTS 0x1A666C count=? (unknown_use_2) - values not dumped */
/begin AXIS_PTS AX_1A666C "RE axis ptr not OEM" 0x1A666C RL_IDENTITY 0 NO_INPUT_QUANTITY 1.0 2 FORMAT "%%5.0" /end AXIS_PTS
/* AXIS_PTS 0x1A6BF8 count=? (unknown_use_2) - values not dumped */
/begin AXIS_PTS AX_1A6BF8 "RE axis ptr not OEM" 0x1A6BF8 RL_IDENTITY 0 NO_INPUT_QUANTITY 1.0 2 FORMAT "%%5.0" /end AXIS_PTS
/* AXIS_PTS 0x1A7450 count=? (unknown_use_2) - values not dumped */
/begin AXIS_PTS AX_1A7450 "RE axis ptr not OEM" 0x1A7450 RL_IDENTITY 0 NO_INPUT_QUANTITY 1.0 2 FORMAT "%%5.0" /end AXIS_PTS
/* AXIS_PTS 0x1A7508 count=? (unknown_use_2) - values not dumped */
/begin AXIS_PTS AX_1A7508 "RE axis ptr not OEM" 0x1A7508 RL_IDENTITY 0 NO_INPUT_QUANTITY 1.0 2 FORMAT "%%5.0" /end AXIS_PTS
/* AXIS_PTS 0x1A765C count=? (unknown_use_2) - values not dumped */
/begin AXIS_PTS AX_1A765C "RE axis ptr not OEM" 0x1A765C RL_IDENTITY 0 NO_INPUT_QUANTITY 1.0 2 FORMAT "%%5.0" /end AXIS_PTS
/* AXIS_PTS 0x1A76EC count=? (unknown_use_2) - values not dumped */
/begin AXIS_PTS AX_1A76EC "RE axis ptr not OEM" 0x1A76EC RL_IDENTITY 0 NO_INPUT_QUANTITY 1.0 2 FORMAT "%%5.0" /end AXIS_PTS
/* AXIS_PTS 0x1A7704 count=? (unknown_use_2) - values not dumped */
/begin AXIS_PTS AX_1A7704 "RE axis ptr not OEM" 0x1A7704 RL_IDENTITY 0 NO_INPUT_QUANTITY 1.0 2 FORMAT "%%5.0" /end AXIS_PTS
/* AXIS_PTS 0x1A77EC count=8 (header_u16) - values not dumped */
/begin AXIS_PTS AX_1A77EC "RE axis ptr not OEM" 0x1A77EC RL_IDENTITY 0 NO_INPUT_QUANTITY 1.0 8 FORMAT "%%5.0" /end AXIS_PTS
/* AXIS_PTS 0x1A7BF8 count=? (unknown_use_2) - values not dumped */
/begin AXIS_PTS AX_1A7BF8 "RE axis ptr not OEM" 0x1A7BF8 RL_IDENTITY 0 NO_INPUT_QUANTITY 1.0 2 FORMAT "%%5.0" /end AXIS_PTS
/* AXIS_PTS 0x1A881C count=? (unknown_use_2) - values not dumped */
/begin AXIS_PTS AX_1A881C "RE axis ptr not OEM" 0x1A881C RL_IDENTITY 0 NO_INPUT_QUANTITY 1.0 2 FORMAT "%%5.0" /end AXIS_PTS
/* AXIS_PTS 0x1A88EC count=? (unknown_use_2) - values not dumped */
/begin AXIS_PTS AX_1A88EC "RE axis ptr not OEM" 0x1A88EC RL_IDENTITY 0 NO_INPUT_QUANTITY 1.0 2 FORMAT "%%5.0" /end AXIS_PTS
/* AXIS_PTS 0x1A8934 count=? (unknown_use_2) - values not dumped */
/begin AXIS_PTS AX_1A8934 "RE axis ptr not OEM" 0x1A8934 RL_IDENTITY 0 NO_INPUT_QUANTITY 1.0 2 FORMAT "%%5.0" /end AXIS_PTS
/* AXIS_PTS 0x1A8BC0 count=8 (header_u16) - values not dumped */
/begin AXIS_PTS AX_1A8BC0 "RE axis ptr not OEM" 0x1A8BC0 RL_IDENTITY 0 NO_INPUT_QUANTITY 1.0 8 FORMAT "%%5.0" /end AXIS_PTS
/* AXIS_PTS 0x1A8BE8 count=? (unknown_use_2) - values not dumped */
/begin AXIS_PTS AX_1A8BE8 "RE axis ptr not OEM" 0x1A8BE8 RL_IDENTITY 0 NO_INPUT_QUANTITY 1.0 2 FORMAT "%%5.0" /end AXIS_PTS
/* AXIS_PTS 0x1A9200 count=50 (header_u16) - values not dumped */
/begin AXIS_PTS AX_1A9200 "RE axis ptr not OEM" 0x1A9200 RL_IDENTITY 0 NO_INPUT_QUANTITY 1.0 50 FORMAT "%%5.0" /end AXIS_PTS
/* AXIS_PTS 0x1A9218 count=? (unknown_use_2) - values not dumped */
/begin AXIS_PTS AX_1A9218 "RE axis ptr not OEM" 0x1A9218 RL_IDENTITY 0 NO_INPUT_QUANTITY 1.0 2 FORMAT "%%5.0" /end AXIS_PTS
/* AXIS_PTS 0x1A92AC count=? (unknown_use_2) - values not dumped */
/begin AXIS_PTS AX_1A92AC "RE axis ptr not OEM" 0x1A92AC RL_IDENTITY 0 NO_INPUT_QUANTITY 1.0 2 FORMAT "%%5.0" /end AXIS_PTS
/* AXIS_PTS 0x1A9804 count=? (unknown_use_2) - values not dumped */
/begin AXIS_PTS AX_1A9804 "RE axis ptr not OEM" 0x1A9804 RL_IDENTITY 0 NO_INPUT_QUANTITY 1.0 2 FORMAT "%%5.0" /end AXIS_PTS
/* AXIS_PTS 0x1A9984 count=? (unknown_use_2) - values not dumped */
/begin AXIS_PTS AX_1A9984 "RE axis ptr not OEM" 0x1A9984 RL_IDENTITY 0 NO_INPUT_QUANTITY 1.0 2 FORMAT "%%5.0" /end AXIS_PTS
/* AXIS_PTS 0x1A9BE8 count=? (unknown_use_2) - values not dumped */
/begin AXIS_PTS AX_1A9BE8 "RE axis ptr not OEM" 0x1A9BE8 RL_IDENTITY 0 NO_INPUT_QUANTITY 1.0 2 FORMAT "%%5.0" /end AXIS_PTS
/* AXIS_PTS 0x1A9C4C count=? (unknown_use_2) - values not dumped */
/begin AXIS_PTS AX_1A9C4C "RE axis ptr not OEM" 0x1A9C4C RL_IDENTITY 0 NO_INPUT_QUANTITY 1.0 2 FORMAT "%%5.0" /end AXIS_PTS
/* AXIS_PTS 0x1AA1F8 count=? (unknown_use_2) - values not dumped */
/begin AXIS_PTS AX_1AA1F8 "RE axis ptr not OEM" 0x1AA1F8 RL_IDENTITY 0 NO_INPUT_QUANTITY 1.0 2 FORMAT "%%5.0" /end AXIS_PTS
/* AXIS_PTS 0x1AA5FC count=? (unknown_use_2) - values not dumped */
/begin AXIS_PTS AX_1AA5FC "RE axis ptr not OEM" 0x1AA5FC RL_IDENTITY 0 NO_INPUT_QUANTITY 1.0 2 FORMAT "%%5.0" /end AXIS_PTS
/* AXIS_PTS 0x1AA67C count=? (unknown_use_2) - values not dumped */
/begin AXIS_PTS AX_1AA67C "RE axis ptr not OEM" 0x1AA67C RL_IDENTITY 0 NO_INPUT_QUANTITY 1.0 2 FORMAT "%%5.0" /end AXIS_PTS
/* AXIS_PTS 0x1AA70C count=? (unknown_use_2) - values not dumped */
/begin AXIS_PTS AX_1AA70C "RE axis ptr not OEM" 0x1AA70C RL_IDENTITY 0 NO_INPUT_QUANTITY 1.0 2 FORMAT "%%5.0" /end AXIS_PTS
/* AXIS_PTS 0x1AA828 count=? (unknown_use_2) - values not dumped */
/begin AXIS_PTS AX_1AA828 "RE axis ptr not OEM" 0x1AA828 RL_IDENTITY 0 NO_INPUT_QUANTITY 1.0 2 FORMAT "%%5.0" /end AXIS_PTS
/* AXIS_PTS 0x1AA898 count=? (unknown_use_2) - values not dumped */
/begin AXIS_PTS AX_1AA898 "RE axis ptr not OEM" 0x1AA898 RL_IDENTITY 0 NO_INPUT_QUANTITY 1.0 2 FORMAT "%%5.0" /end AXIS_PTS
/* AXIS_PTS 0x1AA974 count=? (unknown_use_2) - values not dumped */
/begin AXIS_PTS AX_1AA974 "RE axis ptr not OEM" 0x1AA974 RL_IDENTITY 0 NO_INPUT_QUANTITY 1.0 2 FORMAT "%%5.0" /end AXIS_PTS
/* AXIS_PTS 0x1AA9FC count=? (unknown_use_2) - values not dumped */
/begin AXIS_PTS AX_1AA9FC "RE axis ptr not OEM" 0x1AA9FC RL_IDENTITY 0 NO_INPUT_QUANTITY 1.0 2 FORMAT "%%5.0" /end AXIS_PTS
/* AXIS_PTS 0x1AAA00 count=? (unknown_use_2) - values not dumped */
/begin AXIS_PTS AX_1AAA00 "RE axis ptr not OEM" 0x1AAA00 RL_IDENTITY 0 NO_INPUT_QUANTITY 1.0 2 FORMAT "%%5.0" /end AXIS_PTS
/* AXIS_PTS 0x1AB21C count=? (unknown_use_2) - values not dumped */
/begin AXIS_PTS AX_1AB21C "RE axis ptr not OEM" 0x1AB21C RL_IDENTITY 0 NO_INPUT_QUANTITY 1.0 2 FORMAT "%%5.0" /end AXIS_PTS
/* AXIS_PTS 0x1AB2AC count=? (unknown_use_2) - values not dumped */
/begin AXIS_PTS AX_1AB2AC "RE axis ptr not OEM" 0x1AB2AC RL_IDENTITY 0 NO_INPUT_QUANTITY 1.0 2 FORMAT "%%5.0" /end AXIS_PTS
/* AXIS_PTS 0x1AB908 count=? (unknown_use_2) - values not dumped */
/begin AXIS_PTS AX_1AB908 "RE axis ptr not OEM" 0x1AB908 RL_IDENTITY 0 NO_INPUT_QUANTITY 1.0 2 FORMAT "%%5.0" /end AXIS_PTS
/* AXIS_PTS 0x1AB924 count=? (unknown_use_2) - values not dumped */
/begin AXIS_PTS AX_1AB924 "RE axis ptr not OEM" 0x1AB924 RL_IDENTITY 0 NO_INPUT_QUANTITY 1.0 2 FORMAT "%%5.0" /end AXIS_PTS
/* AXIS_PTS 0x1ABBC8 count=? (unknown_use_2) - values not dumped */
/begin AXIS_PTS AX_1ABBC8 "RE axis ptr not OEM" 0x1ABBC8 RL_IDENTITY 0 NO_INPUT_QUANTITY 1.0 2 FORMAT "%%5.0" /end AXIS_PTS
/* AXIS_PTS 0x1AC284 count=? (unknown_use_2) - values not dumped */
/begin AXIS_PTS AX_1AC284 "RE axis ptr not OEM" 0x1AC284 RL_IDENTITY 0 NO_INPUT_QUANTITY 1.0 2 FORMAT "%%5.0" /end AXIS_PTS
/* AXIS_PTS 0x1AC800 count=? (unknown_use_2) - values not dumped */
/begin AXIS_PTS AX_1AC800 "RE axis ptr not OEM" 0x1AC800 RL_IDENTITY 0 NO_INPUT_QUANTITY 1.0 2 FORMAT "%%5.0" /end AXIS_PTS
/* AXIS_PTS 0x1AC8E0 count=? (unknown_use_2) - values not dumped */
/begin AXIS_PTS AX_1AC8E0 "RE axis ptr not OEM" 0x1AC8E0 RL_IDENTITY 0 NO_INPUT_QUANTITY 1.0 2 FORMAT "%%5.0" /end AXIS_PTS
/* AXIS_PTS 0x1AD8C4 count=? (unknown_use_2) - values not dumped */
/begin AXIS_PTS AX_1AD8C4 "RE axis ptr not OEM" 0x1AD8C4 RL_IDENTITY 0 NO_INPUT_QUANTITY 1.0 2 FORMAT "%%5.0" /end AXIS_PTS
/* AXIS_PTS 0x1AD8D0 count=? (unknown_use_2) - values not dumped */
/begin AXIS_PTS AX_1AD8D0 "RE axis ptr not OEM" 0x1AD8D0 RL_IDENTITY 0 NO_INPUT_QUANTITY 1.0 2 FORMAT "%%5.0" /end AXIS_PTS
/* AXIS_PTS 0x1AD8E8 count=? (unknown_use_2) - values not dumped */
/begin AXIS_PTS AX_1AD8E8 "RE axis ptr not OEM" 0x1AD8E8 RL_IDENTITY 0 NO_INPUT_QUANTITY 1.0 2 FORMAT "%%5.0" /end AXIS_PTS
/* AXIS_PTS 0x1ADBF0 count=? (unknown_use_2) - values not dumped */
/begin AXIS_PTS AX_1ADBF0 "RE axis ptr not OEM" 0x1ADBF0 RL_IDENTITY 0 NO_INPUT_QUANTITY 1.0 2 FORMAT "%%5.0" /end AXIS_PTS
/* AXIS_PTS 0x1AE87C count=? (unknown_use_2) - values not dumped */
/begin AXIS_PTS AX_1AE87C "RE axis ptr not OEM" 0x1AE87C RL_IDENTITY 0 NO_INPUT_QUANTITY 1.0 2 FORMAT "%%5.0" /end AXIS_PTS
/* AXIS_PTS 0x1AE8C0 count=? (unknown_use_2) - values not dumped */
/begin AXIS_PTS AX_1AE8C0 "RE axis ptr not OEM" 0x1AE8C0 RL_IDENTITY 0 NO_INPUT_QUANTITY 1.0 2 FORMAT "%%5.0" /end AXIS_PTS
/* AXIS_PTS 0x1AE8E0 count=? (unknown_use_2) - values not dumped */
/begin AXIS_PTS AX_1AE8E0 "RE axis ptr not OEM" 0x1AE8E0 RL_IDENTITY 0 NO_INPUT_QUANTITY 1.0 2 FORMAT "%%5.0" /end AXIS_PTS
/* AXIS_PTS 0x1AF224 count=? (unknown_use_2) - values not dumped */
/begin AXIS_PTS AX_1AF224 "RE axis ptr not OEM" 0x1AF224 RL_IDENTITY 0 NO_INPUT_QUANTITY 1.0 2 FORMAT "%%5.0" /end AXIS_PTS
/* AXIS_PTS 0x1AF77C count=? (unknown_use_2) - values not dumped */
/begin AXIS_PTS AX_1AF77C "RE axis ptr not OEM" 0x1AF77C RL_IDENTITY 0 NO_INPUT_QUANTITY 1.0 2 FORMAT "%%5.0" /end AXIS_PTS
/* AXIS_PTS 0x1AF84C count=? (unknown_use_2) - values not dumped */
/begin AXIS_PTS AX_1AF84C "RE axis ptr not OEM" 0x1AF84C RL_IDENTITY 0 NO_INPUT_QUANTITY 1.0 2 FORMAT "%%5.0" /end AXIS_PTS
/* AXIS_PTS 0x1AFBD0 count=? (unknown_use_2) - values not dumped */
/begin AXIS_PTS AX_1AFBD0 "RE axis ptr not OEM" 0x1AFBD0 RL_IDENTITY 0 NO_INPUT_QUANTITY 1.0 2 FORMAT "%%5.0" /end AXIS_PTS
/* AXIS_PTS 0x1B0238 count=? (unknown_use_2) - values not dumped */
/begin AXIS_PTS AX_1B0238 "RE axis ptr not OEM" 0x1B0238 RL_IDENTITY 0 NO_INPUT_QUANTITY 1.0 2 FORMAT "%%5.0" /end AXIS_PTS
/* AXIS_PTS 0x1B03A4 count=? (unknown_use_2) - values not dumped */
/begin AXIS_PTS AX_1B03A4 "RE axis ptr not OEM" 0x1B03A4 RL_IDENTITY 0 NO_INPUT_QUANTITY 1.0 2 FORMAT "%%5.0" /end AXIS_PTS
/* AXIS_PTS 0x1B081C count=? (unknown_use_2) - values not dumped */
/begin AXIS_PTS AX_1B081C "RE axis ptr not OEM" 0x1B081C RL_IDENTITY 0 NO_INPUT_QUANTITY 1.0 2 FORMAT "%%5.0" /end AXIS_PTS
/* AXIS_PTS 0x1B0C34 count=? (unknown_use_2) - values not dumped */
/begin AXIS_PTS AX_1B0C34 "RE axis ptr not OEM" 0x1B0C34 RL_IDENTITY 0 NO_INPUT_QUANTITY 1.0 2 FORMAT "%%5.0" /end AXIS_PTS
/* AXIS_PTS 0x1B1744 count=? (unknown_use_2) - values not dumped */
/begin AXIS_PTS AX_1B1744 "RE axis ptr not OEM" 0x1B1744 RL_IDENTITY 0 NO_INPUT_QUANTITY 1.0 2 FORMAT "%%5.0" /end AXIS_PTS
/* AXIS_PTS 0x1B1874 count=? (unknown_use_2) - values not dumped */
/begin AXIS_PTS AX_1B1874 "RE axis ptr not OEM" 0x1B1874 RL_IDENTITY 0 NO_INPUT_QUANTITY 1.0 2 FORMAT "%%5.0" /end AXIS_PTS
/* AXIS_PTS 0x1B2834 count=? (unknown_use_2) - values not dumped */
/begin AXIS_PTS AX_1B2834 "RE axis ptr not OEM" 0x1B2834 RL_IDENTITY 0 NO_INPUT_QUANTITY 1.0 2 FORMAT "%%5.0" /end AXIS_PTS
/* AXIS_PTS 0x1B3208 count=? (unknown_use_2) - values not dumped */
/begin AXIS_PTS AX_1B3208 "RE axis ptr not OEM" 0x1B3208 RL_IDENTITY 0 NO_INPUT_QUANTITY 1.0 2 FORMAT "%%5.0" /end AXIS_PTS
/* AXIS_PTS 0x1B3808 count=? (unknown_use_2) - values not dumped */
/begin AXIS_PTS AX_1B3808 "RE axis ptr not OEM" 0x1B3808 RL_IDENTITY 0 NO_INPUT_QUANTITY 1.0 2 FORMAT "%%5.0" /end AXIS_PTS
/* AXIS_PTS 0x1B3BE8 count=? (unknown_use_2) - values not dumped */
/begin AXIS_PTS AX_1B3BE8 "RE axis ptr not OEM" 0x1B3BE8 RL_IDENTITY 0 NO_INPUT_QUANTITY 1.0 2 FORMAT "%%5.0" /end AXIS_PTS
/* AXIS_PTS 0x1B40B4 count=? (unknown_use_2) - values not dumped */
/begin AXIS_PTS AX_1B40B4 "RE axis ptr not OEM" 0x1B40B4 RL_IDENTITY 0 NO_INPUT_QUANTITY 1.0 2 FORMAT "%%5.0" /end AXIS_PTS
/* AXIS_PTS 0x1B4290 count=? (unknown_use_2) - values not dumped */
/begin AXIS_PTS AX_1B4290 "RE axis ptr not OEM" 0x1B4290 RL_IDENTITY 0 NO_INPUT_QUANTITY 1.0 2 FORMAT "%%5.0" /end AXIS_PTS
/* AXIS_PTS 0x1B42A0 count=? (unknown_use_2) - values not dumped */
/begin AXIS_PTS AX_1B42A0 "RE axis ptr not OEM" 0x1B42A0 RL_IDENTITY 0 NO_INPUT_QUANTITY 1.0 2 FORMAT "%%5.0" /end AXIS_PTS
/* AXIS_PTS 0x1B46FC count=? (unknown_use_2) - values not dumped */
/begin AXIS_PTS AX_1B46FC "RE axis ptr not OEM" 0x1B46FC RL_IDENTITY 0 NO_INPUT_QUANTITY 1.0 2 FORMAT "%%5.0" /end AXIS_PTS
/* AXIS_PTS 0x1B4738 count=? (unknown_use_2) - values not dumped */
/begin AXIS_PTS AX_1B4738 "RE axis ptr not OEM" 0x1B4738 RL_IDENTITY 0 NO_INPUT_QUANTITY 1.0 2 FORMAT "%%5.0" /end AXIS_PTS
/* AXIS_PTS 0x1B4870 count=? (unknown_use_2) - values not dumped */
/begin AXIS_PTS AX_1B4870 "RE axis ptr not OEM" 0x1B4870 RL_IDENTITY 0 NO_INPUT_QUANTITY 1.0 2 FORMAT "%%5.0" /end AXIS_PTS
/* AXIS_PTS 0x1B491C count=? (unknown_use_2) - values not dumped */
/begin AXIS_PTS AX_1B491C "RE axis ptr not OEM" 0x1B491C RL_IDENTITY 0 NO_INPUT_QUANTITY 1.0 2 FORMAT "%%5.0" /end AXIS_PTS
/* AXIS_PTS 0x1B4BF0 count=? (unknown_use_2) - values not dumped */
/begin AXIS_PTS AX_1B4BF0 "RE axis ptr not OEM" 0x1B4BF0 RL_IDENTITY 0 NO_INPUT_QUANTITY 1.0 2 FORMAT "%%5.0" /end AXIS_PTS
/* AXIS_PTS 0x1B4FF4 count=? (unknown_use_2) - values not dumped */
/begin AXIS_PTS AX_1B4FF4 "RE axis ptr not OEM" 0x1B4FF4 RL_IDENTITY 0 NO_INPUT_QUANTITY 1.0 2 FORMAT "%%5.0" /end AXIS_PTS
/* AXIS_PTS 0x1B5814 count=? (unknown_use_2) - values not dumped */
/begin AXIS_PTS AX_1B5814 "RE axis ptr not OEM" 0x1B5814 RL_IDENTITY 0 NO_INPUT_QUANTITY 1.0 2 FORMAT "%%5.0" /end AXIS_PTS
/* AXIS_PTS 0x1B5820 count=? (unknown_use_2) - values not dumped */
/begin AXIS_PTS AX_1B5820 "RE axis ptr not OEM" 0x1B5820 RL_IDENTITY 0 NO_INPUT_QUANTITY 1.0 2 FORMAT "%%5.0" /end AXIS_PTS
/* AXIS_PTS 0x1B582C count=? (unknown_use_2) - values not dumped */
/begin AXIS_PTS AX_1B582C "RE axis ptr not OEM" 0x1B582C RL_IDENTITY 0 NO_INPUT_QUANTITY 1.0 2 FORMAT "%%5.0" /end AXIS_PTS
/* AXIS_PTS 0x1B5C44 count=? (unknown_use_2) - values not dumped */
/begin AXIS_PTS AX_1B5C44 "RE axis ptr not OEM" 0x1B5C44 RL_IDENTITY 0 NO_INPUT_QUANTITY 1.0 2 FORMAT "%%5.0" /end AXIS_PTS
/* AXIS_PTS 0x1B675C count=? (unknown_use_2) - values not dumped */
/begin AXIS_PTS AX_1B675C "RE axis ptr not OEM" 0x1B675C RL_IDENTITY 0 NO_INPUT_QUANTITY 1.0 2 FORMAT "%%5.0" /end AXIS_PTS
/* AXIS_PTS 0x1B6C7C count=? (unknown_use_2) - values not dumped */
/begin AXIS_PTS AX_1B6C7C "RE axis ptr not OEM" 0x1B6C7C RL_IDENTITY 0 NO_INPUT_QUANTITY 1.0 2 FORMAT "%%5.0" /end AXIS_PTS
/* AXIS_PTS 0x1B76F0 count=? (unknown_use_2) - values not dumped */
/begin AXIS_PTS AX_1B76F0 "RE axis ptr not OEM" 0x1B76F0 RL_IDENTITY 0 NO_INPUT_QUANTITY 1.0 2 FORMAT "%%5.0" /end AXIS_PTS
/* AXIS_PTS 0x1B7904 count=? (unknown_use_2) - values not dumped */
/begin AXIS_PTS AX_1B7904 "RE axis ptr not OEM" 0x1B7904 RL_IDENTITY 0 NO_INPUT_QUANTITY 1.0 2 FORMAT "%%5.0" /end AXIS_PTS
/* AXIS_PTS 0x1B79C0 count=? (unknown_use_2) - values not dumped */
/begin AXIS_PTS AX_1B79C0 "RE axis ptr not OEM" 0x1B79C0 RL_IDENTITY 0 NO_INPUT_QUANTITY 1.0 2 FORMAT "%%5.0" /end AXIS_PTS
/* AXIS_PTS 0x1B7BD4 count=? (unknown_use_2) - values not dumped */
/begin AXIS_PTS AX_1B7BD4 "RE axis ptr not OEM" 0x1B7BD4 RL_IDENTITY 0 NO_INPUT_QUANTITY 1.0 2 FORMAT "%%5.0" /end AXIS_PTS
/* AXIS_PTS 0x1B7C00 count=? (unknown_use_2) - values not dumped */
/begin AXIS_PTS AX_1B7C00 "RE axis ptr not OEM" 0x1B7C00 RL_IDENTITY 0 NO_INPUT_QUANTITY 1.0 2 FORMAT "%%5.0" /end AXIS_PTS
/* AXIS_PTS 0x1B7C0C count=? (unknown_use_2) - values not dumped */
/begin AXIS_PTS AX_1B7C0C "RE axis ptr not OEM" 0x1B7C0C RL_IDENTITY 0 NO_INPUT_QUANTITY 1.0 2 FORMAT "%%5.0" /end AXIS_PTS
/* AXIS_PTS 0x1B7C18 count=? (unknown_use_2) - values not dumped */
/begin AXIS_PTS AX_1B7C18 "RE axis ptr not OEM" 0x1B7C18 RL_IDENTITY 0 NO_INPUT_QUANTITY 1.0 2 FORMAT "%%5.0" /end AXIS_PTS
/* AXIS_PTS 0x1B8938 count=? (unknown_use_2) - values not dumped */
/begin AXIS_PTS AX_1B8938 "RE axis ptr not OEM" 0x1B8938 RL_IDENTITY 0 NO_INPUT_QUANTITY 1.0 2 FORMAT "%%5.0" /end AXIS_PTS
/* AXIS_PTS 0x1B9940 count=? (unknown_use_2) - values not dumped */
/begin AXIS_PTS AX_1B9940 "RE axis ptr not OEM" 0x1B9940 RL_IDENTITY 0 NO_INPUT_QUANTITY 1.0 2 FORMAT "%%5.0" /end AXIS_PTS
/* AXIS_PTS 0x1B9ADC count=? (unknown_use_2) - values not dumped */
/begin AXIS_PTS AX_1B9ADC "RE axis ptr not OEM" 0x1B9ADC RL_IDENTITY 0 NO_INPUT_QUANTITY 1.0 2 FORMAT "%%5.0" /end AXIS_PTS
/* AXIS_PTS 0x1B9AE8 count=? (unknown_use_2) - values not dumped */
/begin AXIS_PTS AX_1B9AE8 "RE axis ptr not OEM" 0x1B9AE8 RL_IDENTITY 0 NO_INPUT_QUANTITY 1.0 2 FORMAT "%%5.0" /end AXIS_PTS
/* AXIS_PTS 0x1BA9D8 count=? (unknown_use_2) - values not dumped */
/begin AXIS_PTS AX_1BA9D8 "RE axis ptr not OEM" 0x1BA9D8 RL_IDENTITY 0 NO_INPUT_QUANTITY 1.0 2 FORMAT "%%5.0" /end AXIS_PTS
/* AXIS_PTS 0x1BB96C count=? (unknown_use_2) - values not dumped */
/begin AXIS_PTS AX_1BB96C "RE axis ptr not OEM" 0x1BB96C RL_IDENTITY 0 NO_INPUT_QUANTITY 1.0 2 FORMAT "%%5.0" /end AXIS_PTS
/* AXIS_PTS 0x1BB9F8 count=? (unknown_use_2) - values not dumped */
/begin AXIS_PTS AX_1BB9F8 "RE axis ptr not OEM" 0x1BB9F8 RL_IDENTITY 0 NO_INPUT_QUANTITY 1.0 2 FORMAT "%%5.0" /end AXIS_PTS
/* AXIS_PTS 0x1BC8E8 count=? (unknown_use_2) - values not dumped */
/begin AXIS_PTS AX_1BC8E8 "RE axis ptr not OEM" 0x1BC8E8 RL_IDENTITY 0 NO_INPUT_QUANTITY 1.0 2 FORMAT "%%5.0" /end AXIS_PTS
/* AXIS_PTS 0x1BC8F4 count=? (unknown_use_2) - values not dumped */
/begin AXIS_PTS AX_1BC8F4 "RE axis ptr not OEM" 0x1BC8F4 RL_IDENTITY 0 NO_INPUT_QUANTITY 1.0 2 FORMAT "%%5.0" /end AXIS_PTS
/* AXIS_PTS 0x1BCAF8 count=? (unknown_use_2) - values not dumped */
/begin AXIS_PTS AX_1BCAF8 "RE axis ptr not OEM" 0x1BCAF8 RL_IDENTITY 0 NO_INPUT_QUANTITY 1.0 2 FORMAT "%%5.0" /end AXIS_PTS
/* AXIS_PTS 0x1BD8D8 count=? (unknown_use_2) - values not dumped */
/begin AXIS_PTS AX_1BD8D8 "RE axis ptr not OEM" 0x1BD8D8 RL_IDENTITY 0 NO_INPUT_QUANTITY 1.0 2 FORMAT "%%5.0" /end AXIS_PTS
/* AXIS_PTS 0x1BD958 count=? (unknown_use_2) - values not dumped */
/begin AXIS_PTS AX_1BD958 "RE axis ptr not OEM" 0x1BD958 RL_IDENTITY 0 NO_INPUT_QUANTITY 1.0 2 FORMAT "%%5.0" /end AXIS_PTS
/* AXIS_PTS 0x1BF6B4 count=? (unknown_use_2) - values not dumped */
/begin AXIS_PTS AX_1BF6B4 "RE axis ptr not OEM" 0x1BF6B4 RL_IDENTITY 0 NO_INPUT_QUANTITY 1.0 2 FORMAT "%%5.0" /end AXIS_PTS
/begin CHARACTERISTIC vmax3 "atlas9979 vmax3 / Maximum vehicle speed (IdName Caddy 9979 - verifier sur 9980)" VALUE 0x18047C RL_IDENTITY 0 NO_INPUT_QUANTITY 1.0 /end CHARACTERISTIC
/begin CHARACTERISTIC vmax3_18047E "atlas9979 vmax3@18047E / Maximum vehicle speed (IdName Caddy 9979 - verifier sur" VALUE 0x18047E RL_IDENTITY 0 NO_INPUT_QUANTITY 1.0 /end CHARACTERISTIC
/* src=families fam=B_fam_0054 ax=0x- ay=0x- */
/begin CHARACTERISTIC B_fam_0054_180488 "RE interp_2d_B B_fam_0054 call=0x800C6E3E" VALUE 0x180488 RL_IDENTITY 0 NO_INPUT_QUANTITY 1.0 /end CHARACTERISTIC
/begin CHARACTERISTIC vmax2 "atlas9979 vmax2 / Maximum vehicle speed (IdName Caddy 9979 - verifier sur 9980)" VALUE 0x18048A RL_IDENTITY 0 NO_INPUT_QUANTITY 1.0 /end CHARACTERISTIC
/begin CHARACTERISTIC vmax2_18048C "atlas9979 vmax2@18048C / Maximum vehicle speed (IdName Caddy 9979 - verifier sur" VALUE 0x18048C RL_IDENTITY 0 NO_INPUT_QUANTITY 1.0 /end CHARACTERISTIC
/begin CHARACTERISTIC vmax3_18049E "atlas9979 vmax3@18049E / Maximum vehicle speed (IdName Caddy 9979 - verifier sur" VALUE 0x18049E RL_IDENTITY 0 NO_INPUT_QUANTITY 1.0 /end CHARACTERISTIC
/begin CHARACTERISTIC vmax3_1804A0 "atlas9979 vmax3@1804A0 / Maximum vehicle speed (IdName Caddy 9979 - verifier sur" VALUE 0x1804A0 RL_IDENTITY 0 NO_INPUT_QUANTITY 1.0 /end CHARACTERISTIC
/begin CHARACTERISTIC vmax3_1804A2 "atlas9979 vmax3@1804A2 / Maximum vehicle speed (IdName Caddy 9979 - verifier sur" VALUE 0x1804A2 RL_IDENTITY 0 NO_INPUT_QUANTITY 1.0 /end CHARACTERISTIC
/* src=families fam=B_fam_0048 ax=0x- ay=0x- */
/begin CHARACTERISTIC B_fam_0048_1804D8 "RE interp_2d_B B_fam_0048 call=0x800C6C30" VALUE 0x1804D8 RL_IDENTITY 0 NO_INPUT_QUANTITY 1.0 /end CHARACTERISTIC
/* src=families fam=fam_0107 ax=0x- ay=0x- */
/begin CHARACTERISTIC map_horsA2L_1835AC "RE interp_2d fam_0107 call=0x800DCFF4; RE map_interp_D D_fam_0108 call=0x800DCF3" VALUE 0x180550 RL_IDENTITY 0 NO_INPUT_QUANTITY 1.0 /end CHARACTERISTIC
/* src=families fam=fam_0108 ax=0x- ay=0x- */
/begin CHARACTERISTIC map_horsA2L_1845B8 "RE interp_2d fam_0108 call=0x800DD46E; RE map_interp_D D_fam_0109 call=0x800DD3B" VALUE 0x18055C RL_IDENTITY 0 NO_INPUT_QUANTITY 1.0 /end CHARACTERISTIC
/* src=families fam=fam_0162 ax=0x17D54C ay=0x17A54C */
/begin CHARACTERISTIC fam_0162_1805FC "RE interp_2d fam_0162 call=0x800E9EF4; RE map_interp_C C_fam_0319 call=0x800E9EA" MAP 0x1805FC RL_IDENTITY 0 NO_INPUT_QUANTITY 1.0 FORMAT "%%5.0"
 /begin AXIS_DESCR COM_AXIS NO_INPUT_QUANTITY NO_COMPU_METHOD 2 AXIS_PTS_REF AX_17D54C /end AXIS_DESCR
 /begin AXIS_DESCR COM_AXIS NO_INPUT_QUANTITY NO_COMPU_METHOD 2 AXIS_PTS_REF AX_17A54C /end AXIS_DESCR
/end CHARACTERISTIC
/* src=families fam=fam_0160 ax=0x17B558 ay=0x- */ /* STUB unknown size; axis_x=0x17B558 axis_y=0x- */
/begin CHARACTERISTIC map_horsA2L_180688 "RE interp_2d fam_0160 call=0x800E9E8C" VALUE 0x180688 RL_IDENTITY 0 NO_INPUT_QUANTITY 1.0 /end CHARACTERISTIC
/* src=families fam=D_fam_0205 ax=0x- ay=0x- */
/begin CHARACTERISTIC D_fam_0205_18146C "RE map_interp_D D_fam_0205 call=0x800C9344" VALUE 0x18146C RL_IDENTITY 0 NO_INPUT_QUANTITY 1.0 /end CHARACTERISTIC
/* src=families fam=B_fam_0029 ax=0x- ay=0x- */
/begin CHARACTERISTIC B_fam_0029_181484 "RE interp_2d_B B_fam_0029 call=0x800C6BD0" VALUE 0x181484 RL_IDENTITY 0 NO_INPUT_QUANTITY 1.0 /end CHARACTERISTIC
/* src=families fam=M_fam_0018 ax=0x- ay=0x- */
/begin CHARACTERISTIC M_fam_0018_181494 "RE map_interp_M M_fam_0018 call=0x800A32CA" VALUE 0x181494 RL_IDENTITY 0 NO_INPUT_QUANTITY 1.0 /end CHARACTERISTIC
/* src=families fam=B_fam_0050 ax=0x- ay=0x- */
/begin CHARACTERISTIC B_fam_0050_1814B8 "RE interp_2d_B B_fam_0050 call=0x800C6C84" VALUE 0x1814B8 RL_IDENTITY 0 NO_INPUT_QUANTITY 1.0 /end CHARACTERISTIC
/* src=families fam=B_fam_0033 ax=0x- ay=0x- */
/begin CHARACTERISTIC B_fam_0033_181508 "RE interp_2d_B B_fam_0033 call=0x800817A4" VALUE 0x181508 RL_IDENTITY 0 NO_INPUT_QUANTITY 1.0 /end CHARACTERISTIC
/* src=families fam=fam_0158 ax=0x- ay=0x- */
/begin CHARACTERISTIC map_horsA2L_183540 "RE interp_2d fam_0158 call=0x800E9DA0" VALUE 0x18158C RL_IDENTITY 0 NO_INPUT_QUANTITY 1.0 /end CHARACTERISTIC
/* src=families fam=G_fam_0138 ax=0x- ay=0x- */
/begin CHARACTERISTIC G_fam_0138_1815A0 "RE map_interp_G G_fam_0138 call=0x800E5EDE" VALUE 0x1815A0 RL_IDENTITY 0 NO_INPUT_QUANTITY 1.0 /end CHARACTERISTIC
/* src=families fam=J_fam_0046 ax=0x- ay=0x- */
/begin CHARACTERISTIC J_fam_0046_1815EC "RE map_interp_J J_fam_0046 call=0x800E4DBA" VALUE 0x1815EC RL_IDENTITY 0 NO_INPUT_QUANTITY 1.0 /end CHARACTERISTIC
/* src=families fam=C_fam_0313 ax=0x- ay=0x- */
/begin CHARACTERISTIC C_fam_0313_181638 "RE map_interp_C C_fam_0313 call=0x800E60A2; RE map_interp_D D_fam_0218 call=0x80" VALUE 0x181638 RL_IDENTITY 0 NO_INPUT_QUANTITY 1.0 /end CHARACTERISTIC
/* src=families fam=fam_0155 ax=0x184550 ay=0x17E558 */
/begin CHARACTERISTIC map_horsA2L_1816B8 "RE interp_2d fam_0155 call=0x800DE6A8" MAP 0x1816B8 RL_IDENTITY 0 NO_INPUT_QUANTITY 1.0 FORMAT "%%5.0"
 /begin AXIS_DESCR COM_AXIS NO_INPUT_QUANTITY NO_COMPU_METHOD 2 AXIS_PTS_REF AX_184550 /end AXIS_DESCR
 /begin AXIS_DESCR COM_AXIS NO_INPUT_QUANTITY NO_COMPU_METHOD 2 AXIS_PTS_REF AX_17E558 /end AXIS_DESCR
/end CHARACTERISTIC
/* src=families fam=fam_0152 ax=0x- ay=0x- */
/begin CHARACTERISTIC map_horsA2L_1816C8 "RE interp_2d fam_0152 call=0x800DD558" VALUE 0x1816C8 RL_IDENTITY 0 NO_INPUT_QUANTITY 1.0 /end CHARACTERISTIC
/* src=families fam=C_fam_0346 ax=0x- ay=0x- */
/begin CHARACTERISTIC C_fam_0346_182450 "RE map_interp_C C_fam_0346 call=0x8012273C; RE map_interp_D D_fam_0236 call=0x80" VALUE 0x182450 RL_IDENTITY 0 NO_INPUT_QUANTITY 1.0 /end CHARACTERISTIC
/* src=families fam=B_fam_0011 ax=0x- ay=0x- */
/begin CHARACTERISTIC B_fam_0011_182484 "RE interp_2d_B B_fam_0011 call=0x80081A3C; RE map_interp_M M_fam_0015 call=0x800" VALUE 0x182484 RL_IDENTITY 0 NO_INPUT_QUANTITY 1.0 /end CHARACTERISTIC
/* src=families fam=B_fam_0011 ax=0x- ay=0x- */
/begin CHARACTERISTIC B_fam_0011_182494 "RE interp_2d_B B_fam_0011 call=0x80081B50; RE map_interp_M M_fam_0002 call=0x800" VALUE 0x182494 RL_IDENTITY 0 NO_INPUT_QUANTITY 1.0 /end CHARACTERISTIC
/* src=families fam=fam_0146 ax=0x181484 ay=0x- */ /* STUB unknown size; axis_x=0x181484 axis_y=0x- */
/begin CHARACTERISTIC fam_0146_1824A4 "RE interp_2d fam_0146 call=0x800C6D8A; RE interp_2d_B B_fam_0051 call=0x800C6CFA" VALUE 0x1824A4 RL_IDENTITY 0 NO_INPUT_QUANTITY 1.0 /end CHARACTERISTIC
/* src=families fam=L_fam_0033 ax=0x- ay=0x- */
/begin CHARACTERISTIC L_fam_0033_1824B8 "RE map_interp_L L_fam_0033 call=0x8008AA7E" VALUE 0x1824B8 RL_IDENTITY 0 NO_INPUT_QUANTITY 1.0 /end CHARACTERISTIC
/* src=families fam=fam_0144 ax=0x- ay=0x- */
/begin CHARACTERISTIC map_horsA2L_1824A4 "RE interp_2d fam_0144 call=0x800C6C06" VALUE 0x1824D8 RL_IDENTITY 0 NO_INPUT_QUANTITY 1.0 /end CHARACTERISTIC
/* src=families fam=E_fam_0049 ax=0x- ay=0x- */
/begin CHARACTERISTIC E_fam_0049_182538 "RE map_interp_E E_fam_0049 call=0x80081954" VALUE 0x182538 RL_IDENTITY 0 NO_INPUT_QUANTITY 1.0 /end CHARACTERISTIC
/* src=horsA2L fam=- ax=0x182558 ay=0x183550 */ /* STUB unknown size; axis_x=0x182558 axis_y=0x183550 */
/begin CHARACTERISTIC map_horsA2L_182558 "low: pas dans l A2L/atlas 9979 (299 maps WinOLS) - nommer a la main si besoin; i" VALUE 0x182558 RL_IDENTITY 0 NO_INPUT_QUANTITY 1.0 /end CHARACTERISTIC
/* src=horsA2L fam=- ax=0x182564 ay=0x18355C */ /* STUB unknown size; axis_x=0x182564 axis_y=0x18355C */
/begin CHARACTERISTIC map_horsA2L_182564 "low: pas dans l A2L/atlas 9979 (299 maps WinOLS) - nommer a la main si besoin; i" VALUE 0x182564 RL_IDENTITY 0 NO_INPUT_QUANTITY 1.0 /end CHARACTERISTIC
/* src=families fam=fam_0157 ax=0x182570 ay=0x17F550 */
/begin CHARACTERISTIC map_horsA2L_182570 "RE interp_2d fam_0157 call=0x800E9A08" MAP 0x182570 RL_IDENTITY 0 NO_INPUT_QUANTITY 1.0 FORMAT "%%5.0"
 /begin AXIS_DESCR COM_AXIS NO_INPUT_QUANTITY NO_COMPU_METHOD 2 AXIS_PTS_REF AX_182570 /end AXIS_DESCR
 /begin AXIS_DESCR COM_AXIS NO_INPUT_QUANTITY NO_COMPU_METHOD 2 AXIS_PTS_REF AX_17F550 /end AXIS_DESCR
/end CHARACTERISTIC
/* src=families fam=C_fam_0314 ax=0x- ay=0x- */
/begin CHARACTERISTIC C_fam_0314_182608 "RE map_interp_C C_fam_0314 call=0x800E615C; RE map_interp_F F_fam_0174 call=0x80" VALUE 0x182608 RL_IDENTITY 0 NO_INPUT_QUANTITY 1.0 /end CHARACTERISTIC
/* src=families fam=E_fam_0084 ax=0x- ay=0x- */
/begin CHARACTERISTIC E_fam_0084_183400 "RE map_interp_E E_fam_0084 call=0x80053F36" VALUE 0x183400 RL_IDENTITY 0 NO_INPUT_QUANTITY 1.0 /end CHARACTERISTIC
/* src=families fam=C_fam_0283 ax=0x- ay=0x- */
/begin CHARACTERISTIC C_fam_0283_183410 "RE map_interp_C C_fam_0283 call=0x80057410" VALUE 0x183410 RL_IDENTITY 0 NO_INPUT_QUANTITY 1.0 /end CHARACTERISTIC
/* src=families fam=E_fam_0085 ax=0x- ay=0x- */
/begin CHARACTERISTIC E_fam_0085_183420 "RE map_interp_E E_fam_0085 call=0x80053F62" VALUE 0x183420 RL_IDENTITY 0 NO_INPUT_QUANTITY 1.0 /end CHARACTERISTIC
/* src=families fam=E_fam_0088 ax=0x- ay=0x- */
/begin CHARACTERISTIC E_fam_0088_183430 "RE map_interp_E E_fam_0088 call=0x8005843E" VALUE 0x183430 RL_IDENTITY 0 NO_INPUT_QUANTITY 1.0 /end CHARACTERISTIC
/* src=families fam=C_fam_0281 ax=0x- ay=0x- */
/begin CHARACTERISTIC C_fam_0281_18343C "RE map_interp_C C_fam_0281 call=0x80052C30" VALUE 0x18343C RL_IDENTITY 0 NO_INPUT_QUANTITY 1.0 /end CHARACTERISTIC
/* src=families fam=L_fam_0044 ax=0x- ay=0x- */
/begin CHARACTERISTIC L_fam_0044_18344C "RE map_interp_L L_fam_0044 call=0x800E1DF2" VALUE 0x18344C RL_IDENTITY 0 NO_INPUT_QUANTITY 1.0 /end CHARACTERISTIC
/* src=families fam=I_fam_0105 ax=0x- ay=0x- */
/begin CHARACTERISTIC I_fam_0105_18345C "RE map_interp_I I_fam_0105 call=0x800C935C" VALUE 0x18345C RL_IDENTITY 0 NO_INPUT_QUANTITY 1.0 /end CHARACTERISTIC
/* src=families fam=C_fam_0338 ax=0x- ay=0x- */
/begin CHARACTERISTIC C_fam_0338_18346C "RE map_interp_C C_fam_0338 call=0x801099F6" VALUE 0x18346C RL_IDENTITY 0 NO_INPUT_QUANTITY 1.0 /end CHARACTERISTIC
/* src=families fam=L_fam_0039 ax=0x- ay=0x- */
/begin CHARACTERISTIC L_fam_0039_183488 "RE map_interp_L L_fam_0039 call=0x8008A8EE" VALUE 0x183488 RL_IDENTITY 0 NO_INPUT_QUANTITY 1.0 /end CHARACTERISTIC
/* src=families fam=L_fam_0037 ax=0x- ay=0x- */
/begin CHARACTERISTIC L_fam_0037_183498 "RE map_interp_L L_fam_0037 call=0x80081832" VALUE 0x183498 RL_IDENTITY 0 NO_INPUT_QUANTITY 1.0 /end CHARACTERISTIC
/* src=families fam=L_fam_0038 ax=0x- ay=0x- */
/begin CHARACTERISTIC L_fam_0038_1834B8 "RE map_interp_L L_fam_0038 call=0x80081674" VALUE 0x1834B8 RL_IDENTITY 0 NO_INPUT_QUANTITY 1.0 /end CHARACTERISTIC
/* src=families fam=B_fam_0049 ax=0x- ay=0x- */
/begin CHARACTERISTIC B_fam_0049_1834D8 "RE interp_2d_B B_fam_0049 call=0x800C6C56" VALUE 0x1834D8 RL_IDENTITY 0 NO_INPUT_QUANTITY 1.0 /end CHARACTERISTIC
/* src=families fam=C_fam_0183 ax=0x- ay=0x- */
/begin CHARACTERISTIC C_fam_0183_183508 "RE map_interp_C C_fam_0183 call=0x800C6D5C" VALUE 0x183508 RL_IDENTITY 0 NO_INPUT_QUANTITY 1.0 /end CHARACTERISTIC
/* src=families fam=fam_0024 ax=0x17D454 ay=0x17C460 */
/begin CHARACTERISTIC map_horsA2L_183518 "RE interp_2d fam_0024 call=0x800C6E6C" MAP 0x183518 RL_IDENTITY 0 NO_INPUT_QUANTITY 1.0 FORMAT "%%5.0"
 /begin AXIS_DESCR COM_AXIS NO_INPUT_QUANTITY NO_COMPU_METHOD 2 AXIS_PTS_REF AX_17D454 /end AXIS_DESCR
 /begin AXIS_DESCR COM_AXIS NO_INPUT_QUANTITY NO_COMPU_METHOD 2 AXIS_PTS_REF AX_17C460 /end AXIS_DESCR
/end CHARACTERISTIC
/* src=horsA2L fam=- ax=0x183540 ay=0x18158C */ /* STUB unknown size; axis_x=0x183540 axis_y=0x18158C */
/begin CHARACTERISTIC map_horsA2L_183540_183540 "low: pas dans l A2L/atlas 9979 (299 maps WinOLS) - nommer a la main si besoin; i" VALUE 0x183540 RL_IDENTITY 0 NO_INPUT_QUANTITY 1.0 /end CHARACTERISTIC
/* src=families fam=fam_0127 ax=0x- ay=0x- */
/begin CHARACTERISTIC map_horsA2L_182558_183550 "RE interp_2d fam_0127 call=0x800DD238" VALUE 0x183550 RL_IDENTITY 0 NO_INPUT_QUANTITY 1.0 /end CHARACTERISTIC
/* src=families fam=fam_0153 ax=0x- ay=0x- */
/begin CHARACTERISTIC map_horsA2L_182564_18355C "RE interp_2d fam_0153 call=0x800DD65E" VALUE 0x18355C RL_IDENTITY 0 NO_INPUT_QUANTITY 1.0 /end CHARACTERISTIC
/* src=families fam=fam_0126 ax=0x18357C ay=0x17E548 */
/begin CHARACTERISTIC map_horsA2L_18357C "RE interp_2d fam_0126 call=0x800E9AEA; RE map_interp_C C_fam_0248 call=0x800E9B0" MAP 0x18357C RL_IDENTITY 0 NO_INPUT_QUANTITY 1.0 FORMAT "%%5.0"
 /begin AXIS_DESCR COM_AXIS NO_INPUT_QUANTITY NO_COMPU_METHOD 2 AXIS_PTS_REF AX_18357C /end AXIS_DESCR
 /begin AXIS_DESCR COM_AXIS NO_INPUT_QUANTITY NO_COMPU_METHOD 2 AXIS_PTS_REF AX_17E548 /end AXIS_DESCR
/end CHARACTERISTIC
/* src=families fam=fam_0154 ax=0x- ay=0x- */
/begin CHARACTERISTIC map_horsA2L_185550 "RE interp_2d fam_0154 call=0x800DE670" VALUE 0x183588 RL_IDENTITY 0 NO_INPUT_QUANTITY 1.0 /end CHARACTERISTIC
/* src=families fam=D_fam_0129 ax=0x- ay=0x- */
/begin CHARACTERISTIC D_fam_0129_183598 "RE map_interp_D D_fam_0129 call=0x800DE8A0; RE map_interp_I I_fam_0024 call=0x80" VALUE 0x183598 RL_IDENTITY 0 NO_INPUT_QUANTITY 1.0 /end CHARACTERISTIC
/begin CHARACTERISTIC map_horsA2L_1835AC_1835AC "low: pas dans l A2L/atlas 9979 (299 maps WinOLS) - nommer a la main si besoin; i" VALUE 0x1835AC RL_IDENTITY 0 NO_INPUT_QUANTITY 1.0 /end CHARACTERISTIC
/* src=families fam=fam_0164 ax=0x- ay=0x- */
/begin CHARACTERISTIC fam_0164_1835F8 "RE interp_2d fam_0164 call=0x800ED208; RE map_interp_C C_fam_0321 call=0x800ED1C" VALUE 0x1835F8 RL_IDENTITY 0 NO_INPUT_QUANTITY 1.0 /end CHARACTERISTIC
/* src=families fam=fam_0109 ax=0x184564 ay=0x17E568 */
/begin CHARACTERISTIC map_horsA2L_1836A8 "RE interp_2d fam_0109 call=0x800E9AA4" MAP 0x1836A8 RL_IDENTITY 0 NO_INPUT_QUANTITY 1.0 FORMAT "%%5.0"
 /begin AXIS_DESCR COM_AXIS NO_INPUT_QUANTITY NO_COMPU_METHOD 2 AXIS_PTS_REF AX_184564 /end AXIS_DESCR
 /begin AXIS_DESCR COM_AXIS NO_INPUT_QUANTITY NO_COMPU_METHOD 2 AXIS_PTS_REF AX_17E568 /end AXIS_DESCR
/end CHARACTERISTIC
/begin CHARACTERISTIC scal_trq_cluth "atlas9979 scal_trq_cluth / Monitored scaling factor for requested torque at clut" MAP 0x183F74 RL_IDENTITY 0 NO_INPUT_QUANTITY 1.0 FORMAT "%%5.0"
 /begin AXIS_DESCR COM_AXIS NO_INPUT_QUANTITY NO_COMPU_METHOD 8 AXIS_PTS_REF AX_183F09 /end AXIS_DESCR
 /begin AXIS_DESCR COM_AXIS NO_INPUT_QUANTITY NO_COMPU_METHOD 8 AXIS_PTS_REF AX_183EF6 /end AXIS_DESCR
/end CHARACTERISTIC
/begin CHARACTERISTIC scal_trq_cluth_183FB4 "atlas9979 scal_trq_cluth@183FB4 / Monitored scaling factor for requested torque " MAP 0x183FB4 RL_IDENTITY 0 NO_INPUT_QUANTITY 1.0 FORMAT "%%5.0"
 /begin AXIS_DESCR COM_AXIS NO_INPUT_QUANTITY NO_COMPU_METHOD 8 AXIS_PTS_REF AX_183F09 /end AXIS_DESCR
 /begin AXIS_DESCR COM_AXIS NO_INPUT_QUANTITY NO_COMPU_METHOD 8 AXIS_PTS_REF AX_183EF6 /end AXIS_DESCR
/end CHARACTERISTIC
/begin CHARACTERISTIC scal_trq_cluth_183FF4 "atlas9979 scal_trq_cluth@183FF4 / Monitored scaling factor for requested torque " MAP 0x183FF4 RL_IDENTITY 0 NO_INPUT_QUANTITY 1.0 FORMAT "%%5.0"
 /begin AXIS_DESCR COM_AXIS NO_INPUT_QUANTITY NO_COMPU_METHOD 8 AXIS_PTS_REF AX_183F09 /end AXIS_DESCR
 /begin AXIS_DESCR COM_AXIS NO_INPUT_QUANTITY NO_COMPU_METHOD 8 AXIS_PTS_REF AX_183EF6 /end AXIS_DESCR
/end CHARACTERISTIC
/begin CHARACTERISTIC scal_trq_cluth_184034 "atlas9979 scal_trq_cluth@184034 / Monitored scaling factor for requested torque " MAP 0x184034 RL_IDENTITY 0 NO_INPUT_QUANTITY 1.0 FORMAT "%%5.0"
 /begin AXIS_DESCR COM_AXIS NO_INPUT_QUANTITY NO_COMPU_METHOD 8 AXIS_PTS_REF AX_183F09 /end AXIS_DESCR
 /begin AXIS_DESCR COM_AXIS NO_INPUT_QUANTITY NO_COMPU_METHOD 8 AXIS_PTS_REF AX_183EF6 /end AXIS_DESCR
/end CHARACTERISTIC
/* src=families fam=B_fam_0044 ax=0x- ay=0x- */
/begin CHARACTERISTIC B_fam_0044_18440C "RE interp_2d_B B_fam_0044 call=0x8006202E" VALUE 0x18440C RL_IDENTITY 0 NO_INPUT_QUANTITY 1.0 /end CHARACTERISTIC
/* src=families fam=E_fam_0116 ax=0x- ay=0x- */
/begin CHARACTERISTIC E_fam_0116_184444 "RE map_interp_E E_fam_0116 call=0x80109A12" VALUE 0x184444 RL_IDENTITY 0 NO_INPUT_QUANTITY 1.0 /end CHARACTERISTIC
/* src=families fam=C_fam_0303 ax=0x- ay=0x- */
/begin CHARACTERISTIC C_fam_0303_184474 "RE map_interp_C C_fam_0303 call=0x800C93AE" VALUE 0x184474 RL_IDENTITY 0 NO_INPUT_QUANTITY 1.0 /end CHARACTERISTIC
/* src=families fam=fam_0009 ax=0x17E444 ay=0x17B450 */
/begin CHARACTERISTIC map_horsA2L_184498 "RE interp_2d fam_0009 call=0x80081A9A" MAP 0x184498 RL_IDENTITY 0 NO_INPUT_QUANTITY 1.0 FORMAT "%%5.0"
 /begin AXIS_DESCR COM_AXIS NO_INPUT_QUANTITY NO_COMPU_METHOD 2 AXIS_PTS_REF AX_17E444 /end AXIS_DESCR
 /begin AXIS_DESCR COM_AXIS NO_INPUT_QUANTITY NO_COMPU_METHOD 2 AXIS_PTS_REF AX_17B450 /end AXIS_DESCR
/end CHARACTERISTIC
/* src=families fam=B_fam_0007 ax=0x- ay=0x- */
/begin CHARACTERISTIC B_fam_0007_1844C8 "RE interp_2d_B B_fam_0007 call=0x8008190E" VALUE 0x1844C8 RL_IDENTITY 0 NO_INPUT_QUANTITY 1.0 /end CHARACTERISTIC
/* src=families fam=B_fam_0052 ax=0x- ay=0x- */
/begin CHARACTERISTIC B_fam_0052_184518 "RE interp_2d_B B_fam_0052 call=0x800C6DC6" VALUE 0x184518 RL_IDENTITY 0 NO_INPUT_QUANTITY 1.0 /end CHARACTERISTIC
/* src=families fam=C_fam_0310 ax=0x- ay=0x- */
/begin CHARACTERISTIC C_fam_0310_184550 "RE map_interp_C C_fam_0310 call=0x800DE6C4" VALUE 0x184550 RL_IDENTITY 0 NO_INPUT_QUANTITY 1.0 /end CHARACTERISTIC
/* src=families fam=C_fam_0195 ax=0x- ay=0x- */
/begin CHARACTERISTIC C_fam_0195_184564 "RE map_interp_C C_fam_0195 call=0x800E9ABC" VALUE 0x184564 RL_IDENTITY 0 NO_INPUT_QUANTITY 1.0 /end CHARACTERISTIC
/* src=families fam=D_fam_0179 ax=0x- ay=0x- */
/begin CHARACTERISTIC D_fam_0179_184578 "RE map_interp_D D_fam_0179 call=0x8009A8CE; RE map_interp_F F_fam_0140 call=0x80" VALUE 0x184578 RL_IDENTITY 0 NO_INPUT_QUANTITY 1.0 /end CHARACTERISTIC
/begin CHARACTERISTIC map_horsA2L_1845A4 "low: pas dans l A2L/atlas 9979 (299 maps WinOLS) - nommer a la main si besoin; i" VALUE 0x1845A4 RL_IDENTITY 0 NO_INPUT_QUANTITY 1.0 /end CHARACTERISTIC
/begin CHARACTERISTIC map_horsA2L_1845B8_1845B8 "low: pas dans l A2L/atlas 9979 (299 maps WinOLS) - nommer a la main si besoin; i" VALUE 0x1845B8 RL_IDENTITY 0 NO_INPUT_QUANTITY 1.0 /end CHARACTERISTIC
/* src=families fam=C_fam_0315 ax=0x- ay=0x- */
/begin CHARACTERISTIC C_fam_0315_1845D0 "RE map_interp_C C_fam_0315 call=0x800E61A4; RE map_interp_F F_fam_0175 call=0x80" VALUE 0x1845D0 RL_IDENTITY 0 NO_INPUT_QUANTITY 1.0 /end CHARACTERISTIC
/* src=families fam=fam_0105 ax=0x178574 ay=0x17C540 */
/begin CHARACTERISTIC map_horsA2L_1845E8 "RE interp_2d fam_0105 call=0x800EA0F6" MAP 0x1845E8 RL_IDENTITY 0 NO_INPUT_QUANTITY 1.0 FORMAT "%%5.0"
 /begin AXIS_DESCR COM_AXIS NO_INPUT_QUANTITY NO_COMPU_METHOD 2 AXIS_PTS_REF AX_178574 /end AXIS_DESCR
 /begin AXIS_DESCR COM_AXIS NO_INPUT_QUANTITY NO_COMPU_METHOD 2 AXIS_PTS_REF AX_17C540 /end AXIS_DESCR
/end CHARACTERISTIC
/begin CHARACTERISTIC map_horsA2L_184678 "low: pas dans l A2L/atlas 9979 (299 maps WinOLS) - nommer a la main si besoin; i" VALUE 0x184678 RL_IDENTITY 0 NO_INPUT_QUANTITY 1.0 /end CHARACTERISTIC
/* src=families fam=B_fam_0045 ax=0x- ay=0x- */
/begin CHARACTERISTIC B_fam_0045_185400 "RE interp_2d_B B_fam_0045 call=0x80062080" VALUE 0x185400 RL_IDENTITY 0 NO_INPUT_QUANTITY 1.0 /end CHARACTERISTIC
/* src=families fam=O_fam_0013 ax=0x- ay=0x- */
/begin CHARACTERISTIC O_fam_0013_185434 "RE map_interp_O O_fam_0013 call=0x8005546C" VALUE 0x185434 RL_IDENTITY 0 NO_INPUT_QUANTITY 1.0 /end CHARACTERISTIC
/* src=families fam=C_fam_0304 ax=0x- ay=0x- */
/begin CHARACTERISTIC C_fam_0304_185444 "RE map_interp_C C_fam_0304 call=0x800C94DC" VALUE 0x185444 RL_IDENTITY 0 NO_INPUT_QUANTITY 1.0 /end CHARACTERISTIC
/* src=families fam=fam_0009 ax=0x17E454 ay=0x17B45C */
/begin CHARACTERISTIC map_horsA2L_1854A0 "RE interp_2d fam_0009 call=0x80081BAE" MAP 0x1854A0 RL_IDENTITY 0 NO_INPUT_QUANTITY 1.0 FORMAT "%%5.0"
 /begin AXIS_DESCR COM_AXIS NO_INPUT_QUANTITY NO_COMPU_METHOD 2 AXIS_PTS_REF AX_17E454 /end AXIS_DESCR
 /begin AXIS_DESCR COM_AXIS NO_INPUT_QUANTITY NO_COMPU_METHOD 2 AXIS_PTS_REF AX_17B45C /end AXIS_DESCR
/end CHARACTERISTIC
/* src=families fam=D_fam_0122 ax=0x- ay=0x- */
/begin CHARACTERISTIC D_fam_0122_185544 "RE map_interp_D D_fam_0122 call=0x8009A9BA; RE map_interp_F F_fam_0086 call=0x80" VALUE 0x185544 RL_IDENTITY 0 NO_INPUT_QUANTITY 1.0 /end CHARACTERISTIC
/* src=horsA2L fam=- ax=0x185550 ay=0x183588 */ /* STUB unknown size; axis_x=0x185550 axis_y=0x183588 */
/begin CHARACTERISTIC map_horsA2L_185550_185550 "low: pas dans l A2L/atlas 9979 (299 maps WinOLS) - nommer a la main si besoin; i" VALUE 0x185550 RL_IDENTITY 0 NO_INPUT_QUANTITY 1.0 /end CHARACTERISTIC
/* src=families fam=D_fam_0216 ax=0x- ay=0x- */
/begin CHARACTERISTIC D_fam_0216_185564 "RE map_interp_D D_fam_0216 call=0x800E5F20; RE map_interp_F F_fam_0172 call=0x80" VALUE 0x185564 RL_IDENTITY 0 NO_INPUT_QUANTITY 1.0 /end CHARACTERISTIC
/* src=families fam=fam_0151 ax=0x- ay=0x- */
/begin CHARACTERISTIC map_horsA2L_1855B0 "RE interp_2d fam_0151 call=0x800DD516" VALUE 0x1855B0 RL_IDENTITY 0 NO_INPUT_QUANTITY 1.0 /end CHARACTERISTIC
/* src=families fam=fam_0159 ax=0x- ay=0x- */
/begin CHARACTERISTIC map_horsA2L_1805FC "RE interp_2d fam_0159 call=0x800E9E52; RE map_interp_C C_fam_0318 call=0x800E9E6" VALUE 0x185698 RL_IDENTITY 0 NO_INPUT_QUANTITY 1.0 /end CHARACTERISTIC
/* src=families fam=E_fam_0082 ax=0x- ay=0x- */
/begin CHARACTERISTIC E_fam_0082_1863C8 "RE map_interp_E E_fam_0082 call=0x80053D44" VALUE 0x1863C8 RL_IDENTITY 0 NO_INPUT_QUANTITY 1.0 /end CHARACTERISTIC
/* src=families fam=E_fam_0083 ax=0x- ay=0x- */
/begin CHARACTERISTIC E_fam_0083_1863D4 "RE map_interp_E E_fam_0083 call=0x80053D7A" VALUE 0x1863D4 RL_IDENTITY 0 NO_INPUT_QUANTITY 1.0 /end CHARACTERISTIC
/* src=families fam=C_fam_0337 ax=0x- ay=0x- */
/begin CHARACTERISTIC C_fam_0337_186444 "RE map_interp_C C_fam_0337 call=0x8010993A" VALUE 0x186444 RL_IDENTITY 0 NO_INPUT_QUANTITY 1.0 /end CHARACTERISTIC
/* src=families fam=fam_0143 ax=0x17E40C ay=0x17D408 */
/begin CHARACTERISTIC map_horsA2L_186450 "RE interp_2d fam_0143 call=0x800BE8F6" MAP 0x186450 RL_IDENTITY 0 NO_INPUT_QUANTITY 1.0 FORMAT "%%5.0"
 /begin AXIS_DESCR COM_AXIS NO_INPUT_QUANTITY NO_COMPU_METHOD 2 AXIS_PTS_REF AX_17E40C /end AXIS_DESCR
 /begin AXIS_DESCR COM_AXIS NO_INPUT_QUANTITY NO_COMPU_METHOD 2 AXIS_PTS_REF AX_17D408 /end AXIS_DESCR
/end CHARACTERISTIC
/* src=families fam=fam_0125 ax=0x17F444 ay=0x17B478 */
/begin CHARACTERISTIC map_horsA2L_1864A8 "RE interp_2d fam_0125 call=0x800819E2" MAP 0x1864A8 RL_IDENTITY 0 NO_INPUT_QUANTITY 1.0 FORMAT "%%5.0"
 /begin AXIS_DESCR COM_AXIS NO_INPUT_QUANTITY NO_COMPU_METHOD 2 AXIS_PTS_REF AX_17F444 /end AXIS_DESCR
 /begin AXIS_DESCR COM_AXIS NO_INPUT_QUANTITY NO_COMPU_METHOD 2 AXIS_PTS_REF AX_17B478 /end AXIS_DESCR
/end CHARACTERISTIC
/* src=families fam=M_fam_0002 ax=0x- ay=0x- */
/begin CHARACTERISTIC M_fam_0002_1864C8 "RE map_interp_M M_fam_0002 call=0x80081A6A" VALUE 0x1864C8 RL_IDENTITY 0 NO_INPUT_QUANTITY 1.0 /end CHARACTERISTIC
/* src=families fam=fam_0163 ax=0x- ay=0x- */
/begin CHARACTERISTIC map_horsA2L_1865A8 "RE interp_2d fam_0163 call=0x800ED170" VALUE 0x1865A8 RL_IDENTITY 0 NO_INPUT_QUANTITY 1.0 /end CHARACTERISTIC
/* src=families fam=C_fam_0241 ax=0x- ay=0x- */
/begin CHARACTERISTIC C_fam_0241_1865E8 "RE map_interp_C C_fam_0241 call=0x800E4D28" VALUE 0x1865E8 RL_IDENTITY 0 NO_INPUT_QUANTITY 1.0 /end CHARACTERISTIC
/* src=families fam=C_fam_0184 ax=0x- ay=0x- */
/begin CHARACTERISTIC C_fam_0184_1865F8 "RE map_interp_C C_fam_0184 call=0x800EA0D0" VALUE 0x1865F8 RL_IDENTITY 0 NO_INPUT_QUANTITY 1.0 /end CHARACTERISTIC
/* src=families fam=I_fam_0106 ax=0x- ay=0x- */
/begin CHARACTERISTIC I_fam_0106_1866D8 "RE map_interp_I I_fam_0106 call=0x800DE8D4" VALUE 0x1866D8 RL_IDENTITY 0 NO_INPUT_QUANTITY 1.0 /end CHARACTERISTIC
/* src=families fam=F_fam_0142 ax=0x- ay=0x- */
/begin CHARACTERISTIC F_fam_0142_1866E8 "RE map_interp_F F_fam_0142 call=0x8009AABA" VALUE 0x1866E8 RL_IDENTITY 0 NO_INPUT_QUANTITY 1.0 /end CHARACTERISTIC
/* src=families fam=C_fam_0284 ax=0x- ay=0x- */
/begin CHARACTERISTIC C_fam_0284_1873C0 "RE map_interp_C C_fam_0284 call=0x8005F408" VALUE 0x1873C0 RL_IDENTITY 0 NO_INPUT_QUANTITY 1.0 /end CHARACTERISTIC
/* src=families fam=C_fam_0285 ax=0x- ay=0x- */
/begin CHARACTERISTIC C_fam_0285_1873DC "RE map_interp_C C_fam_0285 call=0x8005F476" VALUE 0x1873DC RL_IDENTITY 0 NO_INPUT_QUANTITY 1.0 /end CHARACTERISTIC
/* src=families fam=fam_0009 ax=0x17F454 ay=0x17C444 */
/begin CHARACTERISTIC map_horsA2L_1874B0 "RE interp_2d fam_0009 call=0x80081AF6" MAP 0x1874B0 RL_IDENTITY 0 NO_INPUT_QUANTITY 1.0 FORMAT "%%5.0"
 /begin AXIS_DESCR COM_AXIS NO_INPUT_QUANTITY NO_COMPU_METHOD 2 AXIS_PTS_REF AX_17F454 /end AXIS_DESCR
 /begin AXIS_DESCR COM_AXIS NO_INPUT_QUANTITY NO_COMPU_METHOD 2 AXIS_PTS_REF AX_17C444 /end AXIS_DESCR
/end CHARACTERISTIC
/* src=families fam=M_fam_0002 ax=0x- ay=0x- */
/begin CHARACTERISTIC M_fam_0002_1874E8 "RE map_interp_M M_fam_0002 call=0x80081B7E" VALUE 0x1874E8 RL_IDENTITY 0 NO_INPUT_QUANTITY 1.0 /end CHARACTERISTIC
/* src=families fam=fam_0145 ax=0x17D460 ay=0x17C474 */
/begin CHARACTERISTIC map_horsA2L_187518 "RE interp_2d fam_0145 call=0x800C6CB4" MAP 0x187518 RL_IDENTITY 0 NO_INPUT_QUANTITY 1.0 FORMAT "%%5.0"
 /begin AXIS_DESCR COM_AXIS NO_INPUT_QUANTITY NO_COMPU_METHOD 2 AXIS_PTS_REF AX_17D460 /end AXIS_DESCR
 /begin AXIS_DESCR COM_AXIS NO_INPUT_QUANTITY NO_COMPU_METHOD 2 AXIS_PTS_REF AX_17C474 /end AXIS_DESCR
/end CHARACTERISTIC
/* src=families fam=D_fam_0215 ax=0x- ay=0x- */
/begin CHARACTERISTIC D_fam_0215_18754C "RE map_interp_D D_fam_0215 call=0x800E5EC8" VALUE 0x18754C RL_IDENTITY 0 NO_INPUT_QUANTITY 1.0 /end CHARACTERISTIC
/* src=families fam=fam_0110 ax=0x17C550 ay=0x17955C */
/begin CHARACTERISTIC map_horsA2L_1875C4 "RE interp_2d fam_0110 call=0x800E9A4A" MAP 0x1875C4 RL_IDENTITY 0 NO_INPUT_QUANTITY 1.0 FORMAT "%%5.0"
 /begin AXIS_DESCR COM_AXIS NO_INPUT_QUANTITY NO_COMPU_METHOD 2 AXIS_PTS_REF AX_17C550 /end AXIS_DESCR
 /begin AXIS_DESCR COM_AXIS NO_INPUT_QUANTITY NO_COMPU_METHOD 2 AXIS_PTS_REF AX_17955C /end AXIS_DESCR
/end CHARACTERISTIC
/* src=families fam=fam_0161 ax=0x17A570 ay=0x- */ /* STUB unknown size; axis_x=0x17A570 axis_y=0x- */
/begin CHARACTERISTIC map_horsA2L_187688 "RE interp_2d fam_0161 call=0x800E9ED0" VALUE 0x187688 RL_IDENTITY 0 NO_INPUT_QUANTITY 1.0 /end CHARACTERISTIC
/* src=families fam=F_fam_0141 ax=0x- ay=0x- */
/begin CHARACTERISTIC F_fam_0141_1876C8 "RE map_interp_F F_fam_0141 call=0x8009AAAC" VALUE 0x1876C8 RL_IDENTITY 0 NO_INPUT_QUANTITY 1.0 /end CHARACTERISTIC
/* src=families fam=F_fam_0144 ax=0x- ay=0x- */
/begin CHARACTERISTIC F_fam_0144_1876E8 "RE map_interp_F F_fam_0144 call=0x8009AB6E" VALUE 0x1876E8 RL_IDENTITY 0 NO_INPUT_QUANTITY 1.0 /end CHARACTERISTIC
/* src=families fam=D_fam_0073 ax=0x1A1B9C ay=0x- */
/begin CHARACTERISTIC D_fam_0073_188A40 "RE map_interp_D D_fam_0073 call=0x8009972A" VALUE 0x188A40 RL_IDENTITY 0 NO_INPUT_QUANTITY 1.0 /end CHARACTERISTIC
/* src=families fam=D_fam_0075 ax=0x1A2B84 ay=0x- */ /* STUB unknown size; axis_x=0x1A2B84 axis_y=0x- */
/begin CHARACTERISTIC D_fam_0075_188A78 "RE map_interp_D D_fam_0075 call=0x800997C4" VALUE 0x188A78 RL_IDENTITY 0 NO_INPUT_QUANTITY 1.0 /end CHARACTERISTIC
/* src=families fam=G_fam_0085 ax=0x- ay=0x- */
/begin CHARACTERISTIC G_fam_0085_188AA4 "RE map_interp_G G_fam_0085 call=0x800924E8" VALUE 0x188AA4 RL_IDENTITY 0 NO_INPUT_QUANTITY 1.0 /end CHARACTERISTIC
/* src=families fam=G_fam_0087 ax=0x- ay=0x- */
/begin CHARACTERISTIC G_fam_0087_188AE0 "RE map_interp_G G_fam_0087 call=0x800926E8" VALUE 0x188AE0 RL_IDENTITY 0 NO_INPUT_QUANTITY 1.0 /end CHARACTERISTIC
/* src=families fam=F_fam_0027 ax=0x1A0B44 ay=0x- */ /* STUB unknown size; axis_x=0x1A0B44 axis_y=0x- */
/begin CHARACTERISTIC F_fam_0027_188B10 "RE map_interp_F F_fam_0027 call=0x8009494C; RE map_interp_G G_fam_0013 call=0x80" VALUE 0x188B10 RL_IDENTITY 0 NO_INPUT_QUANTITY 1.0 /end CHARACTERISTIC
/* src=families fam=F_fam_0028 ax=0x1A0B7C ay=0x- */ /* STUB unknown size; axis_x=0x1A0B7C axis_y=0x- */
/begin CHARACTERISTIC F_fam_0028_188B3C "RE map_interp_F F_fam_0028 call=0x800949EE; RE map_interp_G G_fam_0014 call=0x80" VALUE 0x188B3C RL_IDENTITY 0 NO_INPUT_QUANTITY 1.0 /end CHARACTERISTIC
/* src=families fam=H_fam_0026 ax=0x- ay=0x- */
/begin CHARACTERISTIC H_fam_0026_188B98 "RE map_interp_H H_fam_0026 call=0x80097D32" VALUE 0x188B98 RL_IDENTITY 0 NO_INPUT_QUANTITY 1.0 /end CHARACTERISTIC
/* src=families fam=I_fam_0020 ax=0x- ay=0x- */
/begin CHARACTERISTIC I_fam_0020_188BC4 "RE map_interp_I I_fam_0020 call=0x80094C5E" VALUE 0x188BC4 RL_IDENTITY 0 NO_INPUT_QUANTITY 1.0 /end CHARACTERISTIC
/* src=families fam=I_fam_0080 ax=0x- ay=0x- */
/begin CHARACTERISTIC I_fam_0080_188C1C "RE map_interp_I I_fam_0080 call=0x80092796" VALUE 0x188C1C RL_IDENTITY 0 NO_INPUT_QUANTITY 1.0 /end CHARACTERISTIC
/* src=families fam=F_fam_0186 ax=0x- ay=0x- */
/begin CHARACTERISTIC F_fam_0186_189998 "RE map_interp_F F_fam_0186 call=0x800F0DA6" VALUE 0x189998 RL_IDENTITY 0 NO_INPUT_QUANTITY 1.0 /end CHARACTERISTIC
/* src=families fam=D_fam_0177 ax=0x- ay=0x- */
/begin CHARACTERISTIC D_fam_0177_189A74 "RE map_interp_D D_fam_0177 call=0x800996D4" VALUE 0x189A74 RL_IDENTITY 0 NO_INPUT_QUANTITY 1.0 /end CHARACTERISTIC
/* src=families fam=C_fam_0207 ax=0x- ay=0x- */
/begin CHARACTERISTIC C_fam_0207_189BE8 "RE map_interp_C C_fam_0207 call=0x8009541E" VALUE 0x189BE8 RL_IDENTITY 0 NO_INPUT_QUANTITY 1.0 /end CHARACTERISTIC
/* src=families fam=C_fam_0229 ax=0x1A5B74 ay=0x- */ /* STUB unknown size; axis_x=0x1A5B74 axis_y=0x- */
/begin CHARACTERISTIC C_fam_0229_189BF8 "RE map_interp_C C_fam_0229 call=0x800953B8" VALUE 0x189BF8 RL_IDENTITY 0 NO_INPUT_QUANTITY 1.0 /end CHARACTERISTIC
/* src=families fam=I_fam_0021 ax=0x- ay=0x- */
/begin CHARACTERISTIC I_fam_0021_189C00 "RE map_interp_I I_fam_0021 call=0x8009490A" VALUE 0x189C00 RL_IDENTITY 0 NO_INPUT_QUANTITY 1.0 /end CHARACTERISTIC
/* src=families fam=D_fam_0148 ax=0x- ay=0x- */
/begin CHARACTERISTIC D_fam_0148_18A9C8 "RE map_interp_D D_fam_0148 call=0x800925D8" VALUE 0x18A9C8 RL_IDENTITY 0 NO_INPUT_QUANTITY 1.0 /end CHARACTERISTIC
/* src=families fam=D_fam_0178 ax=0x- ay=0x- */
/begin CHARACTERISTIC D_fam_0178_18AA54 "RE map_interp_D D_fam_0178 call=0x80099770" VALUE 0x18AA54 RL_IDENTITY 0 NO_INPUT_QUANTITY 1.0 /end CHARACTERISTIC
/* src=families fam=F_fam_0029 ax=0x1A2B64 ay=0x- */
/begin CHARACTERISTIC F_fam_0029_18AB0C "RE map_interp_F F_fam_0029 call=0x80094A8E; RE map_interp_G G_fam_0015 call=0x80" VALUE 0x18AB0C RL_IDENTITY 0 NO_INPUT_QUANTITY 1.0 /end CHARACTERISTIC
/* src=families fam=H_fam_0042 ax=0x- ay=0x- */
/begin CHARACTERISTIC H_fam_0042_18AB48 "RE map_interp_H H_fam_0042 call=0x80097E7C" VALUE 0x18AB48 RL_IDENTITY 0 NO_INPUT_QUANTITY 1.0 /end CHARACTERISTIC
/* src=families fam=C_fam_0157 ax=0x1A7B74 ay=0x- */ /* STUB unknown size; axis_x=0x1A7B74 axis_y=0x- */
/begin CHARACTERISTIC C_fam_0157_18ABC8 "RE map_interp_C C_fam_0157 call=0x8009534A" VALUE 0x18ABC8 RL_IDENTITY 0 NO_INPUT_QUANTITY 1.0 /end CHARACTERISTIC
/* src=families fam=I_fam_0077 ax=0x- ay=0x- */
/begin CHARACTERISTIC I_fam_0077_18ABD8 "RE map_interp_I I_fam_0077 call=0x800924A6" VALUE 0x18ABD8 RL_IDENTITY 0 NO_INPUT_QUANTITY 1.0 /end CHARACTERISTIC
/* src=families fam=I_fam_0022 ax=0x- ay=0x- */
/begin CHARACTERISTIC I_fam_0022_18AC08 "RE map_interp_I I_fam_0022 call=0x800949AC" VALUE 0x18AC08 RL_IDENTITY 0 NO_INPUT_QUANTITY 1.0 /end CHARACTERISTIC
/* src=families fam=F_fam_0182 ax=0x- ay=0x- */
/begin CHARACTERISTIC F_fam_0182_18B998 "RE map_interp_F F_fam_0182 call=0x800F0CF8" VALUE 0x18B998 RL_IDENTITY 0 NO_INPUT_QUANTITY 1.0 /end CHARACTERISTIC
/* src=families fam=D_fam_0068 ax=0x1A0B8C ay=0x- */ /* STUB unknown size; axis_x=0x1A0B8C axis_y=0x- */
/begin CHARACTERISTIC D_fam_0068_18BA4C "RE map_interp_D D_fam_0068 call=0x8009980A" VALUE 0x18BA4C RL_IDENTITY 0 NO_INPUT_QUANTITY 1.0 /end CHARACTERISTIC
/* src=families fam=fam_0093 ax=0x1A5B74 ay=0x- */ /* STUB unknown size; axis_x=0x1A5B74 axis_y=0x- */
/begin CHARACTERISTIC map_horsA2L_196A54 "RE interp_2d fam_0093 call=0x80095386" VALUE 0x18BB08 RL_IDENTITY 0 NO_INPUT_QUANTITY 1.0 /end CHARACTERISTIC
/* src=families fam=fam_0116 ax=0x1A7B74 ay=0x- */ /* STUB unknown size; axis_x=0x1A7B74 axis_y=0x- */
/begin CHARACTERISTIC map_horsA2L_196A68 "RE interp_2d fam_0116 call=0x8009531A" VALUE 0x18BB1C RL_IDENTITY 0 NO_INPUT_QUANTITY 1.0 /end CHARACTERISTIC
/* src=families fam=H_fam_0022 ax=0x- ay=0x- */
/begin CHARACTERISTIC H_fam_0022_18BBBC "RE map_interp_H H_fam_0022 call=0x80097CFC" VALUE 0x18BBBC RL_IDENTITY 0 NO_INPUT_QUANTITY 1.0 /end CHARACTERISTIC
/begin CHARACTERISTIC rail_sp_default "RE ld.hu default into D0013870 (code uses one u16; value 0 on this dump)" VALUE 0x18C154 RL_IDENTITY 0 NO_INPUT_QUANTITY 1.0 /end CHARACTERISTIC
/begin CHARACTERISTIC soi_base_int_trq2A "atlas9979 soi_base_int_trq2A / Start of Injection (IdName Caddy 9979 - verifier " MAP 0x18C380 RL_IDENTITY 0 NO_INPUT_QUANTITY 1.0 FORMAT "%%5.0"
 /begin AXIS_DESCR COM_AXIS NO_INPUT_QUANTITY NO_COMPU_METHOD 16 AXIS_PTS_REF AX_18AA26 /end AXIS_DESCR
 /begin AXIS_DESCR COM_AXIS NO_INPUT_QUANTITY NO_COMPU_METHOD 16 AXIS_PTS_REF AX_189CF2 /end AXIS_DESCR
/end CHARACTERISTIC
/begin CHARACTERISTIC soi_base_int_trq2A_18C580 "atlas9979 soi_base_int_trq2A@18C580 / Start of Injection (IdName Caddy 9979 - ve" MAP 0x18C580 RL_IDENTITY 0 NO_INPUT_QUANTITY 1.0 FORMAT "%%5.0"
 /begin AXIS_DESCR COM_AXIS NO_INPUT_QUANTITY NO_COMPU_METHOD 16 AXIS_PTS_REF AX_18AA26 /end AXIS_DESCR
 /begin AXIS_DESCR COM_AXIS NO_INPUT_QUANTITY NO_COMPU_METHOD 16 AXIS_PTS_REF AX_189CF2 /end AXIS_DESCR
/end CHARACTERISTIC
/begin CHARACTERISTIC soi_base_int_trq2A_18C780 "atlas9979 soi_base_int_trq2A@18C780 / Start of Injection (IdName Caddy 9979 - ve" MAP 0x18C780 RL_IDENTITY 0 NO_INPUT_QUANTITY 1.0 FORMAT "%%5.0"
 /begin AXIS_DESCR COM_AXIS NO_INPUT_QUANTITY NO_COMPU_METHOD 16 AXIS_PTS_REF AX_18AA26 /end AXIS_DESCR
 /begin AXIS_DESCR COM_AXIS NO_INPUT_QUANTITY NO_COMPU_METHOD 16 AXIS_PTS_REF AX_189CF2 /end AXIS_DESCR
/end CHARACTERISTIC
/* src=families fam=fam_0148 ax=0x- ay=0x- */
/begin CHARACTERISTIC map_horsA2L_1845A4_18C858 "RE interp_2d fam_0148 call=0x800DD096" VALUE 0x18C858 RL_IDENTITY 0 NO_INPUT_QUANTITY 1.0 /end CHARACTERISTIC
/begin CHARACTERISTIC soi_base_int_trq2A_18C980 "atlas9979 soi_base_int_trq2A@18C980 / Start of Injection (IdName Caddy 9979 - ve" MAP 0x18C980 RL_IDENTITY 0 NO_INPUT_QUANTITY 1.0 FORMAT "%%5.0"
 /begin AXIS_DESCR COM_AXIS NO_INPUT_QUANTITY NO_COMPU_METHOD 16 AXIS_PTS_REF AX_18AA26 /end AXIS_DESCR
 /begin AXIS_DESCR COM_AXIS NO_INPUT_QUANTITY NO_COMPU_METHOD 16 AXIS_PTS_REF AX_189CF2 /end AXIS_DESCR
/end CHARACTERISTIC
/* src=families fam=D_fam_0160 ax=0x- ay=0x- */
/begin CHARACTERISTIC D_fam_0160_18CA48 "RE map_interp_D D_fam_0160 call=0x80093560" VALUE 0x18CA48 RL_IDENTITY 0 NO_INPUT_QUANTITY 1.0 /end CHARACTERISTIC
/* src=families fam=D_fam_0159 ax=0x- ay=0x- */
/begin CHARACTERISTIC D_fam_0159_18CA58 "RE map_interp_D D_fam_0159 call=0x800934E0" VALUE 0x18CA58 RL_IDENTITY 0 NO_INPUT_QUANTITY 1.0 /end CHARACTERISTIC
/* src=families fam=K_fam_0039 ax=0x- ay=0x- */
/begin CHARACTERISTIC K_fam_0039_18CA74 "RE map_interp_K K_fam_0039 call=0x80092490" VALUE 0x18CA74 RL_IDENTITY 0 NO_INPUT_QUANTITY 1.0 /end CHARACTERISTIC
/* src=families fam=G_fam_0109 ax=0x- ay=0x- */
/begin CHARACTERISTIC G_fam_0109_18CB04 "RE map_interp_G G_fam_0109 call=0x800996A4" VALUE 0x18CB04 RL_IDENTITY 0 NO_INPUT_QUANTITY 1.0 /end CHARACTERISTIC
/* src=families fam=G_fam_0066 ax=0x1A1B9C ay=0x- */
/begin CHARACTERISTIC G_fam_0066_18CB24 "RE map_interp_G G_fam_0066 call=0x80099740" VALUE 0x18CB24 RL_IDENTITY 0 NO_INPUT_QUANTITY 1.0 /end CHARACTERISTIC
/begin CHARACTERISTIC soi_base_int_trq2A_18CB80 "atlas9979 soi_base_int_trq2A@18CB80 / Start of Injection (IdName Caddy 9979 - ve" MAP 0x18CB80 RL_IDENTITY 0 NO_INPUT_QUANTITY 1.0 FORMAT "%%5.0"
 /begin AXIS_DESCR COM_AXIS NO_INPUT_QUANTITY NO_COMPU_METHOD 16 AXIS_PTS_REF AX_18AA26 /end AXIS_DESCR
 /begin AXIS_DESCR COM_AXIS NO_INPUT_QUANTITY NO_COMPU_METHOD 16 AXIS_PTS_REF AX_189CF2 /end AXIS_DESCR
/end CHARACTERISTIC
/* src=families fam=I_fam_0023 ax=0x- ay=0x- */
/begin CHARACTERISTIC I_fam_0023_18CC0C "RE map_interp_I I_fam_0023 call=0x80094A4C" VALUE 0x18CC0C RL_IDENTITY 0 NO_INPUT_QUANTITY 1.0 /end CHARACTERISTIC
/begin CHARACTERISTIC soi_base_int_trq2A_18CD80 "atlas9979 soi_base_int_trq2A@18CD80 / Start of Injection (IdName Caddy 9979 - ve" MAP 0x18CD80 RL_IDENTITY 0 NO_INPUT_QUANTITY 1.0 FORMAT "%%5.0"
 /begin AXIS_DESCR COM_AXIS NO_INPUT_QUANTITY NO_COMPU_METHOD 16 AXIS_PTS_REF AX_18AA26 /end AXIS_DESCR
 /begin AXIS_DESCR COM_AXIS NO_INPUT_QUANTITY NO_COMPU_METHOD 16 AXIS_PTS_REF AX_189CF2 /end AXIS_DESCR
/end CHARACTERISTIC
/begin CHARACTERISTIC soi_base_int_trq2A_18CF80 "atlas9979 soi_base_int_trq2A@18CF80 / Start of Injection (IdName Caddy 9979 - ve" MAP 0x18CF80 RL_IDENTITY 0 NO_INPUT_QUANTITY 1.0 FORMAT "%%5.0"
 /begin AXIS_DESCR COM_AXIS NO_INPUT_QUANTITY NO_COMPU_METHOD 16 AXIS_PTS_REF AX_18AA26 /end AXIS_DESCR
 /begin AXIS_DESCR COM_AXIS NO_INPUT_QUANTITY NO_COMPU_METHOD 16 AXIS_PTS_REF AX_189CF2 /end AXIS_DESCR
/end CHARACTERISTIC
/* src=rail_path fam=- ax=0x1930CC ay=0x- */
/begin CHARACTERISTIC rail_sp_curve_18D0F0 "RE interp_C@8007D4D4 a4=18D0F0 a5=1930CC X=D0018666 -> D0013872/3870; size 16 pl" CURVE 0x18D0F0 RL_IDENTITY 0 NO_INPUT_QUANTITY 1.0 FORMAT "%%5.0"
 /begin AXIS_DESCR COM_AXIS NO_INPUT_QUANTITY NO_COMPU_METHOD 16 AXIS_PTS_REF AX_1930CC /end AXIS_DESCR
/end CHARACTERISTIC
/begin CHARACTERISTIC soi_base_int_trq2A_18D180 "atlas9979 soi_base_int_trq2A@18D180 / Start of Injection (IdName Caddy 9979 - ve" MAP 0x18D180 RL_IDENTITY 0 NO_INPUT_QUANTITY 1.0 FORMAT "%%5.0"
 /begin AXIS_DESCR COM_AXIS NO_INPUT_QUANTITY NO_COMPU_METHOD 16 AXIS_PTS_REF AX_18AA26 /end AXIS_DESCR
 /begin AXIS_DESCR COM_AXIS NO_INPUT_QUANTITY NO_COMPU_METHOD 16 AXIS_PTS_REF AX_189CF2 /end AXIS_DESCR
/end CHARACTERISTIC
/begin CHARACTERISTIC soi_base_int_trq2A_18D380 "atlas9979 soi_base_int_trq2A@18D380 / Start of Injection (IdName Caddy 9979 - ve" MAP 0x18D380 RL_IDENTITY 0 NO_INPUT_QUANTITY 1.0 FORMAT "%%5.0"
 /begin AXIS_DESCR COM_AXIS NO_INPUT_QUANTITY NO_COMPU_METHOD 16 AXIS_PTS_REF AX_18AA26 /end AXIS_DESCR
 /begin AXIS_DESCR COM_AXIS NO_INPUT_QUANTITY NO_COMPU_METHOD 16 AXIS_PTS_REF AX_189CF2 /end AXIS_DESCR
/end CHARACTERISTIC
/begin CHARACTERISTIC soi_base_int_trq2A_18D580 "atlas9979 soi_base_int_trq2A@18D580 / Start of Injection (IdName Caddy 9979 - ve" MAP 0x18D580 RL_IDENTITY 0 NO_INPUT_QUANTITY 1.0 FORMAT "%%5.0"
 /begin AXIS_DESCR COM_AXIS NO_INPUT_QUANTITY NO_COMPU_METHOD 16 AXIS_PTS_REF AX_18AA26 /end AXIS_DESCR
 /begin AXIS_DESCR COM_AXIS NO_INPUT_QUANTITY NO_COMPU_METHOD 16 AXIS_PTS_REF AX_189CF2 /end AXIS_DESCR
/end CHARACTERISTIC
/begin CHARACTERISTIC soi_base_int_trq2A_18D780 "atlas9979 soi_base_int_trq2A@18D780 / Start of Injection (IdName Caddy 9979 - ve" MAP 0x18D780 RL_IDENTITY 0 NO_INPUT_QUANTITY 1.0 FORMAT "%%5.0"
 /begin AXIS_DESCR COM_AXIS NO_INPUT_QUANTITY NO_COMPU_METHOD 16 AXIS_PTS_REF AX_18AA26 /end AXIS_DESCR
 /begin AXIS_DESCR COM_AXIS NO_INPUT_QUANTITY NO_COMPU_METHOD 16 AXIS_PTS_REF AX_189CF2 /end AXIS_DESCR
/end CHARACTERISTIC
/* src=families fam=F_fam_0171 ax=0x- ay=0x- */
/begin CHARACTERISTIC F_fam_0171_18D848 "RE map_interp_F F_fam_0171 call=0x800E5EF2" VALUE 0x18D848 RL_IDENTITY 0 NO_INPUT_QUANTITY 1.0 /end CHARACTERISTIC
/begin CHARACTERISTIC soi_base_int_trq2A_18D980 "atlas9979 soi_base_int_trq2A@18D980 / Start of Injection (IdName Caddy 9979 - ve" MAP 0x18D980 RL_IDENTITY 0 NO_INPUT_QUANTITY 1.0 FORMAT "%%5.0"
 /begin AXIS_DESCR COM_AXIS NO_INPUT_QUANTITY NO_COMPU_METHOD 16 AXIS_PTS_REF AX_18AA26 /end AXIS_DESCR
 /begin AXIS_DESCR COM_AXIS NO_INPUT_QUANTITY NO_COMPU_METHOD 16 AXIS_PTS_REF AX_189CF2 /end AXIS_DESCR
/end CHARACTERISTIC
/* src=families fam=D_fam_0008 ax=0x1A2B64 ay=0x- */
/begin CHARACTERISTIC D_fam_0008_18D998 "RE map_interp_D D_fam_0008 call=0x80094AF6" VALUE 0x18D998 RL_IDENTITY 0 NO_INPUT_QUANTITY 1.0 /end CHARACTERISTIC
/* src=families fam=F_fam_0072 ax=0x1A0B8C ay=0x- */ /* STUB unknown size; axis_x=0x1A0B8C axis_y=0x- */
/begin CHARACTERISTIC F_fam_0072_18DB1C "RE map_interp_F F_fam_0072 call=0x800997EE; RE map_interp_G G_fam_0067 call=0x80" VALUE 0x18DB1C RL_IDENTITY 0 NO_INPUT_QUANTITY 1.0 /end CHARACTERISTIC
/* src=families fam=H_fam_0038 ax=0x- ay=0x- */
/begin CHARACTERISTIC H_fam_0038_18DB6C "RE map_interp_H H_fam_0038 call=0x80097E46" VALUE 0x18DB6C RL_IDENTITY 0 NO_INPUT_QUANTITY 1.0 /end CHARACTERISTIC
/begin CHARACTERISTIC soi_base_int_trq2A_18DB80 "atlas9979 soi_base_int_trq2A@18DB80 / Start of Injection (IdName Caddy 9979 - ve" MAP 0x18DB80 RL_IDENTITY 0 NO_INPUT_QUANTITY 1.0 FORMAT "%%5.0"
 /begin AXIS_DESCR COM_AXIS NO_INPUT_QUANTITY NO_COMPU_METHOD 16 AXIS_PTS_REF AX_18AA26 /end AXIS_DESCR
 /begin AXIS_DESCR COM_AXIS NO_INPUT_QUANTITY NO_COMPU_METHOD 16 AXIS_PTS_REF AX_189CF2 /end AXIS_DESCR
/end CHARACTERISTIC
/* src=families fam=I_fam_0078 ax=0x- ay=0x- */
/begin CHARACTERISTIC I_fam_0078_18DBF0 "RE map_interp_I I_fam_0078 call=0x800925AE" VALUE 0x18DBF0 RL_IDENTITY 0 NO_INPUT_QUANTITY 1.0 /end CHARACTERISTIC
/* src=families fam=E_fam_0075 ax=0x- ay=0x- */
/begin CHARACTERISTIC E_fam_0075_18DC30 "RE map_interp_E E_fam_0075 call=0x8009300C" VALUE 0x18DC30 RL_IDENTITY 0 NO_INPUT_QUANTITY 1.0 /end CHARACTERISTIC
/begin CHARACTERISTIC soi_base_int_trq2A_18DD80 "atlas9979 soi_base_int_trq2A@18DD80 / Start of Injection (IdName Caddy 9979 - ve" MAP 0x18DD80 RL_IDENTITY 0 NO_INPUT_QUANTITY 1.0 FORMAT "%%5.0"
 /begin AXIS_DESCR COM_AXIS NO_INPUT_QUANTITY NO_COMPU_METHOD 16 AXIS_PTS_REF AX_18AA26 /end AXIS_DESCR
 /begin AXIS_DESCR COM_AXIS NO_INPUT_QUANTITY NO_COMPU_METHOD 16 AXIS_PTS_REF AX_189CF2 /end AXIS_DESCR
/end CHARACTERISTIC
/begin CHARACTERISTIC soi_base_int_trq2A_18DF80 "atlas9979 soi_base_int_trq2A@18DF80 / Start of Injection (IdName Caddy 9979 - ve" MAP 0x18DF80 RL_IDENTITY 0 NO_INPUT_QUANTITY 1.0 FORMAT "%%5.0"
 /begin AXIS_DESCR COM_AXIS NO_INPUT_QUANTITY NO_COMPU_METHOD 16 AXIS_PTS_REF AX_18AA26 /end AXIS_DESCR
 /begin AXIS_DESCR COM_AXIS NO_INPUT_QUANTITY NO_COMPU_METHOD 16 AXIS_PTS_REF AX_189CF2 /end AXIS_DESCR
/end CHARACTERISTIC
/* src=families fam=F_fam_0103 ax=0x- ay=0x- */
/begin CHARACTERISTIC F_fam_0103_18E080 "RE map_interp_F F_fam_0103 call=0x8009261C" VALUE 0x18E080 RL_IDENTITY 0 NO_INPUT_QUANTITY 1.0 /end CHARACTERISTIC
/begin CHARACTERISTIC soi_base_int_trq2A_18E180 "atlas9979 soi_base_int_trq2A@18E180 / Start of Injection (IdName Caddy 9979 - ve" MAP 0x18E180 RL_IDENTITY 0 NO_INPUT_QUANTITY 1.0 FORMAT "%%5.0"
 /begin AXIS_DESCR COM_AXIS NO_INPUT_QUANTITY NO_COMPU_METHOD 16 AXIS_PTS_REF AX_18AA26 /end AXIS_DESCR
 /begin AXIS_DESCR COM_AXIS NO_INPUT_QUANTITY NO_COMPU_METHOD 16 AXIS_PTS_REF AX_189CF2 /end AXIS_DESCR
/end CHARACTERISTIC
/begin CHARACTERISTIC soi_base_int_trq2A_18E380 "atlas9979 soi_base_int_trq2A@18E380 / Start of Injection (IdName Caddy 9979 - ve" MAP 0x18E380 RL_IDENTITY 0 NO_INPUT_QUANTITY 1.0 FORMAT "%%5.0"
 /begin AXIS_DESCR COM_AXIS NO_INPUT_QUANTITY NO_COMPU_METHOD 16 AXIS_PTS_REF AX_18AA26 /end AXIS_DESCR
 /begin AXIS_DESCR COM_AXIS NO_INPUT_QUANTITY NO_COMPU_METHOD 16 AXIS_PTS_REF AX_189CF2 /end AXIS_DESCR
/end CHARACTERISTIC
/* src=families fam=F_fam_0105 ax=0x- ay=0x- */
/begin CHARACTERISTIC F_fam_0105_18E500 "RE map_interp_F F_fam_0105 call=0x80092712" VALUE 0x18E500 RL_IDENTITY 0 NO_INPUT_QUANTITY 1.0 /end CHARACTERISTIC
/begin CHARACTERISTIC soi_base_int_trq2A_18E580 "atlas9979 soi_base_int_trq2A@18E580 / Start of Injection (IdName Caddy 9979 - ve" MAP 0x18E580 RL_IDENTITY 0 NO_INPUT_QUANTITY 1.0 FORMAT "%%5.0"
 /begin AXIS_DESCR COM_AXIS NO_INPUT_QUANTITY NO_COMPU_METHOD 16 AXIS_PTS_REF AX_18AA26 /end AXIS_DESCR
 /begin AXIS_DESCR COM_AXIS NO_INPUT_QUANTITY NO_COMPU_METHOD 16 AXIS_PTS_REF AX_189CF2 /end AXIS_DESCR
/end CHARACTERISTIC
/begin CHARACTERISTIC soi_base_int_trq2A_18E780 "atlas9979 soi_base_int_trq2A@18E780 / Start of Injection (IdName Caddy 9979 - ve" MAP 0x18E780 RL_IDENTITY 0 NO_INPUT_QUANTITY 1.0 FORMAT "%%5.0"
 /begin AXIS_DESCR COM_AXIS NO_INPUT_QUANTITY NO_COMPU_METHOD 16 AXIS_PTS_REF AX_18AA26 /end AXIS_DESCR
 /begin AXIS_DESCR COM_AXIS NO_INPUT_QUANTITY NO_COMPU_METHOD 16 AXIS_PTS_REF AX_189CF2 /end AXIS_DESCR
/end CHARACTERISTIC
/begin CHARACTERISTIC soi_base_int_trq2A_18E980 "atlas9979 soi_base_int_trq2A@18E980 / Start of Injection (IdName Caddy 9979 - ve" MAP 0x18E980 RL_IDENTITY 0 NO_INPUT_QUANTITY 1.0 FORMAT "%%5.0"
 /begin AXIS_DESCR COM_AXIS NO_INPUT_QUANTITY NO_COMPU_METHOD 16 AXIS_PTS_REF AX_18AA26 /end AXIS_DESCR
 /begin AXIS_DESCR COM_AXIS NO_INPUT_QUANTITY NO_COMPU_METHOD 16 AXIS_PTS_REF AX_189CF2 /end AXIS_DESCR
/end CHARACTERISTIC
/* src=families fam=D_fam_0173 ax=0x- ay=0x- */
/begin CHARACTERISTIC D_fam_0173_18E9A0 "RE map_interp_D D_fam_0173 call=0x80094BA4" VALUE 0x18E9A0 RL_IDENTITY 0 NO_INPUT_QUANTITY 1.0 /end CHARACTERISTIC
/* src=families fam=D_fam_0150 ax=0x- ay=0x- */
/begin CHARACTERISTIC D_fam_0150_18EA14 "RE map_interp_D D_fam_0150 call=0x800927C0" VALUE 0x18EA14 RL_IDENTITY 0 NO_INPUT_QUANTITY 1.0 /end CHARACTERISTIC
/* src=families fam=K_fam_0040 ax=0x- ay=0x- */
/begin CHARACTERISTIC K_fam_0040_18EA6C "RE map_interp_K K_fam_0040 call=0x80092598" VALUE 0x18EA6C RL_IDENTITY 0 NO_INPUT_QUANTITY 1.0 /end CHARACTERISTIC
/* src=families fam=G_fam_0086 ax=0x- ay=0x- */
/begin CHARACTERISTIC G_fam_0086_18EABC "RE map_interp_G G_fam_0086 call=0x800925F2" VALUE 0x18EABC RL_IDENTITY 0 NO_INPUT_QUANTITY 1.0 /end CHARACTERISTIC
/* src=families fam=F_fam_0073 ax=0x1A1B9C ay=0x- */
/begin CHARACTERISTIC F_fam_0073_18EB18 "RE map_interp_F F_fam_0073 call=0x80099700; RE map_interp_G G_fam_0110 call=0x80" VALUE 0x18EB18 RL_IDENTITY 0 NO_INPUT_QUANTITY 1.0 /end CHARACTERISTIC
/* src=families fam=F_fam_0074 ax=0x1A2B84 ay=0x- */ /* STUB unknown size; axis_x=0x1A2B84 axis_y=0x- */
/begin CHARACTERISTIC F_fam_0074_18EB38 "RE map_interp_F F_fam_0074 call=0x8009979C; RE map_interp_G G_fam_0111 call=0x80" VALUE 0x18EB38 RL_IDENTITY 0 NO_INPUT_QUANTITY 1.0 /end CHARACTERISTIC
/begin CHARACTERISTIC soi_base_int_trq2A_18EB80 "atlas9979 soi_base_int_trq2A@18EB80 / Start of Injection (IdName Caddy 9979 - ve" MAP 0x18EB80 RL_IDENTITY 0 NO_INPUT_QUANTITY 1.0 FORMAT "%%5.0"
 /begin AXIS_DESCR COM_AXIS NO_INPUT_QUANTITY NO_COMPU_METHOD 16 AXIS_PTS_REF AX_18AA26 /end AXIS_DESCR
 /begin AXIS_DESCR COM_AXIS NO_INPUT_QUANTITY NO_COMPU_METHOD 16 AXIS_PTS_REF AX_189CF2 /end AXIS_DESCR
/end CHARACTERISTIC
/* src=families fam=F_fam_0101 ax=0x- ay=0x- */
/begin CHARACTERISTIC F_fam_0101_18EC00 "RE map_interp_F F_fam_0101 call=0x80092526" VALUE 0x18EC00 RL_IDENTITY 0 NO_INPUT_QUANTITY 1.0 /end CHARACTERISTIC
/begin CHARACTERISTIC soi_base_int_trq2A_18ED80 "atlas9979 soi_base_int_trq2A@18ED80 / Start of Injection (IdName Caddy 9979 - ve" MAP 0x18ED80 RL_IDENTITY 0 NO_INPUT_QUANTITY 1.0 FORMAT "%%5.0"
 /begin AXIS_DESCR COM_AXIS NO_INPUT_QUANTITY NO_COMPU_METHOD 16 AXIS_PTS_REF AX_18AA26 /end AXIS_DESCR
 /begin AXIS_DESCR COM_AXIS NO_INPUT_QUANTITY NO_COMPU_METHOD 16 AXIS_PTS_REF AX_189CF2 /end AXIS_DESCR
/end CHARACTERISTIC
/begin CHARACTERISTIC soi_base_int_trq2A_18EF80 "atlas9979 soi_base_int_trq2A@18EF80 / Start of Injection (IdName Caddy 9979 - ve" MAP 0x18EF80 RL_IDENTITY 0 NO_INPUT_QUANTITY 1.0 FORMAT "%%5.0"
 /begin AXIS_DESCR COM_AXIS NO_INPUT_QUANTITY NO_COMPU_METHOD 16 AXIS_PTS_REF AX_18AA26 /end AXIS_DESCR
 /begin AXIS_DESCR COM_AXIS NO_INPUT_QUANTITY NO_COMPU_METHOD 16 AXIS_PTS_REF AX_189CF2 /end AXIS_DESCR
/end CHARACTERISTIC
/begin CHARACTERISTIC soi_base_int_trq2A_18F180 "atlas9979 soi_base_int_trq2A@18F180 / Start of Injection (IdName Caddy 9979 - ve" MAP 0x18F180 RL_IDENTITY 0 NO_INPUT_QUANTITY 1.0 FORMAT "%%5.0"
 /begin AXIS_DESCR COM_AXIS NO_INPUT_QUANTITY NO_COMPU_METHOD 16 AXIS_PTS_REF AX_18AA26 /end AXIS_DESCR
 /begin AXIS_DESCR COM_AXIS NO_INPUT_QUANTITY NO_COMPU_METHOD 16 AXIS_PTS_REF AX_189CF2 /end AXIS_DESCR
/end CHARACTERISTIC
/begin CHARACTERISTIC soi_base_int_trq2A_18F380 "atlas9979 soi_base_int_trq2A@18F380 / Start of Injection (IdName Caddy 9979 - ve" MAP 0x18F380 RL_IDENTITY 0 NO_INPUT_QUANTITY 1.0 FORMAT "%%5.0"
 /begin AXIS_DESCR COM_AXIS NO_INPUT_QUANTITY NO_COMPU_METHOD 16 AXIS_PTS_REF AX_18AA26 /end AXIS_DESCR
 /begin AXIS_DESCR COM_AXIS NO_INPUT_QUANTITY NO_COMPU_METHOD 16 AXIS_PTS_REF AX_189CF2 /end AXIS_DESCR
/end CHARACTERISTIC
/begin CHARACTERISTIC soi_base_int_trq2A_18F580 "atlas9979 soi_base_int_trq2A@18F580 / Start of Injection (IdName Caddy 9979 - ve" MAP 0x18F580 RL_IDENTITY 0 NO_INPUT_QUANTITY 1.0 FORMAT "%%5.0"
 /begin AXIS_DESCR COM_AXIS NO_INPUT_QUANTITY NO_COMPU_METHOD 16 AXIS_PTS_REF AX_18AA26 /end AXIS_DESCR
 /begin AXIS_DESCR COM_AXIS NO_INPUT_QUANTITY NO_COMPU_METHOD 16 AXIS_PTS_REF AX_189CF2 /end AXIS_DESCR
/end CHARACTERISTIC
/begin CHARACTERISTIC soi_base_int_trq2A_18F780 "atlas9979 soi_base_int_trq2A@18F780 / Start of Injection (IdName Caddy 9979 - ve" MAP 0x18F780 RL_IDENTITY 0 NO_INPUT_QUANTITY 1.0 FORMAT "%%5.0"
 /begin AXIS_DESCR COM_AXIS NO_INPUT_QUANTITY NO_COMPU_METHOD 16 AXIS_PTS_REF AX_18AA26 /end AXIS_DESCR
 /begin AXIS_DESCR COM_AXIS NO_INPUT_QUANTITY NO_COMPU_METHOD 16 AXIS_PTS_REF AX_189CF2 /end AXIS_DESCR
/end CHARACTERISTIC
/* src=families fam=D_fam_0011 ax=0x- ay=0x- */
/begin CHARACTERISTIC D_fam_0011_18FA18 "RE map_interp_D D_fam_0011 call=0x80094B30" VALUE 0x18FA18 RL_IDENTITY 0 NO_INPUT_QUANTITY 1.0 /end CHARACTERISTIC
/* src=families fam=F_fam_0040 ax=0x1A0B8C ay=0x1A3B8C */
/begin CHARACTERISTIC F_fam_0040_18FB30 "RE map_interp_F F_fam_0040 call=0x80099836; RE map_interp_G G_fam_0064 call=0x80" MAP 0x18FB30 RL_IDENTITY 0 NO_INPUT_QUANTITY 1.0 FORMAT "%%5.0"
 /begin AXIS_DESCR COM_AXIS NO_INPUT_QUANTITY NO_COMPU_METHOD 2 AXIS_PTS_REF AX_1A0B8C /end AXIS_DESCR
 /begin AXIS_DESCR COM_AXIS NO_INPUT_QUANTITY NO_COMPU_METHOD 2 AXIS_PTS_REF AX_1A3B8C /end AXIS_DESCR
/end CHARACTERISTIC
/begin CHARACTERISTIC soi_base_int_trq2A_18FF80 "atlas9979 soi_base_int_trq2A@18FF80 / Start of Injection (IdName Caddy 9979 - ve" MAP 0x18FF80 RL_IDENTITY 0 NO_INPUT_QUANTITY 1.0 FORMAT "%%5.0"
 /begin AXIS_DESCR COM_AXIS NO_INPUT_QUANTITY NO_COMPU_METHOD 16 AXIS_PTS_REF AX_18AA26 /end AXIS_DESCR
 /begin AXIS_DESCR COM_AXIS NO_INPUT_QUANTITY NO_COMPU_METHOD 16 AXIS_PTS_REF AX_189CF2 /end AXIS_DESCR
/end CHARACTERISTIC
/begin CHARACTERISTIC soi_base_int_trq2A_190180 "atlas9979 soi_base_int_trq2A@190180 / Start of Injection (IdName Caddy 9979 - ve" MAP 0x190180 RL_IDENTITY 0 NO_INPUT_QUANTITY 1.0 FORMAT "%%5.0"
 /begin AXIS_DESCR COM_AXIS NO_INPUT_QUANTITY NO_COMPU_METHOD 16 AXIS_PTS_REF AX_18AA26 /end AXIS_DESCR
 /begin AXIS_DESCR COM_AXIS NO_INPUT_QUANTITY NO_COMPU_METHOD 16 AXIS_PTS_REF AX_189CF2 /end AXIS_DESCR
/end CHARACTERISTIC
/begin CHARACTERISTIC soi_base_int_trq2A_190380 "atlas9979 soi_base_int_trq2A@190380 / Start of Injection (IdName Caddy 9979 - ve" MAP 0x190380 RL_IDENTITY 0 NO_INPUT_QUANTITY 1.0 FORMAT "%%5.0"
 /begin AXIS_DESCR COM_AXIS NO_INPUT_QUANTITY NO_COMPU_METHOD 16 AXIS_PTS_REF AX_18AA26 /end AXIS_DESCR
 /begin AXIS_DESCR COM_AXIS NO_INPUT_QUANTITY NO_COMPU_METHOD 16 AXIS_PTS_REF AX_189CF2 /end AXIS_DESCR
/end CHARACTERISTIC
/begin CHARACTERISTIC soi_base_int_trq2A_190580 "atlas9979 soi_base_int_trq2A@190580 / Start of Injection (IdName Caddy 9979 - ve" MAP 0x190580 RL_IDENTITY 0 NO_INPUT_QUANTITY 1.0 FORMAT "%%5.0"
 /begin AXIS_DESCR COM_AXIS NO_INPUT_QUANTITY NO_COMPU_METHOD 16 AXIS_PTS_REF AX_18AA26 /end AXIS_DESCR
 /begin AXIS_DESCR COM_AXIS NO_INPUT_QUANTITY NO_COMPU_METHOD 16 AXIS_PTS_REF AX_189CF2 /end AXIS_DESCR
/end CHARACTERISTIC
/begin CHARACTERISTIC soi_base_int_trq2A_190780 "atlas9979 soi_base_int_trq2A@190780 / Start of Injection (IdName Caddy 9979 - ve" MAP 0x190780 RL_IDENTITY 0 NO_INPUT_QUANTITY 1.0 FORMAT "%%5.0"
 /begin AXIS_DESCR COM_AXIS NO_INPUT_QUANTITY NO_COMPU_METHOD 16 AXIS_PTS_REF AX_18AA26 /end AXIS_DESCR
 /begin AXIS_DESCR COM_AXIS NO_INPUT_QUANTITY NO_COMPU_METHOD 16 AXIS_PTS_REF AX_189CF2 /end AXIS_DESCR
/end CHARACTERISTIC
/begin CHARACTERISTIC soi_base_int_trq2A_190980 "atlas9979 soi_base_int_trq2A@190980 / Start of Injection (IdName Caddy 9979 - ve" MAP 0x190980 RL_IDENTITY 0 NO_INPUT_QUANTITY 1.0 FORMAT "%%5.0"
 /begin AXIS_DESCR COM_AXIS NO_INPUT_QUANTITY NO_COMPU_METHOD 16 AXIS_PTS_REF AX_18AA26 /end AXIS_DESCR
 /begin AXIS_DESCR COM_AXIS NO_INPUT_QUANTITY NO_COMPU_METHOD 16 AXIS_PTS_REF AX_189CF2 /end AXIS_DESCR
/end CHARACTERISTIC
/* src=families fam=D_fam_0174 ax=0x- ay=0x- */
/begin CHARACTERISTIC D_fam_0174_1909FC "RE map_interp_D D_fam_0174 call=0x80094C46" VALUE 0x1909FC RL_IDENTITY 0 NO_INPUT_QUANTITY 1.0 /end CHARACTERISTIC
/* src=families fam=D_fam_0012 ax=0x- ay=0x- */
/begin CHARACTERISTIC D_fam_0012_191A50 "RE map_interp_D D_fam_0012 call=0x80094BD8" VALUE 0x191A50 RL_IDENTITY 0 NO_INPUT_QUANTITY 1.0 /end CHARACTERISTIC
/* src=families fam=K_fam_0041 ax=0x- ay=0x- */
/begin CHARACTERISTIC K_fam_0041_191AA0 "RE map_interp_K K_fam_0041 call=0x8009268E" VALUE 0x191AA0 RL_IDENTITY 0 NO_INPUT_QUANTITY 1.0 /end CHARACTERISTIC
/* src=families fam=B_fam_0010 ax=0x1A3B74 ay=0x- */ /* STUB unknown size; axis_x=0x1A3B74 axis_y=0x- */
/begin CHARACTERISTIC B_fam_0010_191B68 "RE interp_2d_B B_fam_0010 call=0x80093098" VALUE 0x191B68 RL_IDENTITY 0 NO_INPUT_QUANTITY 1.0 /end CHARACTERISTIC
/* src=families fam=H_fam_0030 ax=0x- ay=0x- */
/begin CHARACTERISTIC H_fam_0030_191B74 "RE map_interp_H H_fam_0030 call=0x80097D7C" VALUE 0x191B74 RL_IDENTITY 0 NO_INPUT_QUANTITY 1.0 /end CHARACTERISTIC
/* src=families fam=D_fam_0013 ax=0x- ay=0x- */
/begin CHARACTERISTIC D_fam_0013_192A60 "RE map_interp_D D_fam_0013 call=0x80094C7A" VALUE 0x192A60 RL_IDENTITY 0 NO_INPUT_QUANTITY 1.0 /end CHARACTERISTIC
/* src=families fam=H_fam_0031 ax=0x- ay=0x- */
/begin CHARACTERISTIC H_fam_0031_192B5A "RE map_interp_H H_fam_0031 call=0x80097D8C" VALUE 0x192B5A RL_IDENTITY 0 NO_INPUT_QUANTITY 1.0 /end CHARACTERISTIC
/* src=families fam=I_fam_0079 ax=0x- ay=0x- */
/begin CHARACTERISTIC I_fam_0079_192C34 "RE map_interp_I I_fam_0079 call=0x800926A4" VALUE 0x192C34 RL_IDENTITY 0 NO_INPUT_QUANTITY 1.0 /end CHARACTERISTIC
/begin CHARACTERISTIC rail_sp_pt1_gain "RE u16 d6 of FUN_8004d15c @800BA0C8 (PT1 gain for D0013874); sits in a 82xx tabl" VALUE 0x19314A RL_IDENTITY 0 NO_INPUT_QUANTITY 1.0 /end CHARACTERISTIC
/* src=families fam=C_fam_0312 ax=0x- ay=0x- */
/begin CHARACTERISTIC C_fam_0312_193838 "RE map_interp_C C_fam_0312 call=0x800E604C; RE map_interp_D D_fam_0217 call=0x80" VALUE 0x193838 RL_IDENTITY 0 NO_INPUT_QUANTITY 1.0 /end CHARACTERISTIC
/* src=families fam=D_fam_0147 ax=0x- ay=0x- */
/begin CHARACTERISTIC D_fam_0147_1939F0 "RE map_interp_D D_fam_0147 call=0x800924D0" VALUE 0x1939F0 RL_IDENTITY 0 NO_INPUT_QUANTITY 1.0 /end CHARACTERISTIC
/* src=families fam=D_fam_0149 ax=0x- ay=0x- */
/begin CHARACTERISTIC D_fam_0149_193A2C "RE map_interp_D D_fam_0149 call=0x800926CE" VALUE 0x193A2C RL_IDENTITY 0 NO_INPUT_QUANTITY 1.0 /end CHARACTERISTIC
/* src=families fam=D_fam_0014 ax=0x- ay=0x- */
/begin CHARACTERISTIC D_fam_0014_193A5C "RE map_interp_D D_fam_0014 call=0x80094926" VALUE 0x193A5C RL_IDENTITY 0 NO_INPUT_QUANTITY 1.0 /end CHARACTERISTIC
/* src=families fam=G_fam_0088 ax=0x- ay=0x- */
/begin CHARACTERISTIC G_fam_0088_193B08 "RE map_interp_G G_fam_0088 call=0x800927D8" VALUE 0x193B08 RL_IDENTITY 0 NO_INPUT_QUANTITY 1.0 /end CHARACTERISTIC
/* src=families fam=H_fam_0034 ax=0x- ay=0x- */
/begin CHARACTERISTIC H_fam_0034_193B40 "RE map_interp_H H_fam_0034 call=0x80097DC2" VALUE 0x193B40 RL_IDENTITY 0 NO_INPUT_QUANTITY 1.0 /end CHARACTERISTIC
/* src=families fam=H_fam_0035 ax=0x- ay=0x- */
/begin CHARACTERISTIC H_fam_0035_193B66 "RE map_interp_H H_fam_0035 call=0x80097DD0" VALUE 0x193B66 RL_IDENTITY 0 NO_INPUT_QUANTITY 1.0 /end CHARACTERISTIC
/* src=families fam=B_fam_0010 ax=0x- ay=0x- */
/begin CHARACTERISTIC B_fam_0010_193BC4 "RE interp_2d_B B_fam_0010 call=0x80092FE6" VALUE 0x193BC4 RL_IDENTITY 0 NO_INPUT_QUANTITY 1.0 /end CHARACTERISTIC
/* src=families fam=C_fam_0311 ax=0x- ay=0x- */
/begin CHARACTERISTIC C_fam_0311_194808 "RE map_interp_C C_fam_0311 call=0x800E6028" VALUE 0x194808 RL_IDENTITY 0 NO_INPUT_QUANTITY 1.0 /end CHARACTERISTIC
/* src=families fam=D_fam_0015 ax=0x- ay=0x- */
/begin CHARACTERISTIC D_fam_0015_194A48 "RE map_interp_D D_fam_0015 call=0x800949C8" VALUE 0x194A48 RL_IDENTITY 0 NO_INPUT_QUANTITY 1.0 /end CHARACTERISTIC
/* src=families fam=K_fam_0042 ax=0x- ay=0x- */
/begin CHARACTERISTIC K_fam_0042_194AA8 "RE map_interp_K K_fam_0042 call=0x80092780" VALUE 0x194AA8 RL_IDENTITY 0 NO_INPUT_QUANTITY 1.0 /end CHARACTERISTIC
/* src=families fam=G_fam_0010 ax=0x- ay=0x- */
/begin CHARACTERISTIC G_fam_0010_194B0C "RE map_interp_G G_fam_0010 call=0x80094B46" VALUE 0x194B0C RL_IDENTITY 0 NO_INPUT_QUANTITY 1.0 /end CHARACTERISTIC
/* src=families fam=H_fam_0036 ax=0x- ay=0x- */
/begin CHARACTERISTIC H_fam_0036_194B4C "RE map_interp_H H_fam_0036 call=0x80097DE2" VALUE 0x194B4C RL_IDENTITY 0 NO_INPUT_QUANTITY 1.0 /end CHARACTERISTIC
/* src=families fam=H_fam_0037 ax=0x- ay=0x- */
/begin CHARACTERISTIC H_fam_0037_194B72 "RE map_interp_H H_fam_0037 call=0x80097DF0" VALUE 0x194B72 RL_IDENTITY 0 NO_INPUT_QUANTITY 1.0 /end CHARACTERISTIC
/* src=families fam=C_fam_0316 ax=0x- ay=0x- */
/begin CHARACTERISTIC C_fam_0316_195988 "RE map_interp_C C_fam_0316 call=0x800E6226" VALUE 0x195988 RL_IDENTITY 0 NO_INPUT_QUANTITY 1.0 /end CHARACTERISTIC
/* src=families fam=F_fam_0184 ax=0x- ay=0x- */
/begin CHARACTERISTIC F_fam_0184_195998 "RE map_interp_F F_fam_0184 call=0x800F0D5C" VALUE 0x195998 RL_IDENTITY 0 NO_INPUT_QUANTITY 1.0 /end CHARACTERISTIC
/* src=families fam=D_fam_0016 ax=0x- ay=0x- */
/begin CHARACTERISTIC D_fam_0016_195A58 "RE map_interp_D D_fam_0016 call=0x80094A68" VALUE 0x195A58 RL_IDENTITY 0 NO_INPUT_QUANTITY 1.0 /end CHARACTERISTIC
/* src=families fam=F_fam_0075 ax=0x1A4B9C ay=0x- */ /* STUB unknown size; axis_x=0x1A4B9C axis_y=0x- */
/begin CHARACTERISTIC F_fam_0075_195A8C "RE map_interp_F F_fam_0075 call=0x8009358E" VALUE 0x195A8C RL_IDENTITY 0 NO_INPUT_QUANTITY 1.0 /end CHARACTERISTIC
/* src=families fam=F_fam_0119 ax=0x- ay=0x- */
/begin CHARACTERISTIC F_fam_0119_195A9C "RE map_interp_F F_fam_0119 call=0x80093516" VALUE 0x195A9C RL_IDENTITY 0 NO_INPUT_QUANTITY 1.0 /end CHARACTERISTIC
/* src=families fam=K_fam_0063 ax=0x- ay=0x- */
/begin CHARACTERISTIC K_fam_0063_195AAC "RE map_interp_K K_fam_0063 call=0x800948F2" VALUE 0x195AAC RL_IDENTITY 0 NO_INPUT_QUANTITY 1.0 /end CHARACTERISTIC
/* src=families fam=H_fam_0032 ax=0x- ay=0x- */
/begin CHARACTERISTIC H_fam_0032_195B58 "RE map_interp_H H_fam_0032 call=0x80097DA2" VALUE 0x195B58 RL_IDENTITY 0 NO_INPUT_QUANTITY 1.0 /end CHARACTERISTIC
/* src=families fam=H_fam_0033 ax=0x- ay=0x- */
/begin CHARACTERISTIC H_fam_0033_195B7E "RE map_interp_H H_fam_0033 call=0x80097DB0" VALUE 0x195B7E RL_IDENTITY 0 NO_INPUT_QUANTITY 1.0 /end CHARACTERISTIC
/* src=families fam=I_fam_0009 ax=0x1A2B64 ay=0x- */
/begin CHARACTERISTIC I_fam_0009_195BC4 "RE map_interp_I I_fam_0009 call=0x80094B0A" VALUE 0x195BC4 RL_IDENTITY 0 NO_INPUT_QUANTITY 1.0 /end CHARACTERISTIC
/* src=families fam=K_fam_0002 ax=0x1A0B44 ay=0x- */ /* STUB unknown size; axis_x=0x1A0B44 axis_y=0x- */
/begin CHARACTERISTIC K_fam_0002_196A98 "RE map_interp_K K_fam_0002 call=0x80094994" VALUE 0x196A98 RL_IDENTITY 0 NO_INPUT_QUANTITY 1.0 /end CHARACTERISTIC
/* src=families fam=G_fam_0011 ax=0x- ay=0x- */
/begin CHARACTERISTIC G_fam_0011_196B04 "RE map_interp_G G_fam_0011 call=0x80094BEE" VALUE 0x196B04 RL_IDENTITY 0 NO_INPUT_QUANTITY 1.0 /end CHARACTERISTIC
/* src=families fam=I_fam_0019 ax=0x- ay=0x- */
/begin CHARACTERISTIC I_fam_0019_196BC0 "RE map_interp_I I_fam_0019 call=0x80094BBC" VALUE 0x196BC0 RL_IDENTITY 0 NO_INPUT_QUANTITY 1.0 /end CHARACTERISTIC
/begin CHARACTERISTIC e6e8_curve_197382 "RE 1D FUN_8004bdc8 X=D000E6E8 (ratio, NOT rail bar). Size unproven." VALUE 0x197382 RL_IDENTITY 0 NO_INPUT_QUANTITY 1.0 /end CHARACTERISTIC
/begin CHARACTERISTIC e6e8_interpH_1973A8 "RE map_interp_H after E6E8 store @80091ADC. Size unproven." VALUE 0x1973A8 RL_IDENTITY 0 NO_INPUT_QUANTITY 1.0 /end CHARACTERISTIC
/* src=families fam=F_fam_0087 ax=0x- ay=0x- */
/begin CHARACTERISTIC F_fam_0087_197998 "RE map_interp_F F_fam_0087 call=0x800F0CAE" VALUE 0x197998 RL_IDENTITY 0 NO_INPUT_QUANTITY 1.0 /end CHARACTERISTIC
/* src=families fam=D_fam_0114 ax=0x- ay=0x- */
/begin CHARACTERISTIC D_fam_0114_197A60 "RE map_interp_D D_fam_0114 call=0x8009968E" VALUE 0x197A60 RL_IDENTITY 0 NO_INPUT_QUANTITY 1.0 /end CHARACTERISTIC
/* src=families fam=K_fam_0003 ax=0x1A0B7C ay=0x- */ /* STUB unknown size; axis_x=0x1A0B7C axis_y=0x- */
/begin CHARACTERISTIC K_fam_0003_197AA8 "RE map_interp_K K_fam_0003 call=0x80094A34" VALUE 0x197AA8 RL_IDENTITY 0 NO_INPUT_QUANTITY 1.0 /end CHARACTERISTIC
/* src=families fam=G_fam_0012 ax=0x- ay=0x- */
/begin CHARACTERISTIC G_fam_0012_197B14 "RE map_interp_G G_fam_0012 call=0x80094C90" VALUE 0x197B14 RL_IDENTITY 0 NO_INPUT_QUANTITY 1.0 /end CHARACTERISTIC
/* src=families fam=C_fam_0201 ax=0x1AD6D8 ay=0x- */ /* STUB unknown size; axis_x=0x1AD6D8 axis_y=0x- */
/begin CHARACTERISTIC C_fam_0201_1983F0 "RE map_interp_C C_fam_0201 call=0x800FA20A" VALUE 0x1983F0 RL_IDENTITY 0 NO_INPUT_QUANTITY 1.0 /end CHARACTERISTIC
/* src=families fam=C_fam_0327 ax=0x- ay=0x- */
/begin CHARACTERISTIC C_fam_0327_198430 "RE map_interp_C C_fam_0327 call=0x800F6560" VALUE 0x198430 RL_IDENTITY 0 NO_INPUT_QUANTITY 1.0 /end CHARACTERISTIC
/* src=families fam=D_fam_0145 ax=0x1A145C ay=0x1B3208 */
/begin CHARACTERISTIC D_fam_0145_198440 "RE map_interp_D D_fam_0145 call=0x8008CAD8; RE map_interp_F F_fam_0004 call=0x80" MAP 0x198440 RL_IDENTITY 0 NO_INPUT_QUANTITY 1.0 FORMAT "%%5.0"
 /begin AXIS_DESCR COM_AXIS NO_INPUT_QUANTITY NO_COMPU_METHOD 27 AXIS_PTS_REF AX_1A145C /end AXIS_DESCR
 /begin AXIS_DESCR COM_AXIS NO_INPUT_QUANTITY NO_COMPU_METHOD 2 AXIS_PTS_REF AX_1B3208 /end AXIS_DESCR
/end CHARACTERISTIC
/* src=families fam=D_fam_0022 ax=0x1A145C ay=0x1B3208 */
/begin CHARACTERISTIC D_fam_0022_198450 "RE map_interp_D D_fam_0022 call=0x8008CB12; RE map_interp_F F_fam_0004 call=0x80" MAP 0x198450 RL_IDENTITY 0 NO_INPUT_QUANTITY 1.0 FORMAT "%%5.0"
 /begin AXIS_DESCR COM_AXIS NO_INPUT_QUANTITY NO_COMPU_METHOD 27 AXIS_PTS_REF AX_1A145C /end AXIS_DESCR
 /begin AXIS_DESCR COM_AXIS NO_INPUT_QUANTITY NO_COMPU_METHOD 2 AXIS_PTS_REF AX_1B3208 /end AXIS_DESCR
/end CHARACTERISTIC
/* src=families fam=C_fam_0343 ax=0x- ay=0x- */
/begin CHARACTERISTIC C_fam_0343_19847C "RE map_interp_C C_fam_0343 call=0x8011C02E" VALUE 0x19847C RL_IDENTITY 0 NO_INPUT_QUANTITY 1.0 /end CHARACTERISTIC
/* src=horsA2L fam=- ax=0x19848C ay=0x19A5C8 */ /* STUB unknown size; axis_x=0x19848C axis_y=0x19A5C8 */
/begin CHARACTERISTIC map_horsA2L_19848C "low: 8000/A000 fill - pas une grille Nm lisible (ex. 1C4994); identique 64o vs 9" VALUE 0x19848C RL_IDENTITY 0 NO_INPUT_QUANTITY 1.0 /end CHARACTERISTIC
/* src=families fam=C_fam_0163 ax=0x1AE6D8 ay=0x- */ /* STUB unknown size; axis_x=0x1AE6D8 axis_y=0x- */
/begin CHARACTERISTIC C_fam_0163_1984B0 "RE map_interp_C C_fam_0163 call=0x8013E76E" VALUE 0x1984B0 RL_IDENTITY 0 NO_INPUT_QUANTITY 1.0 /end CHARACTERISTIC
/* src=families fam=C_fam_0170 ax=0x1B676C ay=0x- */ /* STUB unknown size; axis_x=0x1B676C axis_y=0x- */
/begin CHARACTERISTIC C_fam_0170_1984C4 "RE map_interp_C C_fam_0170 call=0x800DE9E6" VALUE 0x1984C4 RL_IDENTITY 0 NO_INPUT_QUANTITY 1.0 /end CHARACTERISTIC
/* src=families fam=C_fam_0223 ax=0x1B774C ay=0x- */ /* STUB unknown size; axis_x=0x1B774C axis_y=0x- */
/begin CHARACTERISTIC C_fam_0223_1984D8 "RE map_interp_C C_fam_0223 call=0x800DEBB2" VALUE 0x1984D8 RL_IDENTITY 0 NO_INPUT_QUANTITY 1.0 /end CHARACTERISTIC
/* src=families fam=N_fam_0020 ax=0x- ay=0x- */
/begin CHARACTERISTIC N_fam_0020_198530 "RE map_interp_N N_fam_0020 call=0x800DDFC2" VALUE 0x198530 RL_IDENTITY 0 NO_INPUT_QUANTITY 1.0 /end CHARACTERISTIC
/* src=families fam=fam_0081 ax=0x1B46FC ay=0x1A5768 */
/begin CHARACTERISTIC map_horsA2L_198544 "RE interp_2d fam_0081 call=0x800E28E2" MAP 0x198544 RL_IDENTITY 0 NO_INPUT_QUANTITY 1.0 FORMAT "%%5.0"
 /begin AXIS_DESCR COM_AXIS NO_INPUT_QUANTITY NO_COMPU_METHOD 2 AXIS_PTS_REF AX_1B46FC /end AXIS_DESCR
 /begin AXIS_DESCR COM_AXIS NO_INPUT_QUANTITY NO_COMPU_METHOD 15 AXIS_PTS_REF AX_1A5768 /end AXIS_DESCR
/end CHARACTERISTIC
/* src=families fam=D_fam_0105 ax=0x1BD958 ay=0x1AA67C */
/begin CHARACTERISTIC D_fam_0105_198558 "RE map_interp_D D_fam_0105 call=0x800E2404; RE map_interp_F F_fam_0008 call=0x80" MAP 0x198558 RL_IDENTITY 0 NO_INPUT_QUANTITY 1.0 FORMAT "%%5.0"
 /begin AXIS_DESCR COM_AXIS NO_INPUT_QUANTITY NO_COMPU_METHOD 2 AXIS_PTS_REF AX_1BD958 /end AXIS_DESCR
 /begin AXIS_DESCR COM_AXIS NO_INPUT_QUANTITY NO_COMPU_METHOD 2 AXIS_PTS_REF AX_1AA67C /end AXIS_DESCR
/end CHARACTERISTIC
/* src=families fam=K_fam_0014 ax=0x1B582C ay=0x1A76EC */
/begin CHARACTERISTIC K_fam_0014_198630 "RE map_interp_K K_fam_0014 call=0x800FD890" MAP 0x198630 RL_IDENTITY 0 NO_INPUT_QUANTITY 1.0 FORMAT "%%5.0"
 /begin AXIS_DESCR COM_AXIS NO_INPUT_QUANTITY NO_COMPU_METHOD 2 AXIS_PTS_REF AX_1B582C /end AXIS_DESCR
 /begin AXIS_DESCR COM_AXIS NO_INPUT_QUANTITY NO_COMPU_METHOD 2 AXIS_PTS_REF AX_1A76EC /end AXIS_DESCR
/end CHARACTERISTIC
/* src=families fam=C_fam_0211 ax=0x1AE738 ay=0x- */ /* STUB unknown size; axis_x=0x1AE738 axis_y=0x- */
/begin CHARACTERISTIC C_fam_0211_198640 "RE map_interp_C C_fam_0211 call=0x800EA720" VALUE 0x198640 RL_IDENTITY 0 NO_INPUT_QUANTITY 1.0 /end CHARACTERISTIC
/* src=families fam=G_fam_0082 ax=0x1B2904 ay=0x- */ /* STUB unknown size; axis_x=0x1B2904 axis_y=0x- */
/begin CHARACTERISTIC G_fam_0082_1986A8 "RE map_interp_G G_fam_0082 call=0x80087718" VALUE 0x1986A8 RL_IDENTITY 0 NO_INPUT_QUANTITY 1.0 /end CHARACTERISTIC
/* src=families fam=B_fam_0026 ax=0x1B26FC ay=0x- */ /* STUB unknown size; axis_x=0x1B26FC axis_y=0x- */
/begin CHARACTERISTIC B_fam_0026_1986D0 "RE interp_2d_B B_fam_0026 call=0x800E2864" VALUE 0x1986D0 RL_IDENTITY 0 NO_INPUT_QUANTITY 1.0 /end CHARACTERISTIC
/* src=families fam=D_fam_0065 ax=0x1BB96C ay=0x1A2550 */
/begin CHARACTERISTIC D_fam_0065_1986DC "RE map_interp_D D_fam_0065 call=0x800F5BAE; RE map_interp_I I_fam_0045 call=0x80" MAP 0x1986DC RL_IDENTITY 0 NO_INPUT_QUANTITY 1.0 FORMAT "%%5.0"
 /begin AXIS_DESCR COM_AXIS NO_INPUT_QUANTITY NO_COMPU_METHOD 2 AXIS_PTS_REF AX_1BB96C /end AXIS_DESCR
 /begin AXIS_DESCR COM_AXIS NO_INPUT_QUANTITY NO_COMPU_METHOD 2 AXIS_PTS_REF AX_1A2550 /end AXIS_DESCR
/end CHARACTERISTIC
/* src=families fam=fam_0046 ax=0x1A5530 ay=0x1B03A4 */
/begin CHARACTERISTIC map_horsA2L_198708 "RE interp_2d fam_0046 call=0x800E677E; RE interp_2d_B B_fam_0014 call=0x800E67A0" MAP 0x198708 RL_IDENTITY 0 NO_INPUT_QUANTITY 1.0 FORMAT "%%5.0"
 /begin AXIS_DESCR COM_AXIS NO_INPUT_QUANTITY NO_COMPU_METHOD 2 AXIS_PTS_REF AX_1A5530 /end AXIS_DESCR
 /begin AXIS_DESCR COM_AXIS NO_INPUT_QUANTITY NO_COMPU_METHOD 2 AXIS_PTS_REF AX_1B03A4 /end AXIS_DESCR
/end CHARACTERISTIC
/* src=families fam=F_fam_0091 ax=0x1BD8D8 ay=0x- */ /* STUB unknown size; axis_x=0x1BD8D8 axis_y=0x- */
/begin CHARACTERISTIC F_fam_0091_1987C4 "RE map_interp_F F_fam_0091 call=0x800B7602; RE map_interp_G G_fam_0016 call=0x80" VALUE 0x1987C4 RL_IDENTITY 0 NO_INPUT_QUANTITY 1.0 /end CHARACTERISTIC
/* src=families fam=D_fam_0128 ax=0x1A6738 ay=0x- */ /* STUB unknown size; axis_x=0x1A6738 axis_y=0x- */
/begin CHARACTERISTIC D_fam_0128_1987D0 "RE map_interp_D D_fam_0128 call=0x8008E53C; RE map_interp_I I_fam_0067 call=0x80" VALUE 0x1987D0 RL_IDENTITY 0 NO_INPUT_QUANTITY 1.0 /end CHARACTERISTIC
/* src=families fam=D_fam_0035 ax=0x1A7450 ay=0x1A7704 */
/begin CHARACTERISTIC D_fam_0035_1987DC "RE map_interp_D D_fam_0035 call=0x8008CD28; RE map_interp_I I_fam_0068 call=0x80" MAP 0x1987DC RL_IDENTITY 0 NO_INPUT_QUANTITY 1.0 FORMAT "%%5.0"
 /begin AXIS_DESCR COM_AXIS NO_INPUT_QUANTITY NO_COMPU_METHOD 2 AXIS_PTS_REF AX_1A7450 /end AXIS_DESCR
 /begin AXIS_DESCR COM_AXIS NO_INPUT_QUANTITY NO_COMPU_METHOD 2 AXIS_PTS_REF AX_1A7704 /end AXIS_DESCR
/end CHARACTERISTIC
/* src=families fam=C_fam_0178 ax=0x1BB9D0 ay=0x- */ /* STUB unknown size; axis_x=0x1BB9D0 axis_y=0x- */
/begin CHARACTERISTIC C_fam_0178_1987F8 "RE map_interp_C C_fam_0178 call=0x800C6464" VALUE 0x1987F8 RL_IDENTITY 0 NO_INPUT_QUANTITY 1.0 /end CHARACTERISTIC
/* src=families fam=H_fam_0011 ax=0x1A7BE0 ay=0x- */ /* STUB unknown size; axis_x=0x1A7BE0 axis_y=0x- */
/begin CHARACTERISTIC H_fam_0011_198BF8 "RE map_interp_H H_fam_0011 call=0x800A492C" VALUE 0x198BF8 RL_IDENTITY 0 NO_INPUT_QUANTITY 1.0 /end CHARACTERISTIC
/* src=families fam=C_fam_0224 ax=0x1B1744 ay=0x1B1744 */
/begin CHARACTERISTIC C_fam_0224_1993E0 "RE map_interp_C C_fam_0224 call=0x800FC2C8" MAP 0x1993E0 RL_IDENTITY 0 NO_INPUT_QUANTITY 1.0 FORMAT "%%5.0"
 /begin AXIS_DESCR COM_AXIS NO_INPUT_QUANTITY NO_COMPU_METHOD 2 AXIS_PTS_REF AX_1B1744 /end AXIS_DESCR
 /begin AXIS_DESCR COM_AXIS NO_INPUT_QUANTITY NO_COMPU_METHOD 2 AXIS_PTS_REF AX_1B1744 /end AXIS_DESCR
/end CHARACTERISTIC
/* src=families fam=D_fam_0214 ax=0x1B6718 ay=0x- */
/begin CHARACTERISTIC D_fam_0214_19940C "RE map_interp_D D_fam_0214 call=0x800E2CAA; RE map_interp_I I_fam_0056 call=0x80" VALUE 0x19940C RL_IDENTITY 0 NO_INPUT_QUANTITY 1.0 /end CHARACTERISTIC
/* src=families fam=E_fam_0027 ax=0x1B5820 ay=0x1A6600 */
/begin CHARACTERISTIC E_fam_0027_199448 "RE map_interp_E E_fam_0027 call=0x80087894" MAP 0x199448 RL_IDENTITY 0 NO_INPUT_QUANTITY 1.0 FORMAT "%%5.0"
 /begin AXIS_DESCR COM_AXIS NO_INPUT_QUANTITY NO_COMPU_METHOD 2 AXIS_PTS_REF AX_1B5820 /end AXIS_DESCR
 /begin AXIS_DESCR COM_AXIS NO_INPUT_QUANTITY NO_COMPU_METHOD 2 AXIS_PTS_REF AX_1A6600 /end AXIS_DESCR
/end CHARACTERISTIC
/* src=families fam=C_fam_0202 ax=0x1AE95C ay=0x- */ /* STUB unknown size; axis_x=0x1AE95C axis_y=0x- */
/begin CHARACTERISTIC C_fam_0202_19945C "RE map_interp_C C_fam_0202 call=0x800C5524" VALUE 0x19945C RL_IDENTITY 0 NO_INPUT_QUANTITY 1.0 /end CHARACTERISTIC
/* src=families fam=C_fam_0233 ax=0x1AC1B4 ay=0x- */ /* STUB unknown size; axis_x=0x1AC1B4 axis_y=0x- */
/begin CHARACTERISTIC C_fam_0233_19946C "RE map_interp_C C_fam_0233 call=0x8008637C" VALUE 0x19946C RL_IDENTITY 0 NO_INPUT_QUANTITY 1.0 /end CHARACTERISTIC
/* src=families fam=L_fam_0029 ax=0x1B39E8 ay=0x- */ /* STUB unknown size; axis_x=0x1B39E8 axis_y=0x- */
/begin CHARACTERISTIC L_fam_0029_199484 "RE map_interp_L L_fam_0029 call=0x8009B7A6" VALUE 0x199484 RL_IDENTITY 0 NO_INPUT_QUANTITY 1.0 /end CHARACTERISTIC
/* src=families fam=J_fam_0034 ax=0x1ABAC8 ay=0x- */ /* STUB unknown size; axis_x=0x1ABAC8 axis_y=0x- */
/begin CHARACTERISTIC J_fam_0034_199490 "RE map_interp_J J_fam_0034 call=0x8009A598" VALUE 0x199490 RL_IDENTITY 0 NO_INPUT_QUANTITY 1.0 /end CHARACTERISTIC
/* src=families fam=L_fam_0034 ax=0x1AAAE8 ay=0x- */ /* STUB unknown size; axis_x=0x1AAAE8 axis_y=0x- */
/begin CHARACTERISTIC L_fam_0034_199534 "RE map_interp_L L_fam_0034 call=0x8009B032" VALUE 0x199534 RL_IDENTITY 0 NO_INPUT_QUANTITY 1.0 /end CHARACTERISTIC
/* src=families fam=G_fam_0041 ax=0x1AA898 ay=0x1A666C */
/begin CHARACTERISTIC G_fam_0041_199640 "RE map_interp_G G_fam_0041 call=0x800F0652" MAP 0x199640 RL_IDENTITY 0 NO_INPUT_QUANTITY 1.0 FORMAT "%%5.0"
 /begin AXIS_DESCR COM_AXIS NO_INPUT_QUANTITY NO_COMPU_METHOD 2 AXIS_PTS_REF AX_1AA898 /end AXIS_DESCR
 /begin AXIS_DESCR COM_AXIS NO_INPUT_QUANTITY NO_COMPU_METHOD 2 AXIS_PTS_REF AX_1A666C /end AXIS_DESCR
/end CHARACTERISTIC
/* src=families fam=E_fam_0021 ax=0x1A92AC ay=0x1AB2AC */
/begin CHARACTERISTIC E_fam_0021_1996B8 "RE map_interp_E E_fam_0021 call=0x8012072C" MAP 0x1996B8 RL_IDENTITY 0 NO_INPUT_QUANTITY 1.0 FORMAT "%%5.0"
 /begin AXIS_DESCR COM_AXIS NO_INPUT_QUANTITY NO_COMPU_METHOD 2 AXIS_PTS_REF AX_1A92AC /end AXIS_DESCR
 /begin AXIS_DESCR COM_AXIS NO_INPUT_QUANTITY NO_COMPU_METHOD 2 AXIS_PTS_REF AX_1AB2AC /end AXIS_DESCR
/end CHARACTERISTIC
/* src=families fam=I_fam_0046 ax=0x1BD958 ay=0x1AA5FC */
/begin CHARACTERISTIC I_fam_0046_1996D8 "RE map_interp_I I_fam_0046 call=0x800E23DC; RE map_interp_K K_fam_0019 call=0x80" MAP 0x1996D8 RL_IDENTITY 0 NO_INPUT_QUANTITY 1.0 FORMAT "%%5.0"
 /begin AXIS_DESCR COM_AXIS NO_INPUT_QUANTITY NO_COMPU_METHOD 2 AXIS_PTS_REF AX_1BD958 /end AXIS_DESCR
 /begin AXIS_DESCR COM_AXIS NO_INPUT_QUANTITY NO_COMPU_METHOD 2 AXIS_PTS_REF AX_1AA5FC /end AXIS_DESCR
/end CHARACTERISTIC
/* src=families fam=C_fam_0206 ax=0x1B9AC4 ay=0x- */ /* STUB unknown size; axis_x=0x1B9AC4 axis_y=0x- */
/begin CHARACTERISTIC C_fam_0206_199728 "RE map_interp_C C_fam_0206 call=0x800E25BA" VALUE 0x199728 RL_IDENTITY 0 NO_INPUT_QUANTITY 1.0 /end CHARACTERISTIC
/* src=families fam=C_fam_0176 ax=0x1B9AD0 ay=0x- */ /* STUB unknown size; axis_x=0x1B9AD0 axis_y=0x- */
/begin CHARACTERISTIC C_fam_0176_199738 "RE map_interp_C C_fam_0176 call=0x800E9418" VALUE 0x199738 RL_IDENTITY 0 NO_INPUT_QUANTITY 1.0 /end CHARACTERISTIC
/* src=families fam=fam_0103 ax=0x1BFAD0 ay=0x- */ /* STUB unknown size; axis_x=0x1BFAD0 axis_y=0x- */
/begin CHARACTERISTIC map_horsA2L_19F540 "RE interp_2d fam_0103 call=0x801121FE" VALUE 0x199760 RL_IDENTITY 0 NO_INPUT_QUANTITY 1.0 /end CHARACTERISTIC
/* src=families fam=C_fam_0294 ax=0x- ay=0x- */
/begin CHARACTERISTIC C_fam_0294_1997E8 "RE map_interp_C C_fam_0294 call=0x800ADE62" VALUE 0x1997E8 RL_IDENTITY 0 NO_INPUT_QUANTITY 1.0 /end CHARACTERISTIC
/* src=families fam=B_fam_0028 ax=0x1BD9C4 ay=0x- */ /* STUB unknown size; axis_x=0x1BD9C4 axis_y=0x- */
/begin CHARACTERISTIC B_fam_0028_1997F4 "RE interp_2d_B B_fam_0028 call=0x800C69C8" VALUE 0x1997F4 RL_IDENTITY 0 NO_INPUT_QUANTITY 1.0 /end CHARACTERISTIC
/* src=families fam=H_fam_0011 ax=0x1A7BE0 ay=0x- */ /* STUB unknown size; axis_x=0x1A7BE0 axis_y=0x- */
/begin CHARACTERISTIC H_fam_0011_199BC4 "RE map_interp_H H_fam_0011 call=0x800A494C" VALUE 0x199BC4 RL_IDENTITY 0 NO_INPUT_QUANTITY 1.0 /end CHARACTERISTIC
/* src=families fam=L_fam_0041 ax=0x- ay=0x- */
/begin CHARACTERISTIC L_fam_0041_199BD0 "RE map_interp_L L_fam_0041 call=0x800BBF64" VALUE 0x199BD0 RL_IDENTITY 0 NO_INPUT_QUANTITY 1.0 /end CHARACTERISTIC
/* src=families fam=E_fam_0039 ax=0x1B0C20 ay=0x- */ /* STUB unknown size; axis_x=0x1B0C20 axis_y=0x- */
/begin CHARACTERISTIC E_fam_0039_19A3C8 "RE map_interp_E E_fam_0039 call=0x800FA3F0" VALUE 0x19A3C8 RL_IDENTITY 0 NO_INPUT_QUANTITY 1.0 /end CHARACTERISTIC
/* src=families fam=C_fam_0090 ax=0x1A88EC ay=0x1A14C4 */
/begin CHARACTERISTIC C_fam_0090_19A438 "RE map_interp_C C_fam_0090 call=0x80087920" MAP 0x19A438 RL_IDENTITY 0 NO_INPUT_QUANTITY 1.0 FORMAT "%%5.0"
 /begin AXIS_DESCR COM_AXIS NO_INPUT_QUANTITY NO_COMPU_METHOD 2 AXIS_PTS_REF AX_1A88EC /end AXIS_DESCR
 /begin AXIS_DESCR COM_AXIS NO_INPUT_QUANTITY NO_COMPU_METHOD 2 AXIS_PTS_REF AX_1A14C4 /end AXIS_DESCR
/end CHARACTERISTIC
/* src=families fam=C_fam_0138 ax=0x1A467C ay=0x- */ /* STUB unknown size; axis_x=0x1A467C axis_y=0x- */
/begin CHARACTERISTIC C_fam_0138_19A44C "RE map_interp_C C_fam_0138 call=0x8007C648" VALUE 0x19A44C RL_IDENTITY 0 NO_INPUT_QUANTITY 1.0 /end CHARACTERISTIC
/* src=families fam=fam_0013 ax=0x1AB908 ay=0x1AE8E0 */
/begin CHARACTERISTIC fam_0013_19A468 "RE interp_2d fam_0013 call=0x8007F178; RE map_interp_N N_fam_0007 call=0x8007F14" MAP 0x19A468 RL_IDENTITY 0 NO_INPUT_QUANTITY 1.0 FORMAT "%%5.0"
 /begin AXIS_DESCR COM_AXIS NO_INPUT_QUANTITY NO_COMPU_METHOD 2 AXIS_PTS_REF AX_1AB908 /end AXIS_DESCR
 /begin AXIS_DESCR COM_AXIS NO_INPUT_QUANTITY NO_COMPU_METHOD 2 AXIS_PTS_REF AX_1AE8E0 /end AXIS_DESCR
/end CHARACTERISTIC
/* src=families fam=L_fam_0030 ax=0x1B4B0C ay=0x- */ /* STUB unknown size; axis_x=0x1B4B0C axis_y=0x- */
/begin CHARACTERISTIC L_fam_0030_19A488 "RE map_interp_L L_fam_0030 call=0x800B200E" VALUE 0x19A488 RL_IDENTITY 0 NO_INPUT_QUANTITY 1.0 /end CHARACTERISTIC
/* src=families fam=C_fam_0271 ax=0x1B6C34 ay=0x- */ /* STUB unknown size; axis_x=0x1B6C34 axis_y=0x- */
/begin CHARACTERISTIC C_fam_0271_19A494 "RE map_interp_C C_fam_0271 call=0x80114B3C" VALUE 0x19A494 RL_IDENTITY 0 NO_INPUT_QUANTITY 1.0 /end CHARACTERISTIC
/* src=families fam=C_fam_0038 ax=0x1BFA78 ay=0x- */ /* STUB unknown size; axis_x=0x1BFA78 axis_y=0x- */
/begin CHARACTERISTIC C_fam_0038_19A51C "RE map_interp_C C_fam_0038 call=0x800A2F06" VALUE 0x19A51C RL_IDENTITY 0 NO_INPUT_QUANTITY 1.0 /end CHARACTERISTIC
/* src=families fam=C_fam_0259 ax=0x- ay=0x- */
/begin CHARACTERISTIC C_fam_0259_19A53C "RE map_interp_C C_fam_0259 call=0x800D5992" VALUE 0x19A53C RL_IDENTITY 0 NO_INPUT_QUANTITY 1.0 /end CHARACTERISTIC
/* src=families fam=fam_0029 ax=0x1A14F0 ay=0x1A9984 */
/begin CHARACTERISTIC map_horsA2L_19848C_19A5C8 "RE interp_2d fam_0029 call=0x800F953A" MAP 0x19A5C8 RL_IDENTITY 0 NO_INPUT_QUANTITY 1.0 FORMAT "%%5.0"
 /begin AXIS_DESCR COM_AXIS NO_INPUT_QUANTITY NO_COMPU_METHOD 2 AXIS_PTS_REF AX_1A14F0 /end AXIS_DESCR
 /begin AXIS_DESCR COM_AXIS NO_INPUT_QUANTITY NO_COMPU_METHOD 2 AXIS_PTS_REF AX_1A9984 /end AXIS_DESCR
/end CHARACTERISTIC
/* src=families fam=D_fam_0213 ax=0x1B6864 ay=0x- */ /* STUB unknown size; axis_x=0x1B6864 axis_y=0x- */
/begin CHARACTERISTIC D_fam_0213_19A5FC "RE map_interp_D D_fam_0213 call=0x800E0C50" VALUE 0x19A5FC RL_IDENTITY 0 NO_INPUT_QUANTITY 1.0 /end CHARACTERISTIC
/* src=families fam=F_fam_0021 ax=0x1AC820 ay=0x- */ /* STUB unknown size; axis_x=0x1AC820 axis_y=0x- */
/begin CHARACTERISTIC F_fam_0021_19A644 "RE map_interp_F F_fam_0021 call=0x800F029A; RE map_interp_G G_fam_0068 call=0x80" VALUE 0x19A644 RL_IDENTITY 0 NO_INPUT_QUANTITY 1.0 /end CHARACTERISTIC
/* src=families fam=D_fam_0206 ax=0x1BA9B8 ay=0x- */ /* STUB unknown size; axis_x=0x1BA9B8 axis_y=0x- */
/begin CHARACTERISTIC D_fam_0206_19A654 "RE map_interp_D D_fam_0206 call=0x800CB7D2; RE map_interp_I I_fam_0059 call=0x80" VALUE 0x19A654 RL_IDENTITY 0 NO_INPUT_QUANTITY 1.0 /end CHARACTERISTIC
/* src=families fam=N_fam_0023 ax=0x- ay=0x- */
/begin CHARACTERISTIC N_fam_0023_19A678 "RE map_interp_N N_fam_0023 call=0x800F3ED0" VALUE 0x19A678 RL_IDENTITY 0 NO_INPUT_QUANTITY 1.0 /end CHARACTERISTIC
/* src=families fam=C_fam_0128 ax=0x1B9AE8 ay=0x1AC800 */
/begin CHARACTERISTIC C_fam_0128_19A708 "RE map_interp_C C_fam_0128 call=0x800F1E54" MAP 0x19A708 RL_IDENTITY 0 NO_INPUT_QUANTITY 1.0 FORMAT "%%5.0"
 /begin AXIS_DESCR COM_AXIS NO_INPUT_QUANTITY NO_COMPU_METHOD 2 AXIS_PTS_REF AX_1B9AE8 /end AXIS_DESCR
 /begin AXIS_DESCR COM_AXIS NO_INPUT_QUANTITY NO_COMPU_METHOD 2 AXIS_PTS_REF AX_1AC800 /end AXIS_DESCR
/end CHARACTERISTIC
/* src=families fam=C_fam_0198 ax=0x1BAAC4 ay=0x- */ /* STUB unknown size; axis_x=0x1BAAC4 axis_y=0x- */
/begin CHARACTERISTIC C_fam_0198_19A718 "RE map_interp_C C_fam_0198 call=0x800E2F98" VALUE 0x19A718 RL_IDENTITY 0 NO_INPUT_QUANTITY 1.0 /end CHARACTERISTIC
/* src=families fam=F_fam_0022 ax=0x1ACEB4 ay=0x- */ /* STUB unknown size; axis_x=0x1ACEB4 axis_y=0x- */
/begin CHARACTERISTIC F_fam_0022_19A728 "RE map_interp_F F_fam_0022 call=0x800F5AB0; RE map_interp_G G_fam_0070 call=0x80" VALUE 0x19A728 RL_IDENTITY 0 NO_INPUT_QUANTITY 1.0 /end CHARACTERISTIC
/* src=families fam=B_fam_0018 ax=0x1AB21C ay=0x1A5518 */
/begin CHARACTERISTIC B_fam_0018_19A7D0 "RE interp_2d_B B_fam_0018 call=0x800AEF4C; RE map_interp_C C_fam_0048 call=0x800" MAP 0x19A7D0 RL_IDENTITY 0 NO_INPUT_QUANTITY 1.0 FORMAT "%%5.0"
 /begin AXIS_DESCR COM_AXIS NO_INPUT_QUANTITY NO_COMPU_METHOD 2 AXIS_PTS_REF AX_1AB21C /end AXIS_DESCR
 /begin AXIS_DESCR COM_AXIS NO_INPUT_QUANTITY NO_COMPU_METHOD 2 AXIS_PTS_REF AX_1A5518 /end AXIS_DESCR
/end CHARACTERISTIC
/* src=families fam=C_fam_0050 ax=0x1A06F8 ay=0x1BB9F8 */
/begin CHARACTERISTIC C_fam_0050_19A7EC "RE map_interp_C C_fam_0050 call=0x801125E6" MAP 0x19A7EC RL_IDENTITY 0 NO_INPUT_QUANTITY 1.0 FORMAT "%%5.0"
 /begin AXIS_DESCR COM_AXIS NO_INPUT_QUANTITY NO_COMPU_METHOD 2 AXIS_PTS_REF AX_1A06F8 /end AXIS_DESCR
 /begin AXIS_DESCR COM_AXIS NO_INPUT_QUANTITY NO_COMPU_METHOD 2 AXIS_PTS_REF AX_1BB9F8 /end AXIS_DESCR
/end CHARACTERISTIC
/* src=families fam=L_fam_0004 ax=0x1A7BF8 ay=0x1A7BF8 */
/begin CHARACTERISTIC L_fam_0004_19ABEC "RE map_interp_L L_fam_0004 call=0x800A49DA" MAP 0x19ABEC RL_IDENTITY 0 NO_INPUT_QUANTITY 1.0 FORMAT "%%5.0"
 /begin AXIS_DESCR COM_AXIS NO_INPUT_QUANTITY NO_COMPU_METHOD 2 AXIS_PTS_REF AX_1A7BF8 /end AXIS_DESCR
 /begin AXIS_DESCR COM_AXIS NO_INPUT_QUANTITY NO_COMPU_METHOD 2 AXIS_PTS_REF AX_1A7BF8 /end AXIS_DESCR
/end CHARACTERISTIC
/* src=families fam=G_fam_0077 ax=0x1A0C14 ay=0x- */ /* STUB unknown size; axis_x=0x1A0C14 axis_y=0x- */
/begin CHARACTERISTIC G_fam_0077_19AC28 "RE map_interp_G G_fam_0077 call=0x8009B5A2" VALUE 0x19AC28 RL_IDENTITY 0 NO_INPUT_QUANTITY 1.0 /end CHARACTERISTIC
/* src=families fam=C_fam_0185 ax=0x- ay=0x- */
/begin CHARACTERISTIC C_fam_0185_19ADD0 "RE map_interp_C C_fam_0185 call=0x8009B98A" VALUE 0x19ADD0 RL_IDENTITY 0 NO_INPUT_QUANTITY 1.0 /end CHARACTERISTIC
/* src=families fam=N_fam_0028 ax=0x- ay=0x- */
/begin CHARACTERISTIC N_fam_0028_19ADF4 "RE map_interp_N N_fam_0028 call=0x800C8612" VALUE 0x19ADF4 RL_IDENTITY 0 NO_INPUT_QUANTITY 1.0 /end CHARACTERISTIC
/* src=families fam=fam_0068 ax=0x1ABBC8 ay=0x1A570C */
/begin CHARACTERISTIC map_horsA2L_19B3E0 "RE interp_2d fam_0068 call=0x800FB0E4; RE map_interp_N N_fam_0008 call=0x800FB0F" MAP 0x19B3E0 RL_IDENTITY 0 NO_INPUT_QUANTITY 1.0 FORMAT "%%5.0"
 /begin AXIS_DESCR COM_AXIS NO_INPUT_QUANTITY NO_COMPU_METHOD 2 AXIS_PTS_REF AX_1ABBC8 /end AXIS_DESCR
 /begin AXIS_DESCR COM_AXIS NO_INPUT_QUANTITY NO_COMPU_METHOD 2 AXIS_PTS_REF AX_1A570C /end AXIS_DESCR
/end CHARACTERISTIC
/* src=horsA2L fam=- ax=0x19B3F0 ay=0x19C3C0 */ /* STUB unknown size; axis_x=0x19B3F0 axis_y=0x19C3C0 */
/begin CHARACTERISTIC map_horsA2L_19B3F0 "low: 8000/A000 fill - pas une grille Nm lisible (ex. 1C4994); identique 64o vs 9" VALUE 0x19B3F0 RL_IDENTITY 0 NO_INPUT_QUANTITY 1.0 /end CHARACTERISTIC
/* src=families fam=M_fam_0008 ax=0x1BA9D8 ay=0x1B5820 */
/begin CHARACTERISTIC M_fam_0008_19B40C "RE map_interp_M M_fam_0008 call=0x800878C0" MAP 0x19B40C RL_IDENTITY 0 NO_INPUT_QUANTITY 1.0 FORMAT "%%5.0"
 /begin AXIS_DESCR COM_AXIS NO_INPUT_QUANTITY NO_COMPU_METHOD 2 AXIS_PTS_REF AX_1BA9D8 /end AXIS_DESCR
 /begin AXIS_DESCR COM_AXIS NO_INPUT_QUANTITY NO_COMPU_METHOD 2 AXIS_PTS_REF AX_1B5820 /end AXIS_DESCR
/end CHARACTERISTIC
/* src=families fam=C_fam_0179 ax=0x1BC030 ay=0x- */ /* STUB unknown size; axis_x=0x1BC030 axis_y=0x- */
/begin CHARACTERISTIC C_fam_0179_19B420 "RE map_interp_C C_fam_0179 call=0x800F7866" VALUE 0x19B420 RL_IDENTITY 0 NO_INPUT_QUANTITY 1.0 /end CHARACTERISTIC
/* src=families fam=fam_0102 ax=0x1BF024 ay=0x- */ /* STUB unknown size; axis_x=0x1BF024 axis_y=0x- */
/begin CHARACTERISTIC map_horsA2L_19C5A8 "RE interp_2d fam_0102 call=0x800AFFAE" VALUE 0x19B488 RL_IDENTITY 0 NO_INPUT_QUANTITY 1.0 /end CHARACTERISTIC
/* src=families fam=C_fam_0116 ax=0x1B46FC ay=0x1A5768 */
/begin CHARACTERISTIC C_fam_0116_19B4B4 "RE map_interp_C C_fam_0116 call=0x800E2916" MAP 0x19B4B4 RL_IDENTITY 0 NO_INPUT_QUANTITY 1.0 FORMAT "%%5.0"
 /begin AXIS_DESCR COM_AXIS NO_INPUT_QUANTITY NO_COMPU_METHOD 2 AXIS_PTS_REF AX_1B46FC /end AXIS_DESCR
 /begin AXIS_DESCR COM_AXIS NO_INPUT_QUANTITY NO_COMPU_METHOD 15 AXIS_PTS_REF AX_1A5768 /end AXIS_DESCR
/end CHARACTERISTIC
/* src=families fam=fam_0014 ax=0x1AC284 ay=0x1A765C */
/begin CHARACTERISTIC map_horsA2L_19B4C8 "RE interp_2d fam_0014 call=0x800EA644" MAP 0x19B4C8 RL_IDENTITY 0 NO_INPUT_QUANTITY 1.0 FORMAT "%%5.0"
 /begin AXIS_DESCR COM_AXIS NO_INPUT_QUANTITY NO_COMPU_METHOD 2 AXIS_PTS_REF AX_1AC284 /end AXIS_DESCR
 /begin AXIS_DESCR COM_AXIS NO_INPUT_QUANTITY NO_COMPU_METHOD 2 AXIS_PTS_REF AX_1A765C /end AXIS_DESCR
/end CHARACTERISTIC
/* src=families fam=L_fam_0016 ax=0x1B1874 ay=0x1B1874 */
/begin CHARACTERISTIC L_fam_0016_19B524 "RE map_interp_L L_fam_0016 call=0x80096AAA" MAP 0x19B524 RL_IDENTITY 0 NO_INPUT_QUANTITY 1.0 FORMAT "%%5.0"
 /begin AXIS_DESCR COM_AXIS NO_INPUT_QUANTITY NO_COMPU_METHOD 2 AXIS_PTS_REF AX_1B1874 /end AXIS_DESCR
 /begin AXIS_DESCR COM_AXIS NO_INPUT_QUANTITY NO_COMPU_METHOD 2 AXIS_PTS_REF AX_1B1874 /end AXIS_DESCR
/end CHARACTERISTIC
/* src=families fam=C_fam_0295 ax=0x- ay=0x- */
/begin CHARACTERISTIC C_fam_0295_19B55C "RE map_interp_C C_fam_0295 call=0x800AE6F6" VALUE 0x19B55C RL_IDENTITY 0 NO_INPUT_QUANTITY 1.0 /end CHARACTERISTIC
/* src=families fam=D_fam_0137 ax=0x1A378C ay=0x- */ /* STUB unknown size; axis_x=0x1A378C axis_y=0x- */
/begin CHARACTERISTIC D_fam_0137_19B568 "RE map_interp_D D_fam_0137 call=0x8007D268; RE map_interp_G G_fam_0009 call=0x80" VALUE 0x19B568 RL_IDENTITY 0 NO_INPUT_QUANTITY 1.0 /end CHARACTERISTIC
/* src=families fam=fam_0049 ax=0x1A56F0 ay=0x1A54F8 */
/begin CHARACTERISTIC fam_0049_19B634 "RE interp_2d fam_0049 call=0x800F010C" MAP 0x19B634 RL_IDENTITY 0 NO_INPUT_QUANTITY 1.0 FORMAT "%%5.0"
 /begin AXIS_DESCR COM_AXIS NO_INPUT_QUANTITY NO_COMPU_METHOD 2 AXIS_PTS_REF AX_1A56F0 /end AXIS_DESCR
 /begin AXIS_DESCR COM_AXIS NO_INPUT_QUANTITY NO_COMPU_METHOD 16 AXIS_PTS_REF AX_1A54F8 /end AXIS_DESCR
/end CHARACTERISTIC
/* src=families fam=fam_0085 ax=0x1B5814 ay=0x1B3BE8 */
/begin CHARACTERISTIC map_horsA2L_19B648 "RE interp_2d fam_0085 call=0x800A2820" MAP 0x19B648 RL_IDENTITY 0 NO_INPUT_QUANTITY 1.0 FORMAT "%%5.0"
 /begin AXIS_DESCR COM_AXIS NO_INPUT_QUANTITY NO_COMPU_METHOD 2 AXIS_PTS_REF AX_1B5814 /end AXIS_DESCR
 /begin AXIS_DESCR COM_AXIS NO_INPUT_QUANTITY NO_COMPU_METHOD 2 AXIS_PTS_REF AX_1B3BE8 /end AXIS_DESCR
/end CHARACTERISTIC
/* src=horsA2L fam=- ax=0x19B658 ay=0x19D40C */ /* STUB unknown size; axis_x=0x19B658 axis_y=0x19D40C */
/begin CHARACTERISTIC map_horsA2L_19B658 "low: 8000/A000 fill - pas une grille Nm lisible (ex. 1C4994); identique 64o vs 9" VALUE 0x19B658 RL_IDENTITY 0 NO_INPUT_QUANTITY 1.0 /end CHARACTERISTIC
/* src=families fam=O_fam_0009 ax=0x1A92AC ay=0x- */ /* STUB unknown size; axis_x=0x1A92AC axis_y=0x- */
/begin CHARACTERISTIC O_fam_0009_19B6AC "RE map_interp_O O_fam_0009 call=0x801206FA" VALUE 0x19B6AC RL_IDENTITY 0 NO_INPUT_QUANTITY 1.0 /end CHARACTERISTIC
/* src=families fam=K_fam_0086 ax=0x- ay=0x- */
/begin CHARACTERISTIC K_fam_0086_19B6D0 "RE map_interp_K K_fam_0086 call=0x800F18FE" VALUE 0x19B6D0 RL_IDENTITY 0 NO_INPUT_QUANTITY 1.0 /end CHARACTERISTIC
/* src=families fam=fam_0031 ax=0x1A1528 ay=0x1BF6B4 */
/begin CHARACTERISTIC map_horsA2L_19A5DC_19B760 "RE interp_2d fam_0031 call=0x80112676" MAP 0x19B760 RL_IDENTITY 0 NO_INPUT_QUANTITY 1.0 FORMAT "%%5.0"
 /begin AXIS_DESCR COM_AXIS NO_INPUT_QUANTITY NO_COMPU_METHOD 2 AXIS_PTS_REF AX_1A1528 /end AXIS_DESCR
 /begin AXIS_DESCR COM_AXIS NO_INPUT_QUANTITY NO_COMPU_METHOD 2 AXIS_PTS_REF AX_1BF6B4 /end AXIS_DESCR
/end CHARACTERISTIC
/* src=families fam=G_fam_0137 ax=0x1B6864 ay=0x- */ /* STUB unknown size; axis_x=0x1B6864 axis_y=0x- */
/begin CHARACTERISTIC G_fam_0137_19B77C "RE map_interp_G G_fam_0137 call=0x800E0D50" VALUE 0x19B77C RL_IDENTITY 0 NO_INPUT_QUANTITY 1.0 /end CHARACTERISTIC
/* src=families fam=G_fam_0143 ax=0x- ay=0x- */
/begin CHARACTERISTIC G_fam_0143_19B7A0 "RE map_interp_G G_fam_0143 call=0x800F16DA" VALUE 0x19B7A0 RL_IDENTITY 0 NO_INPUT_QUANTITY 1.0 /end CHARACTERISTIC
/* src=families fam=B_fam_0001 ax=0x1A91D0 ay=0x- */ /* STUB unknown size; axis_x=0x1A91D0 axis_y=0x- */
/begin CHARACTERISTIC B_fam_0001_19B7C0 "RE interp_2d_B B_fam_0001 call=0x8011639A" VALUE 0x19B7C0 RL_IDENTITY 0 NO_INPUT_QUANTITY 1.0 /end CHARACTERISTIC
/* src=families fam=fam_0096 ax=0x1ACC18 ay=0x- */ /* STUB unknown size; axis_x=0x1ACC18 axis_y=0x- */
/begin CHARACTERISTIC map_horsA2L_19B7E8 "RE interp_2d fam_0096 call=0x800B55FA" VALUE 0x19B7D8 RL_IDENTITY 0 NO_INPUT_QUANTITY 1.0 /end CHARACTERISTIC
/* src=horsA2L fam=- ax=0x19B7E8 ay=0x19B7D8 */ /* STUB unknown size; axis_x=0x19B7E8 axis_y=0x19B7D8 */
/begin CHARACTERISTIC map_horsA2L_19B7E8_19B7E8 "low: pas dans l A2L/atlas 9979 (299 maps WinOLS) - nommer a la main si besoin; i" VALUE 0x19B7E8 RL_IDENTITY 0 NO_INPUT_QUANTITY 1.0 /end CHARACTERISTIC
/* src=families fam=B_fam_0046 ax=0x- ay=0x- */
/begin CHARACTERISTIC B_fam_0046_19BB74 "RE interp_2d_B B_fam_0046 call=0x8009354A" VALUE 0x19BB74 RL_IDENTITY 0 NO_INPUT_QUANTITY 1.0 /end CHARACTERISTIC
/* src=families fam=D_fam_0180 ax=0x- ay=0x- */
/begin CHARACTERISTIC D_fam_0180_19BC58 "RE map_interp_D D_fam_0180 call=0x8009B630" VALUE 0x19BC58 RL_IDENTITY 0 NO_INPUT_QUANTITY 1.0 /end CHARACTERISTIC
/* src=families fam=N_fam_0002 ax=0x- ay=0x- */
/begin CHARACTERISTIC N_fam_0002_19BDC4 "RE map_interp_N N_fam_0002 call=0x800A046C" VALUE 0x19BDC4 RL_IDENTITY 0 NO_INPUT_QUANTITY 1.0 /end CHARACTERISTIC
/* src=families fam=N_fam_0002 ax=0x- ay=0x- */
/begin CHARACTERISTIC N_fam_0002_19BDD8 "RE map_interp_N N_fam_0002 call=0x800A0378" VALUE 0x19BDD8 RL_IDENTITY 0 NO_INPUT_QUANTITY 1.0 /end CHARACTERISTIC
/* src=families fam=O_fam_0005 ax=0x- ay=0x- */
/begin CHARACTERISTIC O_fam_0005_19BDEC "RE map_interp_O O_fam_0005 call=0x800A0422" VALUE 0x19BDEC RL_IDENTITY 0 NO_INPUT_QUANTITY 1.0 /end CHARACTERISTIC
/* src=families fam=fam_0120 ax=0x1ADBF0 ay=0x1A9804 */
/begin CHARACTERISTIC map_horsA2L_19B3F0_19C3C0 "RE interp_2d fam_0120 call=0x800FB00C; RE map_interp_D D_fam_0048 call=0x800FB01" MAP 0x19C3C0 RL_IDENTITY 0 NO_INPUT_QUANTITY 1.0 FORMAT "%%5.0"
 /begin AXIS_DESCR COM_AXIS NO_INPUT_QUANTITY NO_COMPU_METHOD 2 AXIS_PTS_REF AX_1ADBF0 /end AXIS_DESCR
 /begin AXIS_DESCR COM_AXIS NO_INPUT_QUANTITY NO_COMPU_METHOD 2 AXIS_PTS_REF AX_1A9804 /end AXIS_DESCR
/end CHARACTERISTIC
/* src=families fam=C_fam_0008 ax=0x1BC8F4 ay=0x1BC8F4 */
/begin CHARACTERISTIC C_fam_0008_19C3E8 "RE map_interp_C C_fam_0008 call=0x800CE910; RE map_interp_E E_fam_0001 call=0x80" MAP 0x19C3E8 RL_IDENTITY 0 NO_INPUT_QUANTITY 1.0 FORMAT "%%5.0"
 /begin AXIS_DESCR COM_AXIS NO_INPUT_QUANTITY NO_COMPU_METHOD 2 AXIS_PTS_REF AX_1BC8F4 /end AXIS_DESCR
 /begin AXIS_DESCR COM_AXIS NO_INPUT_QUANTITY NO_COMPU_METHOD 2 AXIS_PTS_REF AX_1BC8F4 /end AXIS_DESCR
/end CHARACTERISTIC
/* src=families fam=fam_0101 ax=0x1BE6AC ay=0x- */ /* STUB unknown size; axis_x=0x1BE6AC axis_y=0x- */
/begin CHARACTERISTIC map_horsA2L_19C598 "RE interp_2d fam_0101 call=0x800F99D0" VALUE 0x19C404 RL_IDENTITY 0 NO_INPUT_QUANTITY 1.0 /end CHARACTERISTIC
/* src=families fam=G_fam_0079 ax=0x- ay=0x- */
/begin CHARACTERISTIC G_fam_0079_19C414 "RE map_interp_G G_fam_0079 call=0x80087C32" VALUE 0x19C414 RL_IDENTITY 0 NO_INPUT_QUANTITY 1.0 /end CHARACTERISTIC
/* src=families fam=C_fam_0175 ax=0x1B8798 ay=0x- */ /* STUB unknown size; axis_x=0x1B8798 axis_y=0x- */
/begin CHARACTERISTIC C_fam_0175_19C438 "RE map_interp_C C_fam_0175 call=0x800AB420" VALUE 0x19C438 RL_IDENTITY 0 NO_INPUT_QUANTITY 1.0 /end CHARACTERISTIC
/* src=families fam=C_fam_0180 ax=0x1BFAA4 ay=0x- */ /* STUB unknown size; axis_x=0x1BFAA4 axis_y=0x- */
/begin CHARACTERISTIC C_fam_0180_19C45C "RE map_interp_C C_fam_0180 call=0x8008E8E2" VALUE 0x19C45C RL_IDENTITY 0 NO_INPUT_QUANTITY 1.0 /end CHARACTERISTIC
/* src=families fam=C_fam_0177 ax=0x1B9AF4 ay=0x- */ /* STUB unknown size; axis_x=0x1B9AF4 axis_y=0x- */
/begin CHARACTERISTIC C_fam_0177_19C470 "RE map_interp_C C_fam_0177 call=0x8008D9C0" VALUE 0x19C470 RL_IDENTITY 0 NO_INPUT_QUANTITY 1.0 /end CHARACTERISTIC
/* src=families fam=N_fam_0012 ax=0x1B4870 ay=0x1BCAF8 */
/begin CHARACTERISTIC N_fam_0012_19C490 "RE map_interp_N N_fam_0012 call=0x80085BD2" MAP 0x19C490 RL_IDENTITY 0 NO_INPUT_QUANTITY 1.0 FORMAT "%%5.0"
 /begin AXIS_DESCR COM_AXIS NO_INPUT_QUANTITY NO_COMPU_METHOD 2 AXIS_PTS_REF AX_1B4870 /end AXIS_DESCR
 /begin AXIS_DESCR COM_AXIS NO_INPUT_QUANTITY NO_COMPU_METHOD 2 AXIS_PTS_REF AX_1BCAF8 /end AXIS_DESCR
/end CHARACTERISTIC
/* src=families fam=N_fam_0017 ax=0x- ay=0x- */
/begin CHARACTERISTIC N_fam_0017_19C4A0 "RE map_interp_N N_fam_0017 call=0x800EBA3E" VALUE 0x19C4A0 RL_IDENTITY 0 NO_INPUT_QUANTITY 1.0 /end CHARACTERISTIC
/* src=families fam=C_fam_0036 ax=0x1B66FC ay=0x- */ /* STUB unknown size; axis_x=0x1B66FC axis_y=0x- */
/begin CHARACTERISTIC C_fam_0036_19C4B0 "RE map_interp_C C_fam_0036 call=0x80118A7A" VALUE 0x19C4B0 RL_IDENTITY 0 NO_INPUT_QUANTITY 1.0 /end CHARACTERISTIC
/* src=families fam=fam_0129 ax=0x1B22B4 ay=0x- */ /* STUB unknown size; axis_x=0x1B22B4 axis_y=0x- */
/begin CHARACTERISTIC map_horsA2L_19F4BC "RE interp_2d fam_0129 call=0x800DEB34" VALUE 0x19C4D0 RL_IDENTITY 0 NO_INPUT_QUANTITY 1.0 /end CHARACTERISTIC
/* src=families fam=fam_0055 ax=0x1A6504 ay=0x1B6C7C */
/begin CHARACTERISTIC map_horsA2L_19C4EC "RE interp_2d fam_0055 call=0x800E166C" MAP 0x19C4EC RL_IDENTITY 0 NO_INPUT_QUANTITY 1.0 FORMAT "%%5.0"
 /begin AXIS_DESCR COM_AXIS NO_INPUT_QUANTITY NO_COMPU_METHOD 6 AXIS_PTS_REF AX_1A6504 /end AXIS_DESCR
 /begin AXIS_DESCR COM_AXIS NO_INPUT_QUANTITY NO_COMPU_METHOD 2 AXIS_PTS_REF AX_1B6C7C /end AXIS_DESCR
/end CHARACTERISTIC
/* src=families fam=fam_0057 ax=0x1A6514 ay=0x1A9C4C */
/begin CHARACTERISTIC map_horsA2L_19C4FC "RE interp_2d fam_0057 call=0x800E15F4" MAP 0x19C4FC RL_IDENTITY 0 NO_INPUT_QUANTITY 1.0 FORMAT "%%5.0"
 /begin AXIS_DESCR COM_AXIS NO_INPUT_QUANTITY NO_COMPU_METHOD 8 AXIS_PTS_REF AX_1A6514 /end AXIS_DESCR
 /begin AXIS_DESCR COM_AXIS NO_INPUT_QUANTITY NO_COMPU_METHOD 2 AXIS_PTS_REF AX_1A9C4C /end AXIS_DESCR
/end CHARACTERISTIC
/* src=families fam=D_fam_0231 ax=0x1B7C00 ay=0x- */ /* STUB unknown size; axis_x=0x1B7C00 axis_y=0x- */
/begin CHARACTERISTIC D_fam_0231_19C50C "RE map_interp_D D_fam_0231 call=0x80107ACC; RE map_interp_I I_fam_0058 call=0x80" VALUE 0x19C50C RL_IDENTITY 0 NO_INPUT_QUANTITY 1.0 /end CHARACTERISTIC
/* src=families fam=D_fam_0104 ax=0x1B7C00 ay=0x1B7C0C */
/begin CHARACTERISTIC D_fam_0104_19C51C "RE map_interp_D D_fam_0104 call=0x80107AEA; RE map_interp_I I_fam_0044 call=0x80" MAP 0x19C51C RL_IDENTITY 0 NO_INPUT_QUANTITY 1.0 FORMAT "%%5.0"
 /begin AXIS_DESCR COM_AXIS NO_INPUT_QUANTITY NO_COMPU_METHOD 2 AXIS_PTS_REF AX_1B7C00 /end AXIS_DESCR
 /begin AXIS_DESCR COM_AXIS NO_INPUT_QUANTITY NO_COMPU_METHOD 2 AXIS_PTS_REF AX_1B7C0C /end AXIS_DESCR
/end CHARACTERISTIC
/* src=families fam=N_fam_0011 ax=0x1AF84C ay=0x1AA828 */
/begin CHARACTERISTIC N_fam_0011_19C52C "RE map_interp_N N_fam_0011 call=0x800F98A0" MAP 0x19C52C RL_IDENTITY 0 NO_INPUT_QUANTITY 1.0 FORMAT "%%5.0"
 /begin AXIS_DESCR COM_AXIS NO_INPUT_QUANTITY NO_COMPU_METHOD 2 AXIS_PTS_REF AX_1AF84C /end AXIS_DESCR
 /begin AXIS_DESCR COM_AXIS NO_INPUT_QUANTITY NO_COMPU_METHOD 2 AXIS_PTS_REF AX_1AA828 /end AXIS_DESCR
/end CHARACTERISTIC
/* src=families fam=D_fam_0093 ax=0x1B0718 ay=0x- */ /* STUB unknown size; axis_x=0x1B0718 axis_y=0x- */
/begin CHARACTERISTIC D_fam_0093_19C53C "RE map_interp_D D_fam_0093 call=0x800F5A6E" VALUE 0x19C53C RL_IDENTITY 0 NO_INPUT_QUANTITY 1.0 /end CHARACTERISTIC
/* src=families fam=B_fam_0020 ax=0x1AD8E8 ay=0x1AE8C0 */
/begin CHARACTERISTIC B_fam_0020_19C54C "RE interp_2d_B B_fam_0020 call=0x800ADF58; RE map_interp_C C_fam_0218 call=0x800" MAP 0x19C54C RL_IDENTITY 0 NO_INPUT_QUANTITY 1.0 FORMAT "%%5.0"
 /begin AXIS_DESCR COM_AXIS NO_INPUT_QUANTITY NO_COMPU_METHOD 2 AXIS_PTS_REF AX_1AD8E8 /end AXIS_DESCR
 /begin AXIS_DESCR COM_AXIS NO_INPUT_QUANTITY NO_COMPU_METHOD 2 AXIS_PTS_REF AX_1AE8C0 /end AXIS_DESCR
/end CHARACTERISTIC
/* src=families fam=fam_0025 ax=0x1A0588 ay=0x1A3510 */
/begin CHARACTERISTIC map_horsA2L_19C568 "RE interp_2d fam_0025 call=0x800EAC18" MAP 0x19C568 RL_IDENTITY 0 NO_INPUT_QUANTITY 1.0 FORMAT "%%5.0"
 /begin AXIS_DESCR COM_AXIS NO_INPUT_QUANTITY NO_COMPU_METHOD 2 AXIS_PTS_REF AX_1A0588 /end AXIS_DESCR
 /begin AXIS_DESCR COM_AXIS NO_INPUT_QUANTITY NO_COMPU_METHOD 2 AXIS_PTS_REF AX_1A3510 /end AXIS_DESCR
/end CHARACTERISTIC
/* src=families fam=D_fam_0223 ax=0x1BC018 ay=0x- */ /* STUB unknown size; axis_x=0x1BC018 axis_y=0x- */
/begin CHARACTERISTIC D_fam_0223_19C588 "RE map_interp_D D_fam_0223 call=0x800F890C; RE map_interp_I I_fam_0014 call=0x80" VALUE 0x19C588 RL_IDENTITY 0 NO_INPUT_QUANTITY 1.0 /end CHARACTERISTIC
/* src=horsA2L fam=- ax=0x19C598 ay=0x19C404 */ /* STUB unknown size; axis_x=0x19C598 axis_y=0x19C404 */
/begin CHARACTERISTIC map_horsA2L_19C598_19C598 "low: pas dans l A2L/atlas 9979 (299 maps WinOLS) - nommer a la main si besoin; i" VALUE 0x19C598 RL_IDENTITY 0 NO_INPUT_QUANTITY 1.0 /end CHARACTERISTIC
/* src=horsA2L fam=- ax=0x19C5A8 ay=0x19B488 */ /* STUB unknown size; axis_x=0x19C5A8 axis_y=0x19B488 */
/begin CHARACTERISTIC map_horsA2L_19C5A8_19C5A8 "low: pas dans l A2L/atlas 9979 (299 maps WinOLS) - nommer a la main si besoin; i" VALUE 0x19C5A8 RL_IDENTITY 0 NO_INPUT_QUANTITY 1.0 /end CHARACTERISTIC
/* src=families fam=C_fam_0228 ax=0x- ay=0x- */
/begin CHARACTERISTIC C_fam_0228_19C62C "RE map_interp_C C_fam_0228 call=0x800BFE58" VALUE 0x19C62C RL_IDENTITY 0 NO_INPUT_QUANTITY 1.0 /end CHARACTERISTIC
/* src=families fam=B_fam_0031 ax=0x1B29A0 ay=0x- */ /* STUB unknown size; axis_x=0x1B29A0 axis_y=0x- */
/begin CHARACTERISTIC B_fam_0031_19C638 "RE interp_2d_B B_fam_0031 call=0x800C566A" VALUE 0x19C638 RL_IDENTITY 0 NO_INPUT_QUANTITY 1.0 /end CHARACTERISTIC
/* src=families fam=E_fam_0026 ax=0x1B4290 ay=0x1A8934 */
/begin CHARACTERISTIC E_fam_0026_19C690 "RE map_interp_E E_fam_0026 call=0x80095550" MAP 0x19C690 RL_IDENTITY 0 NO_INPUT_QUANTITY 1.0 FORMAT "%%5.0"
 /begin AXIS_DESCR COM_AXIS NO_INPUT_QUANTITY NO_COMPU_METHOD 2 AXIS_PTS_REF AX_1B4290 /end AXIS_DESCR
 /begin AXIS_DESCR COM_AXIS NO_INPUT_QUANTITY NO_COMPU_METHOD 2 AXIS_PTS_REF AX_1A8934 /end AXIS_DESCR
/end CHARACTERISTIC
/* src=families fam=E_fam_0041 ax=0x1B76C8 ay=0x- */ /* STUB unknown size; axis_x=0x1B76C8 axis_y=0x- */
/begin CHARACTERISTIC E_fam_0041_19C69C "RE map_interp_E E_fam_0041 call=0x801189CE" VALUE 0x19C69C RL_IDENTITY 0 NO_INPUT_QUANTITY 1.0 /end CHARACTERISTIC
/* src=families fam=K_fam_0087 ax=0x- ay=0x- */
/begin CHARACTERISTIC K_fam_0087_19C6A8 "RE map_interp_K K_fam_0087 call=0x800F5876" VALUE 0x19C6A8 RL_IDENTITY 0 NO_INPUT_QUANTITY 1.0 /end CHARACTERISTIC
/* src=families fam=J_fam_0037 ax=0x1B0B10 ay=0x- */ /* STUB unknown size; axis_x=0x1B0B10 axis_y=0x- */
/begin CHARACTERISTIC J_fam_0037_19C778 "RE map_interp_J J_fam_0037 call=0x800F2156" VALUE 0x19C778 RL_IDENTITY 0 NO_INPUT_QUANTITY 1.0 /end CHARACTERISTIC
/* src=families fam=D_fam_0227 ax=0x- ay=0x- */
/begin CHARACTERISTIC D_fam_0227_19C7F0 "RE map_interp_D D_fam_0227 call=0x8010125A" VALUE 0x19C7F0 RL_IDENTITY 0 NO_INPUT_QUANTITY 1.0 /end CHARACTERISTIC
/* src=families fam=B_fam_0015 ax=0x1A6BF8 ay=0x1A7BF8 */
/begin CHARACTERISTIC B_fam_0015_19CBD0 "RE interp_2d_B B_fam_0015 call=0x800BBE64" MAP 0x19CBD0 RL_IDENTITY 0 NO_INPUT_QUANTITY 1.0 FORMAT "%%5.0"
 /begin AXIS_DESCR COM_AXIS NO_INPUT_QUANTITY NO_COMPU_METHOD 2 AXIS_PTS_REF AX_1A6BF8 /end AXIS_DESCR
 /begin AXIS_DESCR COM_AXIS NO_INPUT_QUANTITY NO_COMPU_METHOD 2 AXIS_PTS_REF AX_1A7BF8 /end AXIS_DESCR
/end CHARACTERISTIC
/* src=families fam=O_fam_0005 ax=0x- ay=0x- */
/begin CHARACTERISTIC O_fam_0005_19CDF4 "RE map_interp_O O_fam_0005 call=0x800A03A4" VALUE 0x19CDF4 RL_IDENTITY 0 NO_INPUT_QUANTITY 1.0 /end CHARACTERISTIC
/* src=families fam=D_fam_0222 ax=0x1B0718 ay=0x- */ /* STUB unknown size; axis_x=0x1B0718 axis_y=0x- */
/begin CHARACTERISTIC D_fam_0222_19D3D8 "RE map_interp_D D_fam_0222 call=0x800F5A34; RE map_interp_I I_fam_0052 call=0x80" VALUE 0x19D3D8 RL_IDENTITY 0 NO_INPUT_QUANTITY 1.0 /end CHARACTERISTIC
/* src=families fam=fam_0100 ax=0x1BC7B0 ay=0x- */ /* STUB unknown size; axis_x=0x1BC7B0 axis_y=0x- */
/begin CHARACTERISTIC map_horsA2L_19B658_19D40C "RE interp_2d fam_0100 call=0x800CF0CC" VALUE 0x19D40C RL_IDENTITY 0 NO_INPUT_QUANTITY 1.0 /end CHARACTERISTIC
/* src=families fam=C_fam_0242 ax=0x1BFAB4 ay=0x- */ /* STUB unknown size; axis_x=0x1BFAB4 axis_y=0x- */
/begin CHARACTERISTIC C_fam_0242_19D444 "RE map_interp_C C_fam_0242 call=0x8008D0BE" VALUE 0x19D444 RL_IDENTITY 0 NO_INPUT_QUANTITY 1.0 /end CHARACTERISTIC
/* src=families fam=D_fam_0107 ax=0x- ay=0x- */
/begin CHARACTERISTIC D_fam_0107_19D458 "RE map_interp_D D_fam_0107 call=0x8008E8AE" VALUE 0x19D458 RL_IDENTITY 0 NO_INPUT_QUANTITY 1.0 /end CHARACTERISTIC
/* src=families fam=C_fam_0062 ax=0x1A24AC ay=0x1B76F0 */
/begin CHARACTERISTIC C_fam_0062_19D490 "RE map_interp_C C_fam_0062 call=0x800EB274" MAP 0x19D490 RL_IDENTITY 0 NO_INPUT_QUANTITY 1.0 FORMAT "%%5.0"
 /begin AXIS_DESCR COM_AXIS NO_INPUT_QUANTITY NO_COMPU_METHOD 2 AXIS_PTS_REF AX_1A24AC /end AXIS_DESCR
 /begin AXIS_DESCR COM_AXIS NO_INPUT_QUANTITY NO_COMPU_METHOD 2 AXIS_PTS_REF AX_1B76F0 /end AXIS_DESCR
/end CHARACTERISTIC
/* src=families fam=C_fam_0020 ax=0x1AC8E0 ay=0x1A9200 */
/begin CHARACTERISTIC C_fam_0020_19D4B4 "RE map_interp_C C_fam_0020 call=0x8007BC48" MAP 0x19D4B4 RL_IDENTITY 0 NO_INPUT_QUANTITY 1.0 FORMAT "%%5.0"
 /begin AXIS_DESCR COM_AXIS NO_INPUT_QUANTITY NO_COMPU_METHOD 2 AXIS_PTS_REF AX_1AC8E0 /end AXIS_DESCR
 /begin AXIS_DESCR COM_AXIS NO_INPUT_QUANTITY NO_COMPU_METHOD 50 AXIS_PTS_REF AX_1A9200 /end AXIS_DESCR
/end CHARACTERISTIC
/* src=families fam=fam_0047 ax=0x1A555C ay=0x1B42A0 */
/begin CHARACTERISTIC map_horsA2L_19D4CC "RE interp_2d fam_0047 call=0x800AFF42" MAP 0x19D4CC RL_IDENTITY 0 NO_INPUT_QUANTITY 1.0 FORMAT "%%5.0"
 /begin AXIS_DESCR COM_AXIS NO_INPUT_QUANTITY NO_COMPU_METHOD 2 AXIS_PTS_REF AX_1A555C /end AXIS_DESCR
 /begin AXIS_DESCR COM_AXIS NO_INPUT_QUANTITY NO_COMPU_METHOD 2 AXIS_PTS_REF AX_1B42A0 /end AXIS_DESCR
/end CHARACTERISTIC
/* src=families fam=C_fam_0127 ax=0x1B9ADC ay=0x1AC800 */
/begin CHARACTERISTIC C_fam_0127_19D4E4 "RE map_interp_C C_fam_0127 call=0x800F1DE4" MAP 0x19D4E4 RL_IDENTITY 0 NO_INPUT_QUANTITY 1.0 FORMAT "%%5.0"
 /begin AXIS_DESCR COM_AXIS NO_INPUT_QUANTITY NO_COMPU_METHOD 2 AXIS_PTS_REF AX_1B9ADC /end AXIS_DESCR
 /begin AXIS_DESCR COM_AXIS NO_INPUT_QUANTITY NO_COMPU_METHOD 2 AXIS_PTS_REF AX_1AC800 /end AXIS_DESCR
/end CHARACTERISTIC
/* src=families fam=D_fam_0036 ax=0x1A77EC ay=0x1BD8D8 */
/begin CHARACTERISTIC D_fam_0036_19D4F4 "RE map_interp_D D_fam_0036 call=0x800B75DA" MAP 0x19D4F4 RL_IDENTITY 0 NO_INPUT_QUANTITY 1.0 FORMAT "%%5.0"
 /begin AXIS_DESCR COM_AXIS NO_INPUT_QUANTITY NO_COMPU_METHOD 8 AXIS_PTS_REF AX_1A77EC /end AXIS_DESCR
 /begin AXIS_DESCR COM_AXIS NO_INPUT_QUANTITY NO_COMPU_METHOD 2 AXIS_PTS_REF AX_1BD8D8 /end AXIS_DESCR
/end CHARACTERISTIC
/* src=families fam=D_fam_0181 ax=0x- ay=0x- */
/begin CHARACTERISTIC D_fam_0181_19D544 "RE map_interp_D D_fam_0181 call=0x800AE0CE" VALUE 0x19D544 RL_IDENTITY 0 NO_INPUT_QUANTITY 1.0 /end CHARACTERISTIC
/* src=families fam=D_fam_0220 ax=0x- ay=0x- */
/begin CHARACTERISTIC D_fam_0220_19D580 "RE map_interp_D D_fam_0220 call=0x800F16BA" VALUE 0x19D580 RL_IDENTITY 0 NO_INPUT_QUANTITY 1.0 /end CHARACTERISTIC
/* src=families fam=C_fam_0109 ax=0x1AE87C ay=0x1BC8E8 */
/begin CHARACTERISTIC C_fam_0109_19D5E0 "RE map_interp_C C_fam_0109 call=0x800E97F6" MAP 0x19D5E0 RL_IDENTITY 0 NO_INPUT_QUANTITY 1.0 FORMAT "%%5.0"
 /begin AXIS_DESCR COM_AXIS NO_INPUT_QUANTITY NO_COMPU_METHOD 2 AXIS_PTS_REF AX_1AE87C /end AXIS_DESCR
 /begin AXIS_DESCR COM_AXIS NO_INPUT_QUANTITY NO_COMPU_METHOD 2 AXIS_PTS_REF AX_1BC8E8 /end AXIS_DESCR
/end CHARACTERISTIC
/* src=families fam=fam_0041 ax=0x1A444C ay=0x1A8BE8 */
/begin CHARACTERISTIC map_horsA2L_19F7D0 "RE interp_2d fam_0041 call=0x800EEBA6" MAP 0x19D674 RL_IDENTITY 0 NO_INPUT_QUANTITY 1.0 FORMAT "%%5.0"
 /begin AXIS_DESCR COM_AXIS NO_INPUT_QUANTITY NO_COMPU_METHOD 8 AXIS_PTS_REF AX_1A444C /end AXIS_DESCR
 /begin AXIS_DESCR COM_AXIS NO_INPUT_QUANTITY NO_COMPU_METHOD 2 AXIS_PTS_REF AX_1A8BE8 /end AXIS_DESCR
/end CHARACTERISTIC
/* src=families fam=K_fam_0078 ax=0x- ay=0x- */
/begin CHARACTERISTIC K_fam_0078_19D684 "RE map_interp_K K_fam_0078 call=0x800E20E0" VALUE 0x19D684 RL_IDENTITY 0 NO_INPUT_QUANTITY 1.0 /end CHARACTERISTIC
/* src=families fam=L_fam_0015 ax=0x1B1874 ay=0x1AA9FC */
/begin CHARACTERISTIC L_fam_0015_19D6AC "RE map_interp_L L_fam_0015 call=0x80080D0E" MAP 0x19D6AC RL_IDENTITY 0 NO_INPUT_QUANTITY 1.0 FORMAT "%%5.0"
 /begin AXIS_DESCR COM_AXIS NO_INPUT_QUANTITY NO_COMPU_METHOD 2 AXIS_PTS_REF AX_1B1874 /end AXIS_DESCR
 /begin AXIS_DESCR COM_AXIS NO_INPUT_QUANTITY NO_COMPU_METHOD 2 AXIS_PTS_REF AX_1AA9FC /end AXIS_DESCR
/end CHARACTERISTIC
/* src=families fam=K_fam_0082 ax=0x- ay=0x- */
/begin CHARACTERISTIC K_fam_0082_19D6B8 "RE map_interp_K K_fam_0082 call=0x800E9044" VALUE 0x19D6B8 RL_IDENTITY 0 NO_INPUT_QUANTITY 1.0 /end CHARACTERISTIC
/* src=families fam=B_fam_0027 ax=0x1BC03C ay=0x- */ /* STUB unknown size; axis_x=0x1BC03C axis_y=0x- */
/begin CHARACTERISTIC B_fam_0027_19D6C8 "RE interp_2d_B B_fam_0027 call=0x800E96F6" VALUE 0x19D6C8 RL_IDENTITY 0 NO_INPUT_QUANTITY 1.0 /end CHARACTERISTIC
/* src=families fam=C_fam_0089 ax=0x1A7508 ay=0x1B5C44 */
/begin CHARACTERISTIC C_fam_0089_19D6E8 "RE map_interp_C C_fam_0089 call=0x800E32EC" MAP 0x19D6E8 RL_IDENTITY 0 NO_INPUT_QUANTITY 1.0 FORMAT "%%5.0"
 /begin AXIS_DESCR COM_AXIS NO_INPUT_QUANTITY NO_COMPU_METHOD 2 AXIS_PTS_REF AX_1A7508 /end AXIS_DESCR
 /begin AXIS_DESCR COM_AXIS NO_INPUT_QUANTITY NO_COMPU_METHOD 2 AXIS_PTS_REF AX_1B5C44 /end AXIS_DESCR
/end CHARACTERISTIC
/* src=families fam=F_fam_0039 ax=0x1A0548 ay=0x1B4FF4 */
/begin CHARACTERISTIC F_fam_0039_19D704 "RE map_interp_F F_fam_0039 call=0x800F5D4E; RE map_interp_G G_fam_0047 call=0x80" MAP 0x19D704 RL_IDENTITY 0 NO_INPUT_QUANTITY 1.0 FORMAT "%%5.0"
 /begin AXIS_DESCR COM_AXIS NO_INPUT_QUANTITY NO_COMPU_METHOD 2 AXIS_PTS_REF AX_1A0548 /end AXIS_DESCR
 /begin AXIS_DESCR COM_AXIS NO_INPUT_QUANTITY NO_COMPU_METHOD 2 AXIS_PTS_REF AX_1B4FF4 /end AXIS_DESCR
/end CHARACTERISTIC
/* src=families fam=D_fam_0057 ax=0x1B491C ay=0x1AAA00 */
/begin CHARACTERISTIC D_fam_0057_19D75C "RE map_interp_D D_fam_0057 call=0x800F882A" MAP 0x19D75C RL_IDENTITY 0 NO_INPUT_QUANTITY 1.0 FORMAT "%%5.0"
 /begin AXIS_DESCR COM_AXIS NO_INPUT_QUANTITY NO_COMPU_METHOD 2 AXIS_PTS_REF AX_1B491C /end AXIS_DESCR
 /begin AXIS_DESCR COM_AXIS NO_INPUT_QUANTITY NO_COMPU_METHOD 2 AXIS_PTS_REF AX_1AAA00 /end AXIS_DESCR
/end CHARACTERISTIC
/* src=families fam=F_fam_0025 ax=0x- ay=0x- */
/begin CHARACTERISTIC F_fam_0025_19DB0C "RE map_interp_F F_fam_0025 call=0x80094BFE" VALUE 0x19DB0C RL_IDENTITY 0 NO_INPUT_QUANTITY 1.0 /end CHARACTERISTIC
/* src=families fam=E_fam_0070 ax=0x- ay=0x- */
/begin CHARACTERISTIC E_fam_0070_19DDFC "RE map_interp_E E_fam_0070 call=0x800A049A" VALUE 0x19DDFC RL_IDENTITY 0 NO_INPUT_QUANTITY 1.0 /end CHARACTERISTIC
/begin CHARACTERISTIC DTC_U1112 "atlas9979 DTC_U1112 / DTC OFF U1112 (EGR com) (IdName Caddy 9979 - verifier sur " VALUE 0x19E1AD RL_IDENTITY 0 NO_INPUT_QUANTITY 1.0 /end CHARACTERISTIC
/* src=families fam=C_fam_0174 ax=0x1B8788 ay=0x- */ /* STUB unknown size; axis_x=0x1B8788 axis_y=0x- */
/begin CHARACTERISTIC C_fam_0174_19E418 "RE map_interp_C C_fam_0174 call=0x800B875C" VALUE 0x19E418 RL_IDENTITY 0 NO_INPUT_QUANTITY 1.0 /end CHARACTERISTIC
/* src=families fam=D_fam_0110 ax=0x- ay=0x- */
/begin CHARACTERISTIC D_fam_0110_19E440 "RE map_interp_D D_fam_0110 call=0x8008D08C" VALUE 0x19E440 RL_IDENTITY 0 NO_INPUT_QUANTITY 1.0 /end CHARACTERISTIC
/* src=families fam=C_fam_0278 ax=0x1AA23C ay=0x- */ /* STUB unknown size; axis_x=0x1AA23C axis_y=0x- */
/begin CHARACTERISTIC C_fam_0278_19E454 "RE map_interp_C C_fam_0278 call=0x8008DEDC" VALUE 0x19E454 RL_IDENTITY 0 NO_INPUT_QUANTITY 1.0 /end CHARACTERISTIC
/* src=families fam=C_fam_0191 ax=0x1AB20C ay=0x- */ /* STUB unknown size; axis_x=0x1AB20C axis_y=0x- */
/begin CHARACTERISTIC C_fam_0191_19E468 "RE map_interp_C C_fam_0191 call=0x8008D32E" VALUE 0x19E468 RL_IDENTITY 0 NO_INPUT_QUANTITY 1.0 /end CHARACTERISTIC
/* src=families fam=C_fam_0187 ax=0x1AA22C ay=0x- */ /* STUB unknown size; axis_x=0x1AA22C axis_y=0x- */
/begin CHARACTERISTIC C_fam_0187_19E47C "RE map_interp_C C_fam_0187 call=0x8008E9B8" VALUE 0x19E47C RL_IDENTITY 0 NO_INPUT_QUANTITY 1.0 /end CHARACTERISTIC
/* src=families fam=fam_0063 ax=0x1A9218 ay=0x1A568C */
/begin CHARACTERISTIC map_horsA2L_19E480 "RE interp_2d fam_0063 call=0x8007BC86; RE map_interp_D D_fam_0039 call=0x8007BCB" MAP 0x19E480 RL_IDENTITY 0 NO_INPUT_QUANTITY 1.0 FORMAT "%%5.0"
 /begin AXIS_DESCR COM_AXIS NO_INPUT_QUANTITY NO_COMPU_METHOD 2 AXIS_PTS_REF AX_1A9218 /end AXIS_DESCR
 /begin AXIS_DESCR COM_AXIS NO_INPUT_QUANTITY NO_COMPU_METHOD 2 AXIS_PTS_REF AX_1A568C /end AXIS_DESCR
/end CHARACTERISTIC
/* src=families fam=C_fam_0203 ax=0x- ay=0x- */
/begin CHARACTERISTIC C_fam_0203_19E490 "RE map_interp_C C_fam_0203 call=0x800C56AE" VALUE 0x19E490 RL_IDENTITY 0 NO_INPUT_QUANTITY 1.0 /end CHARACTERISTIC
/* src=families fam=C_fam_0225 ax=0x1AFC18 ay=0x- */ /* STUB unknown size; axis_x=0x1AFC18 axis_y=0x- */
/begin CHARACTERISTIC C_fam_0225_19E49C "RE map_interp_C C_fam_0225 call=0x800FA508" VALUE 0x19E49C RL_IDENTITY 0 NO_INPUT_QUANTITY 1.0 /end CHARACTERISTIC
/* src=families fam=C_fam_0007 ax=0x1B674C ay=0x- */ /* STUB unknown size; axis_x=0x1B674C axis_y=0x- */
/begin CHARACTERISTIC C_fam_0007_19E4AC "RE map_interp_C C_fam_0007 call=0x80074254" VALUE 0x19E4AC RL_IDENTITY 0 NO_INPUT_QUANTITY 1.0 /end CHARACTERISTIC
/* src=families fam=G_fam_0016 ax=0x1A77EC ay=0x- */ /* STUB unknown size; axis_x=0x1A77EC axis_y=0x- */
/begin CHARACTERISTIC G_fam_0016_19E4C8 "RE map_interp_G G_fam_0016 call=0x800B75AE" VALUE 0x19E4C8 RL_IDENTITY 0 NO_INPUT_QUANTITY 1.0 /end CHARACTERISTIC
/* src=families fam=fam_0039 ax=0x1A36DC ay=0x1B9940 */
/begin CHARACTERISTIC map_horsA2L_19E4E0 "RE interp_2d fam_0039 call=0x80112856; RE map_interp_C C_fam_0054 call=0x8011288" MAP 0x19E4E0 RL_IDENTITY 0 NO_INPUT_QUANTITY 1.0 FORMAT "%%5.0"
 /begin AXIS_DESCR COM_AXIS NO_INPUT_QUANTITY NO_COMPU_METHOD 49 AXIS_PTS_REF AX_1A36DC /end AXIS_DESCR
 /begin AXIS_DESCR COM_AXIS NO_INPUT_QUANTITY NO_COMPU_METHOD 2 AXIS_PTS_REF AX_1B9940 /end AXIS_DESCR
/end CHARACTERISTIC
/* src=families fam=D_fam_0099 ax=0x1B6718 ay=0x- */
/begin CHARACTERISTIC D_fam_0099_19E5E4 "RE map_interp_D D_fam_0099 call=0x800E2CE0" VALUE 0x19E5E4 RL_IDENTITY 0 NO_INPUT_QUANTITY 1.0 /end CHARACTERISTIC
/* src=families fam=C_fam_0199 ax=0x1AE8D4 ay=0x- */ /* STUB unknown size; axis_x=0x1AE8D4 axis_y=0x- */
/begin CHARACTERISTIC C_fam_0199_19E608 "RE map_interp_C C_fam_0199 call=0x800D6A60; RE map_interp_N N_fam_0021 call=0x80" VALUE 0x19E608 RL_IDENTITY 0 NO_INPUT_QUANTITY 1.0 /end CHARACTERISTIC
/* src=families fam=C_fam_0293 ax=0x- ay=0x- */
/begin CHARACTERISTIC C_fam_0293_19E614 "RE map_interp_C C_fam_0293 call=0x800ADE10" VALUE 0x19E614 RL_IDENTITY 0 NO_INPUT_QUANTITY 1.0 /end CHARACTERISTIC
/* src=families fam=F_fam_0068 ax=0x1B7904 ay=0x1AE8E0 */
/begin CHARACTERISTIC F_fam_0068_19E62C "RE map_interp_F F_fam_0068 call=0x8007F250; RE map_interp_G G_fam_0058 call=0x80" MAP 0x19E62C RL_IDENTITY 0 NO_INPUT_QUANTITY 1.0 FORMAT "%%5.0"
 /begin AXIS_DESCR COM_AXIS NO_INPUT_QUANTITY NO_COMPU_METHOD 2 AXIS_PTS_REF AX_1B7904 /end AXIS_DESCR
 /begin AXIS_DESCR COM_AXIS NO_INPUT_QUANTITY NO_COMPU_METHOD 2 AXIS_PTS_REF AX_1AE8E0 /end AXIS_DESCR
/end CHARACTERISTIC
/* src=families fam=D_fam_0094 ax=0x1B0740 ay=0x- */ /* STUB unknown size; axis_x=0x1B0740 axis_y=0x- */
/begin CHARACTERISTIC D_fam_0094_19E63C "RE map_interp_D D_fam_0094 call=0x8007BDCA" VALUE 0x19E63C RL_IDENTITY 0 NO_INPUT_QUANTITY 1.0 /end CHARACTERISTIC
/* src=families fam=fam_0072 ax=0x1B081C ay=0x1AA1F8 */
/begin CHARACTERISTIC fam_0072_19E654 "RE interp_2d fam_0072 call=0x800EEF08" MAP 0x19E654 RL_IDENTITY 0 NO_INPUT_QUANTITY 1.0 FORMAT "%%5.0"
 /begin AXIS_DESCR COM_AXIS NO_INPUT_QUANTITY NO_COMPU_METHOD 2 AXIS_PTS_REF AX_1B081C /end AXIS_DESCR
 /begin AXIS_DESCR COM_AXIS NO_INPUT_QUANTITY NO_COMPU_METHOD 2 AXIS_PTS_REF AX_1AA1F8 /end AXIS_DESCR
/end CHARACTERISTIC
/* src=families fam=J_fam_0033 ax=0x1A9B4C ay=0x- */ /* STUB unknown size; axis_x=0x1A9B4C axis_y=0x- */
/begin CHARACTERISTIC J_fam_0033_19E674 "RE map_interp_J J_fam_0033 call=0x80103272" VALUE 0x19E674 RL_IDENTITY 0 NO_INPUT_QUANTITY 1.0 /end CHARACTERISTIC
/* src=families fam=K_fam_0084 ax=0x- ay=0x- */
/begin CHARACTERISTIC K_fam_0084_19E694 "RE map_interp_K K_fam_0084 call=0x800F166A" VALUE 0x19E694 RL_IDENTITY 0 NO_INPUT_QUANTITY 1.0 /end CHARACTERISTIC
/* src=families fam=K_fam_0079 ax=0x- ay=0x- */
/begin CHARACTERISTIC K_fam_0079_19E6B0 "RE map_interp_K K_fam_0079 call=0x800E2B3A" VALUE 0x19E6B0 RL_IDENTITY 0 NO_INPUT_QUANTITY 1.0 /end CHARACTERISTIC
/* src=families fam=D_fam_0089 ax=0x1AD8C4 ay=0x1B8938 */
/begin CHARACTERISTIC D_fam_0089_19E6C4 "RE map_interp_D D_fam_0089 call=0x80073F76; RE map_interp_F F_fam_0058 call=0x80" MAP 0x19E6C4 RL_IDENTITY 0 NO_INPUT_QUANTITY 1.0 FORMAT "%%5.0"
 /begin AXIS_DESCR COM_AXIS NO_INPUT_QUANTITY NO_COMPU_METHOD 2 AXIS_PTS_REF AX_1AD8C4 /end AXIS_DESCR
 /begin AXIS_DESCR COM_AXIS NO_INPUT_QUANTITY NO_COMPU_METHOD 2 AXIS_PTS_REF AX_1B8938 /end AXIS_DESCR
/end CHARACTERISTIC
/* src=families fam=D_fam_0046 ax=0x1AB924 ay=0x1B7C18 */
/begin CHARACTERISTIC D_fam_0046_19E6DC "RE map_interp_D D_fam_0046 call=0x800740CC" MAP 0x19E6DC RL_IDENTITY 0 NO_INPUT_QUANTITY 1.0 FORMAT "%%5.0"
 /begin AXIS_DESCR COM_AXIS NO_INPUT_QUANTITY NO_COMPU_METHOD 2 AXIS_PTS_REF AX_1AB924 /end AXIS_DESCR
 /begin AXIS_DESCR COM_AXIS NO_INPUT_QUANTITY NO_COMPU_METHOD 2 AXIS_PTS_REF AX_1B7C18 /end AXIS_DESCR
/end CHARACTERISTIC
/* src=families fam=F_fam_0045 ax=0x1A2550 ay=0x1B40B4 */
/begin CHARACTERISTIC F_fam_0045_19E72C "RE map_interp_F F_fam_0045 call=0x800F5BF0; RE map_interp_G G_fam_0060 call=0x80" MAP 0x19E72C RL_IDENTITY 0 NO_INPUT_QUANTITY 1.0 FORMAT "%%5.0"
 /begin AXIS_DESCR COM_AXIS NO_INPUT_QUANTITY NO_COMPU_METHOD 2 AXIS_PTS_REF AX_1A2550 /end AXIS_DESCR
 /begin AXIS_DESCR COM_AXIS NO_INPUT_QUANTITY NO_COMPU_METHOD 2 AXIS_PTS_REF AX_1B40B4 /end AXIS_DESCR
/end CHARACTERISTIC
/* src=families fam=G_fam_0071 ax=0x1B6718 ay=0x- */
/begin CHARACTERISTIC G_fam_0071_19E750 "RE map_interp_G G_fam_0071 call=0x800E2CF6" VALUE 0x19E750 RL_IDENTITY 0 NO_INPUT_QUANTITY 1.0 /end CHARACTERISTIC
/* src=families fam=fam_0084 ax=0x1B4BF0 ay=0x1B2834 */
/begin CHARACTERISTIC map_horsA2L_19E7DC "RE interp_2d fam_0084 call=0x800EED3A; RE map_interp_C C_fam_0114 call=0x800EED7" MAP 0x19E7DC RL_IDENTITY 0 NO_INPUT_QUANTITY 1.0 FORMAT "%%5.0"
 /begin AXIS_DESCR COM_AXIS NO_INPUT_QUANTITY NO_COMPU_METHOD 2 AXIS_PTS_REF AX_1B4BF0 /end AXIS_DESCR
 /begin AXIS_DESCR COM_AXIS NO_INPUT_QUANTITY NO_COMPU_METHOD 2 AXIS_PTS_REF AX_1B2834 /end AXIS_DESCR
/end CHARACTERISTIC
/* src=families fam=fam_0090 ax=0x1B7BD4 ay=0x1B3808 */
/begin CHARACTERISTIC map_horsA2L_19E7F0 "RE interp_2d fam_0090 call=0x800EE0F6" MAP 0x19E7F0 RL_IDENTITY 0 NO_INPUT_QUANTITY 1.0 FORMAT "%%5.0"
 /begin AXIS_DESCR COM_AXIS NO_INPUT_QUANTITY NO_COMPU_METHOD 2 AXIS_PTS_REF AX_1B7BD4 /end AXIS_DESCR
 /begin AXIS_DESCR COM_AXIS NO_INPUT_QUANTITY NO_COMPU_METHOD 2 AXIS_PTS_REF AX_1B3808 /end AXIS_DESCR
/end CHARACTERISTIC
/* src=families fam=C_fam_0160 ax=0x1A8BD8 ay=0x- */ /* STUB unknown size; axis_x=0x1A8BD8 axis_y=0x- */
/begin CHARACTERISTIC C_fam_0160_19E7FC "RE map_interp_C C_fam_0160 call=0x800EEAB0" VALUE 0x19E7FC RL_IDENTITY 0 NO_INPUT_QUANTITY 1.0 /end CHARACTERISTIC
/begin CHARACTERISTIC DTC_P147A "atlas9979 DTC_P147A / DTC OFF P147A (EGR) (IdName Caddy 9979 - verifier sur 9980" VALUE 0x19E809 RL_IDENTITY 0 NO_INPUT_QUANTITY 1.0 /end CHARACTERISTIC
/* src=families fam=F_fam_0107 ax=0x- ay=0x- */
/begin CHARACTERISTIC F_fam_0107_19EA00 "RE map_interp_F F_fam_0107 call=0x80092816" VALUE 0x19EA00 RL_IDENTITY 0 NO_INPUT_QUANTITY 1.0 /end CHARACTERISTIC
/* src=families fam=F_fam_0024 ax=0x- ay=0x- */
/begin CHARACTERISTIC F_fam_0024_19EAC0 "RE map_interp_F F_fam_0024 call=0x80094B5A" VALUE 0x19EAC0 RL_IDENTITY 0 NO_INPUT_QUANTITY 1.0 /end CHARACTERISTIC
/* src=families fam=F_fam_0026 ax=0x- ay=0x- */
/begin CHARACTERISTIC F_fam_0026_19EB34 "RE map_interp_F F_fam_0026 call=0x80094CA0" VALUE 0x19EB34 RL_IDENTITY 0 NO_INPUT_QUANTITY 1.0 /end CHARACTERISTIC
/* src=families fam=F_fam_0138 ax=0x- ay=0x- */
/begin CHARACTERISTIC F_fam_0138_19EB5C "RE map_interp_F F_fam_0138 call=0x800996B8" VALUE 0x19EB5C RL_IDENTITY 0 NO_INPUT_QUANTITY 1.0 /end CHARACTERISTIC
/* src=families fam=E_fam_0035 ax=0x1A7BC8 ay=0x- */ /* STUB unknown size; axis_x=0x1A7BC8 axis_y=0x- */
/begin CHARACTERISTIC E_fam_0035_19EBC8 "RE map_interp_E E_fam_0035 call=0x800B650C" VALUE 0x19EBC8 RL_IDENTITY 0 NO_INPUT_QUANTITY 1.0 /end CHARACTERISTIC
/* src=families fam=K_fam_0088 ax=0x- ay=0x- */
/begin CHARACTERISTIC K_fam_0088_19EBFC "RE map_interp_K K_fam_0088 call=0x80100688" VALUE 0x19EBFC RL_IDENTITY 0 NO_INPUT_QUANTITY 1.0 /end CHARACTERISTIC
/* src=families fam=C_fam_0244 ax=0x- ay=0x- */
/begin CHARACTERISTIC C_fam_0244_19EDC8 "RE map_interp_C C_fam_0244 call=0x800A03E8" VALUE 0x19EDC8 RL_IDENTITY 0 NO_INPUT_QUANTITY 1.0 /end CHARACTERISTIC
/* src=families fam=D_fam_0052 ax=0x1AF77C ay=0x1A0548 */
/begin CHARACTERISTIC D_fam_0052_19F3C4 "RE map_interp_D D_fam_0052 call=0x800F5D0C; RE map_interp_F F_fam_0046 call=0x80" MAP 0x19F3C4 RL_IDENTITY 0 NO_INPUT_QUANTITY 1.0 FORMAT "%%5.0"
 /begin AXIS_DESCR COM_AXIS NO_INPUT_QUANTITY NO_COMPU_METHOD 2 AXIS_PTS_REF AX_1AF77C /end AXIS_DESCR
 /begin AXIS_DESCR COM_AXIS NO_INPUT_QUANTITY NO_COMPU_METHOD 2 AXIS_PTS_REF AX_1A0548 /end AXIS_DESCR
/end CHARACTERISTIC
/* src=families fam=C_fam_0113 ax=0x1B0C34 ay=0x1AA974 */
/begin CHARACTERISTIC C_fam_0113_19F400 "RE map_interp_C C_fam_0113 call=0x8008E462; RE map_interp_D D_fam_0053 call=0x80" MAP 0x19F400 RL_IDENTITY 0 NO_INPUT_QUANTITY 1.0 FORMAT "%%5.0"
 /begin AXIS_DESCR COM_AXIS NO_INPUT_QUANTITY NO_COMPU_METHOD 2 AXIS_PTS_REF AX_1B0C34 /end AXIS_DESCR
 /begin AXIS_DESCR COM_AXIS NO_INPUT_QUANTITY NO_COMPU_METHOD 2 AXIS_PTS_REF AX_1AA974 /end AXIS_DESCR
/end CHARACTERISTIC
/* src=families fam=D_fam_0127 ax=0x1A0448 ay=0x1B0238 */
/begin CHARACTERISTIC D_fam_0127_19F414 "RE map_interp_D D_fam_0127 call=0x8008E1E2; RE map_interp_F F_fam_0003 call=0x80" MAP 0x19F414 RL_IDENTITY 0 NO_INPUT_QUANTITY 1.0 FORMAT "%%5.0"
 /begin AXIS_DESCR COM_AXIS NO_INPUT_QUANTITY NO_COMPU_METHOD 2 AXIS_PTS_REF AX_1A0448 /end AXIS_DESCR
 /begin AXIS_DESCR COM_AXIS NO_INPUT_QUANTITY NO_COMPU_METHOD 2 AXIS_PTS_REF AX_1B0238 /end AXIS_DESCR
/end CHARACTERISTIC
/* src=families fam=D_fam_0020 ax=0x1A0448 ay=0x1B0238 */
/begin CHARACTERISTIC D_fam_0020_19F424 "RE map_interp_D D_fam_0020 call=0x8008E224; RE map_interp_F F_fam_0003 call=0x80" MAP 0x19F424 RL_IDENTITY 0 NO_INPUT_QUANTITY 1.0 FORMAT "%%5.0"
 /begin AXIS_DESCR COM_AXIS NO_INPUT_QUANTITY NO_COMPU_METHOD 2 AXIS_PTS_REF AX_1A0448 /end AXIS_DESCR
 /begin AXIS_DESCR COM_AXIS NO_INPUT_QUANTITY NO_COMPU_METHOD 2 AXIS_PTS_REF AX_1B0238 /end AXIS_DESCR
/end CHARACTERISTIC
/* src=families fam=E_fam_0052 ax=0x1AE1D0 ay=0x- */ /* STUB unknown size; axis_x=0x1AE1D0 axis_y=0x- */
/begin CHARACTERISTIC E_fam_0052_19F450 "RE map_interp_E E_fam_0052 call=0x800EB962" VALUE 0x19F450 RL_IDENTITY 0 NO_INPUT_QUANTITY 1.0 /end CHARACTERISTIC
/* src=families fam=C_fam_0123 ax=0x1B675C ay=0x1AD8D0 */
/begin CHARACTERISTIC C_fam_0123_19F480 "RE map_interp_C C_fam_0123 call=0x80074E68" MAP 0x19F480 RL_IDENTITY 0 NO_INPUT_QUANTITY 1.0 FORMAT "%%5.0"
 /begin AXIS_DESCR COM_AXIS NO_INPUT_QUANTITY NO_COMPU_METHOD 2 AXIS_PTS_REF AX_1B675C /end AXIS_DESCR
 /begin AXIS_DESCR COM_AXIS NO_INPUT_QUANTITY NO_COMPU_METHOD 2 AXIS_PTS_REF AX_1AD8D0 /end AXIS_DESCR
/end CHARACTERISTIC
/* src=horsA2L fam=- ax=0x19F4BC ay=0x19C4D0 */ /* STUB unknown size; axis_x=0x19F4BC axis_y=0x19C4D0 */
/begin CHARACTERISTIC map_horsA2L_19F4BC_19F4BC "low: pas dans l A2L/atlas 9979 (299 maps WinOLS) - nommer a la main si besoin; i" VALUE 0x19F4BC RL_IDENTITY 0 NO_INPUT_QUANTITY 1.0 /end CHARACTERISTIC
/* src=families fam=C_fam_0171 ax=0x1B677C ay=0x- */ /* STUB unknown size; axis_x=0x1B677C axis_y=0x- */
/begin CHARACTERISTIC C_fam_0171_19F4C8 "RE map_interp_C C_fam_0171 call=0x800F8FA4" VALUE 0x19F4C8 RL_IDENTITY 0 NO_INPUT_QUANTITY 1.0 /end CHARACTERISTIC
/* src=families fam=D_fam_0134 ax=0x1AC820 ay=0x- */ /* STUB unknown size; axis_x=0x1AC820 axis_y=0x- */
/begin CHARACTERISTIC D_fam_0134_19F4F0 "RE map_interp_D D_fam_0134 call=0x800F0276" VALUE 0x19F4F0 RL_IDENTITY 0 NO_INPUT_QUANTITY 1.0 /end CHARACTERISTIC
/* src=horsA2L fam=- ax=0x19F540 ay=0x199760 */ /* STUB unknown size; axis_x=0x19F540 axis_y=0x199760 */
/begin CHARACTERISTIC map_horsA2L_19F540_19F540 "low: pas dans l A2L/atlas 9979 (299 maps WinOLS) - nommer a la main si besoin; i" VALUE 0x19F540 RL_IDENTITY 0 NO_INPUT_QUANTITY 1.0 /end CHARACTERISTIC
/* src=families fam=C_fam_0072 ax=0x1A3674 ay=0x1AF224 */
/begin CHARACTERISTIC C_fam_0072_19F60C "RE map_interp_C C_fam_0072 call=0x8008B688" MAP 0x19F60C RL_IDENTITY 0 NO_INPUT_QUANTITY 1.0 FORMAT "%%5.0"
 /begin AXIS_DESCR COM_AXIS NO_INPUT_QUANTITY NO_COMPU_METHOD 2 AXIS_PTS_REF AX_1A3674 /end AXIS_DESCR
 /begin AXIS_DESCR COM_AXIS NO_INPUT_QUANTITY NO_COMPU_METHOD 2 AXIS_PTS_REF AX_1AF224 /end AXIS_DESCR
/end CHARACTERISTIC
/* src=families fam=fam_0026 ax=0x1A070C ay=0x1AA70C */
/begin CHARACTERISTIC map_horsA2L_19F61C "RE interp_2d fam_0026 call=0x8007F122" MAP 0x19F61C RL_IDENTITY 0 NO_INPUT_QUANTITY 1.0 FORMAT "%%5.0"
 /begin AXIS_DESCR COM_AXIS NO_INPUT_QUANTITY NO_COMPU_METHOD 2 AXIS_PTS_REF AX_1A070C /end AXIS_DESCR
 /begin AXIS_DESCR COM_AXIS NO_INPUT_QUANTITY NO_COMPU_METHOD 2 AXIS_PTS_REF AX_1AA70C /end AXIS_DESCR
/end CHARACTERISTIC
/* src=families fam=N_fam_0026 ax=0x- ay=0x- */
/begin CHARACTERISTIC N_fam_0026_19F638 "RE map_interp_N N_fam_0026 call=0x8008C39A" VALUE 0x19F638 RL_IDENTITY 0 NO_INPUT_QUANTITY 1.0 /end CHARACTERISTIC
/* src=families fam=J_fam_0041 ax=0x1AFA84 ay=0x- */ /* STUB unknown size; axis_x=0x1AFA84 axis_y=0x- */
/begin CHARACTERISTIC J_fam_0041_19F654 "RE map_interp_J J_fam_0041 call=0x8010659A" VALUE 0x19F654 RL_IDENTITY 0 NO_INPUT_QUANTITY 1.0 /end CHARACTERISTIC
/* src=families fam=J_fam_0032 ax=0x1B79C0 ay=0x1A14FC */
/begin CHARACTERISTIC J_fam_0032_19F660 "RE map_interp_J J_fam_0032 call=0x800DE2B6" MAP 0x19F660 RL_IDENTITY 0 NO_INPUT_QUANTITY 1.0 FORMAT "%%5.0"
 /begin AXIS_DESCR COM_AXIS NO_INPUT_QUANTITY NO_COMPU_METHOD 2 AXIS_PTS_REF AX_1B79C0 /end AXIS_DESCR
 /begin AXIS_DESCR COM_AXIS NO_INPUT_QUANTITY NO_COMPU_METHOD 2 AXIS_PTS_REF AX_1A14FC /end AXIS_DESCR
/end CHARACTERISTIC
/* src=families fam=J_fam_0035 ax=0x1ABB54 ay=0x- */ /* STUB unknown size; axis_x=0x1ABB54 axis_y=0x- */
/begin CHARACTERISTIC J_fam_0035_19F66C "RE map_interp_J J_fam_0035 call=0x80117B6C" VALUE 0x19F66C RL_IDENTITY 0 NO_INPUT_QUANTITY 1.0 /end CHARACTERISTIC
/* src=families fam=D_fam_0136 ax=0x- ay=0x- */
/begin CHARACTERISTIC D_fam_0136_19F6C0 "RE map_interp_D D_fam_0136 call=0x80074028" VALUE 0x19F6C0 RL_IDENTITY 0 NO_INPUT_QUANTITY 1.0 /end CHARACTERISTIC
/* src=families fam=G_fam_0063 ax=0x1A0610 ay=0x- */
/begin CHARACTERISTIC G_fam_0063_19F77C "RE map_interp_G G_fam_0063 call=0x800E2E10" VALUE 0x19F77C RL_IDENTITY 0 NO_INPUT_QUANTITY 1.0 /end CHARACTERISTIC
/* src=families fam=G_fam_0054 ax=0x1B4738 ay=0x1A15E8 */
/begin CHARACTERISTIC G_fam_0054_19F790 "RE map_interp_G G_fam_0054 call=0x800F1874" MAP 0x19F790 RL_IDENTITY 0 NO_INPUT_QUANTITY 1.0 FORMAT "%%5.0"
 /begin AXIS_DESCR COM_AXIS NO_INPUT_QUANTITY NO_COMPU_METHOD 2 AXIS_PTS_REF AX_1B4738 /end AXIS_DESCR
 /begin AXIS_DESCR COM_AXIS NO_INPUT_QUANTITY NO_COMPU_METHOD 2 AXIS_PTS_REF AX_1A15E8 /end AXIS_DESCR
/end CHARACTERISTIC
/* src=horsA2L fam=- ax=0x19F7D0 ay=0x19D674 */ /* STUB unknown size; axis_x=0x19F7D0 axis_y=0x19D674 */
/begin CHARACTERISTIC map_horsA2L_19F7D0_19F7D0 "low: pas dans l A2L/atlas 9979 (299 maps WinOLS) - nommer a la main si besoin; i" VALUE 0x19F7D0 RL_IDENTITY 0 NO_INPUT_QUANTITY 1.0 /end CHARACTERISTIC
/* src=families fam=C_fam_0161 ax=0x1A9BE8 ay=0x1A881C */
/begin CHARACTERISTIC C_fam_0161_19F7E4 "RE map_interp_C C_fam_0161 call=0x800EE014" MAP 0x19F7E4 RL_IDENTITY 0 NO_INPUT_QUANTITY 1.0 FORMAT "%%5.0"
 /begin AXIS_DESCR COM_AXIS NO_INPUT_QUANTITY NO_COMPU_METHOD 2 AXIS_PTS_REF AX_1A9BE8 /end AXIS_DESCR
 /begin AXIS_DESCR COM_AXIS NO_INPUT_QUANTITY NO_COMPU_METHOD 2 AXIS_PTS_REF AX_1A881C /end AXIS_DESCR
/end CHARACTERISTIC
/* src=families fam=C_fam_0034 ax=0x1AFBD0 ay=0x1A8BC0 */
/begin CHARACTERISTIC C_fam_0034_19F7F4 "RE map_interp_C C_fam_0034 call=0x800EDAEE" MAP 0x19F7F4 RL_IDENTITY 0 NO_INPUT_QUANTITY 1.0 FORMAT "%%5.0"
 /begin AXIS_DESCR COM_AXIS NO_INPUT_QUANTITY NO_COMPU_METHOD 2 AXIS_PTS_REF AX_1AFBD0 /end AXIS_DESCR
 /begin AXIS_DESCR COM_AXIS NO_INPUT_QUANTITY NO_COMPU_METHOD 8 AXIS_PTS_REF AX_1A8BC0 /end AXIS_DESCR
/end CHARACTERISTIC
/* src=families fam=F_fam_0139 ax=0x- ay=0x- */
/begin CHARACTERISTIC F_fam_0139_19FB44 "RE map_interp_F F_fam_0139 call=0x80099754" VALUE 0x19FB44 RL_IDENTITY 0 NO_INPUT_QUANTITY 1.0 /end CHARACTERISTIC
/* src=families fam=H_fam_0016 ax=0x1A4C70 ay=0x- */ /* STUB unknown size; axis_x=0x1A4C70 axis_y=0x- */
/begin CHARACTERISTIC H_fam_0016_19FBEC "RE map_interp_H H_fam_0016 call=0x80093986" VALUE 0x19FBEC RL_IDENTITY 0 NO_INPUT_QUANTITY 1.0 /end CHARACTERISTIC
/end MODULE
/end PROJECT
/* COUNTS CHARACTERISTIC=1167 (MAP/CURVE=363 STUB=804) MEASUREMENT=8 AXIS_PTS=622 skipped_interior=46 */
