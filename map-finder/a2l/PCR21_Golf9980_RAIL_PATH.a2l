ASAP2_VERSION 1 60
/*
* PCR2.1 Golf 9980 - RAIL PATH only (RE, not OEM).
* Source: Ghidra chain 2026-08-23. Do not flash from these labels.
* Units unknown. Names = role in code.
*/
/begin PROJECT PCR21_Golf9980_RAIL_PATH "RE rail path 9980 - NOT OEM"
/begin MODULE PCR21_SM2G0P_9980_RAIL "rail_sp + e6e8 + bank index"
/begin AXIS_PTS AX_1930CC "RE axis interp_C a5; 16 placeholder" 0x1930CC RL_IDENTITY 0 NO_INPUT_QUANTITY 1.0 16 FORMAT "%%5.0" /end AXIS_PTS
/begin CHARACTERISTIC rail_sp_curve_18D0F0 "interp_C a4 -> D0013872/3870; X=D0018666" CURVE 0x18D0F0 RL_IDENTITY 0 NO_INPUT_QUANTITY 1.0 FORMAT "%%5.0"
 /begin AXIS_DESCR COM_AXIS NO_INPUT_QUANTITY NO_COMPU_METHOD 16 AXIS_PTS_REF AX_1930CC /end AXIS_DESCR
/end CHARACTERISTIC
/begin CHARACTERISTIC rail_sp_pt1_gain "d6 FUN_8004d15c @800BA0C8" VALUE 0x19314A RL_IDENTITY 0 NO_INPUT_QUANTITY 1.0 /end CHARACTERISTIC
/begin CHARACTERISTIC rail_sp_default "ld.hu into D0013870; dump value 0" VALUE 0x18C154 RL_IDENTITY 0 NO_INPUT_QUANTITY 1.0 /end CHARACTERISTIC
/begin CHARACTERISTIC e6e8_curve_197382 "FUN_8004bdc8 X=D000E6E8 not rail bar" VALUE 0x197382 RL_IDENTITY 0 NO_INPUT_QUANTITY 1.0 /end CHARACTERISTIC
/begin CHARACTERISTIC e6e8_interpH_1973A8 "map_interp_H @80091ADC" VALUE 0x1973A8 RL_IDENTITY 0 NO_INPUT_QUANTITY 1.0 /end CHARACTERISTIC
/begin MEASUREMENT rail_sp_target "cible avant PT1 (sortie interp_C 18D0F0)" UWORD RL_IDENTITY 0 0 0 65535 ECU_ADDRESS 0xD0013870 /end MEASUREMENT
/begin MEASUREMENT rail_sp_filtered "apres FUN_8004d15c; copie vers D000B6AE" UWORD RL_IDENTITY 0 0 0 65535 ECU_ADDRESS 0xD0013874 /end MEASUREMENT
/begin MEASUREMENT rail_sp_x_1E9DE0 "X du site rail 2d 800F5114" UWORD RL_IDENTITY 0 0 0 65535 ECU_ADDRESS 0xD000B6AE /end MEASUREMENT
/begin MEASUREMENT rail_sp_curve_x "X de 18D0F0 = D000048A / D00019DC" UWORD RL_IDENTITY 0 0 0 65535 ECU_ADDRESS 0xD0018666 /end MEASUREMENT
/begin MEASUREMENT rail_sp_ratio_den "denominateur du ratio 8666" UWORD RL_IDENTITY 0 0 0 65535 ECU_ADDRESS 0xD00019DC /end MEASUREMENT
/begin MEASUREMENT rail_sp_ratio_num "numerateur (ld.w) voisin ram_0414" ULONG RL_IDENTITY 0 0 0 4294967295 ECU_ADDRESS 0xD000048A /end MEASUREMENT
/begin MEASUREMENT e6e8_ratio "quotient FUN_80080f4c; PAS consigne bar" UWORD RL_IDENTITY 0 0 0 65535 ECU_ADDRESS 0xD000E6E8 /end MEASUREMENT
/begin MEASUREMENT rail_bank_index "ld.bu mode/index site rail B 800B5A96 - porte multi-map" UBYTE RL_IDENTITY 0 0 0 255 ECU_ADDRESS 0xD000A946 /end MEASUREMENT
/end MODULE
/end PROJECT
